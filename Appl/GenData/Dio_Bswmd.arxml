AUTOSAR XML (schema 4-2-2)
# Copyright (C) Infineon Technologies (2020)
# All rights reserved.
package /AUTOSAR_Dio/BswModuleDescriptions
  bsw module description Dio: category=BSW_MODULE, module-id=120  # DIO Driver
    provided-entrys:
      Dio_ReadChannel
      Dio_WriteChannel
      Dio_ReadPort
      Dio_WritePort
      Dio_ReadChannelGroup
      Dio_WriteChannelGroup
      Dio_FlipChannel
      Dio_MaskedWritePort
    bsw module dependency DetDependency: category=BSW_MODULE, target-module-id=15, required-entrys=Det_ReportError
    bsw module dependency McalLibDependency: target-module-id=255, required-entrys=Mcal_SetBitAtomic
    bsw internal behavior DioBehavior
      8 x bsw called entity, all with reentrancy-level=MULTICORE-REENTRANT:
        Dio_ReadChannel: implemented-entry=Dio_ReadChannel
        Dio_WriteChannel: implemented-entry=Dio_WriteChannel
        Dio_ReadPort: implemented-entry=Dio_ReadPort
        Dio_WritePort: implemented-entry=Dio_WritePort
        Dio_ReadChannelGroup: implemented-entry=Dio_ReadChannelGroup
        Dio_WriteChannelGroup: implemented-entry=Dio_WriteChannelGroup
        Dio_FlipChannel: implemented-entry=Dio_FlipChannel
        Dio_MaskedWritePort: implemented-entry=Dio_MaskedWritePort
package /AUTOSAR_Dio/BswModuleEntrys
  8 x bsw module entry, all with is-reentrant=true, is-synchronous=true, call-type=REGULAR, execution-context=TASK, sw-service-impl-policy=STANDARD:
    Dio_ReadChannel: service-id=0
      return type Return: implementation-data-type=Dio_LevelType
      sw service arg ChannelId: implementation-data-type=Dio_ChannelType
    Dio_WriteChannel: service-id=1
      sw service arg ChannelId: implementation-data-type=Dio_ChannelType
      sw service arg Level: implementation-data-type=Dio_LevelType
    Dio_ReadPort: service-id=2
      return type Return: implementation-data-type=Dio_PortLevelType
      sw service arg PortId: implementation-data-type=Dio_PortType
    Dio_WritePort: service-id=3
      sw service arg PortId: implementation-data-type=Dio_PortType
      sw service arg Level: implementation-data-type=Dio_PortLevelType
    Dio_ReadChannelGroup: service-id=4
      return type Return: implementation-data-type=Dio_PortLevelType
      sw service arg ChannelGroupIdPtr: category=DATA_REFERENCE, sw-pointer-target-props={target-category=TYPE_REFERENCE, implementation-data-type=Dio_ChannelGroupType}
    Dio_WriteChannelGroup: service-id=5
      sw service arg ChannelGroupIdPtr: category=DATA_REFERENCE, sw-pointer-target-props={target-category=TYPE_REFERENCE, implementation-data-type=Dio_ChannelGroupType}
      sw service arg Level: implementation-data-type=Dio_PortLevelType
    Dio_FlipChannel: service-id=17
      return type Return: implementation-data-type=Dio_LevelType
      sw service arg ChannelId: implementation-data-type=Dio_ChannelType
    Dio_MaskedWritePort: service-id=13
      sw service arg PortId: implementation-data-type=Dio_PortType
      sw service arg Level: implementation-data-type=Dio_PortLevelType
      sw service arg Mask: implementation-data-type=Dio_PortLevelType
package /AUTOSAR_Dio/Implementations
  bsw implementation Dio: programming-language=C, sw-version=20.0.1, vendor-id=17, ar-release-version=4.2.2, behavior=DioBehavior, vendor-specific-module-def=Dio
    code-descriptors:
      code Files: artifact-descriptors=[{short-label=ssc::src::Dio.c, category=SWSRC}, {short-label=ssc::inc::Dio.h, category=SWHDR}]
    generated-artifacts:
      4 x dependency on artifact:
        Dio_Cfg_h: artifact-descriptor={short-label=generate::template::inc::Dio_Cfg.h, category=SWTEMPLATE}, usages=COMPILE
        Dio_Lcfg_c: artifact-descriptor={short-label=generate::template::src::Dio_Lcfg.c, category=SWTEMPLATE}, usages=LINK
        Dio_xdm: artifact-descriptor={short-label=config::Dio.xdm, category=SWTOOL}, usages=CODEGENERATION
        Dio_bmd: artifact-descriptor={short-label=autosar::TC36x::TC364x_TQFP::Dio.bmd, category=SWTOOL}, usages=CODEGENERATION
    resource consumption ResourceConsumption
      4 x memory section:
        CONST_ASIL_B_GLOBAL_16: alignment=16, sw-addrmethod=CONST
        CONST_ASIL_B_GLOBAL_32: alignment=32, sw-addrmethod=CONST
        CONFIG_DATA_ASIL_B_GLOBAL_UNSPECIFIED: alignment=UNSPECIFIED, sw-addrmethod=CONFIG_DATA
        CODE_ASIL_B_GLOBAL: alignment=UNSPECIFIED, sw-addrmethod=CODE
      section name prefix DIO
package /AUTOSAR_Dio/ImplementationDataTypes
  5 x impl type, all with type-emitter=BSW:
    Dio_ChannelGroupType: category=STRUCTURE
      element Mask: implementation-data-type=uint16
      element Offset: implementation-data-type=uint8
      element Port: implementation-data-type=Dio_PortType
    Dio_ChannelType: implementation-data-type=uint16
    Dio_LevelType: implementation-data-type=uint8
    Dio_PortType: implementation-data-type=uint8
    Dio_PortLevelType: implementation-data-type=uint16
