AUTOSAR XML (schema 4-2-2)
# Copyright (C) Infineon Technologies (2021)
# All rights reserved.
package /AUTOSAR_Spi/BswModuleDescriptions
  bsw module description Spi: category=BSW_MODULE, module-id=83  # SPI Driver
    provided-entrys:
      Spi_Init
      Spi_DeInit
      Spi_SetupEB
      Spi_GetStatus
      Spi_GetJobResult
      Spi_GetSequenceResult
      Spi_SyncTransmit
      Spi_GetHWUnitStatus
      Spi_Cancel
      Spi_ControlLoopBack
    bsw module dependency McalLibDependency: target-module-id=255, required-entrys=Mcal_WritePeripEndInitProtReg
    bsw internal behavior SpiBehavior
      exclusive area SyncLock
      exclusive area Queue_Update
      10 x bsw called entity:
        Spi_Init: reentrancy-level=NON-REENTRANT, implemented-entry=Spi_Init
        Spi_DeInit: reentrancy-level=NON-REENTRANT, implemented-entry=Spi_DeInit
        Spi_SetupEB: reentrancy-level=MULTICORE-REENTRANT, implemented-entry=Spi_SetupEB
        Spi_GetStatus: reentrancy-level=MULTICORE-REENTRANT, implemented-entry=Spi_GetStatus
        Spi_GetJobResult: reentrancy-level=MULTICORE-REENTRANT, implemented-entry=Spi_GetJobResult
        Spi_GetSequenceResult: reentrancy-level=MULTICORE-REENTRANT, implemented-entry=Spi_GetSequenceResult
        Spi_SyncTransmit: can-enter-exclusive-area=SyncLock, reentrancy-level=MULTICORE-REENTRANT, implemented-entry=Spi_SyncTransmit
        Spi_GetHWUnitStatus: reentrancy-level=MULTICORE-REENTRANT, implemented-entry=Spi_GetHWUnitStatus
        Spi_Cancel: can-enter-exclusive-area=Queue_Update, reentrancy-level=MULTICORE-REENTRANT, implemented-entry=Spi_Cancel
        Spi_ControlLoopBack: reentrancy-level=MULTICORE-REENTRANT, implemented-entry=Spi_ControlLoopBack
      service-needs:
        diagnostic event needs SPI_E_HARDWARE_ERROR
package /AUTOSAR_Spi/BswModuleEntrys
  10 x bsw module entry, all with call-type=REGULAR, execution-context=TASK, sw-service-impl-policy=STANDARD:
    Spi_Init: service-id=0, is-reentrant=false, is-synchronous=true
      sw service arg ConfigPtr: category=DATA_REFERENCE, sw-pointer-target-props={target-category=TYPE_REFERENCE, implementation-data-type=Spi_ConfigType}
    Spi_DeInit: service-id=1, is-reentrant=false, is-synchronous=true
      return type Return: implementation-data-type=Std_ReturnType
    Spi_SetupEB: service-id=5, is-reentrant=true, is-synchronous=true
      return type Return: implementation-data-type=Std_ReturnType
      4 x sw service arg:
        Channel: implementation-data-type=Spi_ChannelType
        SrcDataBufferPtr: category=DATA_REFERENCE, sw-pointer-target-props={target-category=TYPE_REFERENCE, implementation-data-type=Spi_DataBufferType}
        DesDataBufferPtr: category=DATA_REFERENCE, sw-pointer-target-props={target-category=TYPE_REFERENCE, implementation-data-type=Spi_DataBufferType}
        Length: implementation-data-type=Spi_NumberOfDataType
    Spi_GetStatus: service-id=6, is-reentrant=true, is-synchronous=true
      return type Return: implementation-data-type=Spi_StatusType
    Spi_GetJobResult: service-id=7, is-reentrant=true, is-synchronous=true
      return type Return: implementation-data-type=Spi_JobResultType
      sw service arg Job: implementation-data-type=Spi_JobType
    Spi_GetSequenceResult: service-id=8, is-reentrant=true, is-synchronous=true
      return type Return: implementation-data-type=Spi_SeqResultType
      sw service arg Sequence: implementation-data-type=Spi_SequenceType
    Spi_SyncTransmit: service-id=10, is-reentrant=true, is-synchronous=true
      return type Return: implementation-data-type=Std_ReturnType
      sw service arg Sequence: implementation-data-type=Spi_SequenceType
    Spi_GetHWUnitStatus: service-id=11, is-reentrant=true, is-synchronous=true
      return type Return: implementation-data-type=Spi_StatusType
      sw service arg HWUnit: implementation-data-type=Spi_HWUnitType
    Spi_Cancel: service-id=12, is-reentrant=true, is-synchronous=false
      sw service arg Sequence: implementation-data-type=Spi_SequenceType
    Spi_ControlLoopBack: service-id=37, is-reentrant=true, is-synchronous=true
      return type Return: implementation-data-type=Std_ReturnType
      sw service arg HWUnit: implementation-data-type=Spi_HWUnitType
      sw service arg EnableOrDisable: implementation-data-type=Spi_LoopBackType
package /AUTOSAR_Spi/Implementations
  bsw implementation Spi: programming-language=C, sw-version=20.10.0, vendor-id=17, ar-release-version=4.2.2, behavior=SpiBehavior, vendor-specific-module-def=Spi
    code-descriptors:
      code Files: artifact-descriptors=[{short-label=ssc::src::Spi.c, category=SWSRC}, {short-label=ssc::inc::Spi.h, category=SWHDR}]
    generated-artifacts:
      5 x dependency on artifact:
        Spi_PBcfg_c: artifact-descriptor={short-label=generate::template::src::Spi_PBcfg.c, category=SWTEMPLATE}, usages=EXECUTE
        Spi_PBcfg_h: artifact-descriptor={short-label=generate::template::inc::Spi_PBcfg.h, category=SWTEMPLATE}, usages=EXECUTE
        Spi_Cfg_h: artifact-descriptor={short-label=generate::template::inc::Spi_Cfg.h, category=SWTEMPLATE}, usages=EXECUTE
        Spi_xdm: artifact-descriptor={short-label=Config::Spi.xdm, category=SWTOOL}, usages=CODEGENERATION
        Spi_bmd: artifact-descriptor={short-label=autosar::TC36x::TC364x_TQFP::Spi.bmd, category=SWTOOL}, usages=CODEGENERATION
    resource consumption ResourceConsumption
      10 x memory section:
        VAR_CLEARED_ASIL_B_CORE0_32: alignment=32, sw-addrmethod=VAR_CLEARED
        VAR_CLEARED_ASIL_B_CORE0_256: alignment=256, sw-addrmethod=VAR_CLEARED
        CONFIG_DATA_ASIL_B_CORE0_32: alignment=32, sw-addrmethod=CONFIG_DATA
        VAR_CLEARED_ASIL_B_CORE1_32: alignment=32, sw-addrmethod=VAR_CLEARED
        VAR_CLEARED_ASIL_B_CORE1_256: alignment=256, sw-addrmethod=VAR_CLEARED
        CONFIG_DATA_ASIL_B_CORE1_32: alignment=32, sw-addrmethod=CONFIG_DATA
        CONFIG_DATA_ASIL_B_GLOBAL_32: alignment=32, sw-addrmethod=CONFIG_DATA
        CONFIG_DATA_ASIL_B_GLOBAL_UNSPECIFIED: alignment=UNSPECIFIED, sw-addrmethod=CONFIG_DATA
        VAR_CLEARED_ASIL_B_GLOBAL_32: alignment=32, sw-addrmethod=VAR_CLEARED
        CODE_ASIL_B_GLOBAL: alignment=UNSPECIFIED, sw-addrmethod=CODE
      section name prefix SPI
package /AUTOSAR_Spi/ImplementationDataTypes
  20 x impl type, all with type-emitter=BSW:
    Spi_JobEndNotification: category=FUNCTION_REFERENCE, sw-pointer-target-props=Spi_JobEndCallback
    Spi_JobResultType: compu {0=SPI_JOB_OK, 1=SPI_JOB_PENDING, 2=SPI_JOB_FAILED, 3=SPI_JOB_QUEUED}, implementation-data-type=sint32, additional-native-type-qualifier=enum
    Spi_SeqEndNotification: category=FUNCTION_REFERENCE, sw-pointer-target-props=Spi_SeqEndCallback
    Spi_SeqResultType: compu {0=SPI_SEQ_OK, 1=SPI_SEQ_PENDING, 2=SPI_SEQ_FAILED, 3=SPI_SEQ_CANCELLED}, implementation-data-type=sint32, additional-native-type-qualifier=enum
    Spi_StatusType: compu {0=SPI_UNINIT, 1=SPI_IDLE, 2=SPI_BUSY}, implementation-data-type=sint32, additional-native-type-qualifier=enum
    Spi_DataBufferType: implementation-data-type=uint8
    Spi_NumberOfDataType: implementation-data-type=uint16
    Spi_ChannelType: implementation-data-type=uint8
    Spi_JobType: implementation-data-type=uint16
    Spi_SequenceType: implementation-data-type=uint8
    Spi_HWUnitType: implementation-data-type=uint8
    Spi_LoopBackType: compu {0=SPI_LOOPBACK_DISABLE, 1=SPI_LOOPBACK_ENABLE}, implementation-data-type=sint32, additional-native-type-qualifier=enum
    Spi_QSPIHwMapConfigType: implementation-data-type=uint32
    Spi_ChannelConfigType: category=STRUCTURE
      5 x element, all with category=TYPE_REFERENCE:
        Defaultdata: implementation-data-type=uint32
        NoOfDataElements: implementation-data-type=uint16
        ChannelType: implementation-data-type=uint8
        DataConfig: implementation-data-type=uint8
        ChannelId: implementation-data-type=Spi_ChannelType
    Spi_ConfigType: category=STRUCTURE
      8 x element:
        CoreConfigPtr: category=DATA_REFERENCE, sw-pointer-target-props={target-category=TYPE_REFERENCE, implementation-data-type=Spi_CoreConfigType}
        SequenceLookup: category=DATA_REFERENCE, sw-pointer-target-props={target-category=TYPE_REFERENCE, implementation-data-type=uint8}
        JobLookup: category=DATA_REFERENCE, sw-pointer-target-props={target-category=TYPE_REFERENCE, implementation-data-type=uint16}
        ChannelLookup: category=DATA_REFERENCE, sw-pointer-target-props={target-category=TYPE_REFERENCE, implementation-data-type=uint8}
        NoOfSequences: implementation-data-type=Spi_SequenceType
        NoOfJobs: implementation-data-type=Spi_JobType
        NoOfChannels: implementation-data-type=Spi_ChannelType
        SyncTimeout: implementation-data-type=uint32
    Spi_CoreChannelOffsetType: category=STRUCTURE
      element ChannelOffset: implementation-data-type=uint16
      element DataTransferLength: implementation-data-type=uint16
    Spi_CoreConfigType: category=STRUCTURE
      9 x element:
        SequenceConfigPtr: category=DATA_REFERENCE, sw-pointer-target-props={target-category=TYPE_REFERENCE, implementation-data-type=Spi_SequenceConfigType}
        JobConfigPtr: category=DATA_REFERENCE, sw-pointer-target-props={target-category=TYPE_REFERENCE, implementation-data-type=Spi_JobConfigType}
        ChannelConfigPtr: category=DATA_REFERENCE, sw-pointer-target-props={target-category=TYPE_REFERENCE, implementation-data-type=Spi_ChannelConfigType}
        ChannelOffsetInfo: implementation-data-type=Spi_CoreChannelOffsetType
        QSPIHwConfigPtr: category=DATA_REFERENCE, sw-pointer-target-props={target-category=TYPE_REFERENCE, implementation-data-type=Spi_QspiHwConfigType}
        QSPIHwMap: category=DATA_REFERENCE, sw-pointer-target-props={target-category=TYPE_REFERENCE, implementation-data-type=Spi_QSPIHwMapConfigType}
        NoOfSequences: implementation-data-type=Spi_SequenceType
        NoOfJobs: implementation-data-type=Spi_JobType
        NoOfChannels: implementation-data-type=Spi_ChannelType
    Spi_JobConfigType: category=STRUCTURE
      10 x element:
        JobId: implementation-data-type=Spi_JobType
        BaudRateAndClockParam: implementation-data-type=uint32
        IdleLeadTrailDelay: implementation-data-type=uint32
        ChnlLinkPtrPhysical: category=DATA_REFERENCE, sw-pointer-target-props={target-category=TYPE_REFERENCE, implementation-data-type=Spi_ChannelType}
        CSPortPin: implementation-data-type=uint16
        JobPriority: implementation-data-type=uint8
        CsPolarity: implementation-data-type=uint8
        HwUnit: implementation-data-type=Spi_HWUnitType
        ParitySupport: implementation-data-type=uint8
        FramebasedCs: implementation-data-type=uint8
    Spi_QspiHwConfigType: category=STRUCTURE
      7 x element, all with category=TYPE_REFERENCE:
        ActiveChipSelectLevel: implementation-data-type=uint32
        JobQueueLength: implementation-data-type=uint16
        ClockSetting: implementation-data-type=uint8
        MasterReceivePortPin: implementation-data-type=uint8
        MaxSequence: implementation-data-type=Spi_SequenceType
        ExternalDemuxEnabled: implementation-data-type=uint8
        StrobeDelay: implementation-data-type=uint32
    Spi_SequenceConfigType: category=STRUCTURE
      5 x element:
        SequenceId: implementation-data-type=Spi_SequenceType
        JobLinkPtrPhysical: category=DATA_REFERENCE, sw-pointer-target-props={target-category=TYPE_REFERENCE, implementation-data-type=Spi_JobType}
        NoOfJobInSeq: implementation-data-type=uint16
        HwModuleUsed: implementation-data-type=uint8
        u8Comm: implementation-data-type=uint8
