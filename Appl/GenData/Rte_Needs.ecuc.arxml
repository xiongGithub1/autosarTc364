AUTOSAR XML (schema 4-0-3)
package /DaVinci_Project
  module config Rte
    35 x RteBswModuleInstance:
      Adc
      BswM
        BswM_MainFunctionTimingEvent0 (RteBswEventToTaskMapping): RteBswUsedOsEventRef=Rte_Ev_Cyclic2_Default_BSW_ASync_Task_10ms_0_10ms, RteBswUsedOsAlarmRef=Os/Rte_Al_TE2_Default_BSW_ASync_Task_10ms_0_10ms
      Can
        5 x RteBswEventToTaskMapping:
          Can_MainFunction_BusOffTimingEvent0: RteBswUsedOsEventRef=Rte_Ev_Cyclic2_Default_BSW_ASync_Task_10ms_0_10ms, RteBswUsedOsAlarmRef=Os/Rte_Al_TE2_Default_BSW_ASync_Task_10ms_0_10ms
          Can_MainFunction_ModeTimingEvent0: RteBswUsedOsEventRef=Rte_Ev_Cyclic2_Default_BSW_ASync_Task_10ms_0_10ms, RteBswUsedOsAlarmRef=Os/Rte_Al_TE2_Default_BSW_ASync_Task_10ms_0_10ms
          Can_MainFunction_ReadTimingEvent0: RteBswUsedOsEventRef=Rte_Ev_Cyclic2_Default_BSW_ASync_Task_10ms_0_10ms, RteBswUsedOsAlarmRef=Os/Rte_Al_TE2_Default_BSW_ASync_Task_10ms_0_10ms
          Can_MainFunction_WakeupTimingEvent0
          Can_MainFunction_WriteTimingEvent0: RteBswUsedOsEventRef=Rte_Ev_Cyclic2_Default_BSW_ASync_Task_10ms_0_10ms, RteBswUsedOsAlarmRef=Os/Rte_Al_TE2_Default_BSW_ASync_Task_10ms_0_10ms
      CanIf
      CanNm
        CanNm_MainFunctionTimingEvent0 (RteBswEventToTaskMapping)
      CanSM
        CanSM_MainFunctionTimingEvent0 (RteBswEventToTaskMapping): RteBswUsedOsEventRef=Rte_Ev_Cyclic2_Default_BSW_ASync_Task_10ms_0_10ms, RteBswUsedOsAlarmRef=Os/Rte_Al_TE2_Default_BSW_ASync_Task_10ms_0_10ms
      CanTp
        CanTp_MainFunctionTimingEvent0 (RteBswEventToTaskMapping): RteBswUsedOsEventRef=Rte_Ev_Cyclic2_Default_BSW_ASync_Task_10ms_0_5ms, RteBswUsedOsAlarmRef=Os/Rte_Al_TE2_Default_BSW_ASync_Task_10ms_0_5ms
      Com
        Com_MainFunctionRx_ComMainFunctionRxTimingEvent0 (RteBswEventToTaskMapping): RteBswUsedOsEventRef=Rte_Ev_Cyclic2_Default_BSW_ASync_Task_10ms_0_10ms, RteBswUsedOsAlarmRef=Os/Rte_Al_TE2_Default_BSW_ASync_Task_10ms_0_10ms
        Com_MainFunctionTx_ComMainFunctionTxTimingEvent0 (RteBswEventToTaskMapping): RteBswUsedOsEventRef=Rte_Ev_Cyclic2_Default_BSW_ASync_Task_10ms_0_5ms, RteBswUsedOsAlarmRef=Os/Rte_Al_TE2_Default_BSW_ASync_Task_10ms_0_5ms
      ComM
        ComM_MainFunction_0TimingEvent0 (RteBswEventToTaskMapping): RteBswUsedOsEventRef=Rte_Ev_Cyclic2_Default_BSW_ASync_Task_10ms_0_20ms, RteBswUsedOsAlarmRef=Os/Rte_Al_TE2_Default_BSW_ASync_Task_10ms_0_20ms
      ComXf
      Crc
      Dcm
        Dcm_MainFunctionTimingEvent0 (RteBswEventToTaskMapping): RteBswUsedOsEventRef=Rte_Ev_Cyclic2_Default_BSW_ASync_Task_10ms_0_10ms, RteBswUsedOsAlarmRef=Os/Rte_Al_TE2_Default_BSW_ASync_Task_10ms_0_10ms
      Dem
        Dem_MasterMainFunctionTimingEvent0 (RteBswEventToTaskMapping): RteBswUsedOsEventRef=Rte_Ev_Cyclic2_Default_BSW_ASync_Task_10ms_0_10ms, RteBswUsedOsAlarmRef=Os/Rte_Al_TE2_Default_BSW_ASync_Task_10ms_0_10ms
        Dem_SatelliteMainFunctionTimingEvent0 (RteBswEventToTaskMapping): RteBswUsedOsEventRef=Rte_Ev_Cyclic2_Default_BSW_ASync_Task_10ms_0_10ms, RteBswUsedOsAlarmRef=Os/Rte_Al_TE2_Default_BSW_ASync_Task_10ms_0_10ms
      Det
      Dio
      Dma
      Dsadc
      E2EXf
      EcuM
        EcuM_MainFunctionTimingEvent0 (RteBswEventToTaskMapping): RteBswUsedOsEventRef=Rte_Ev_Cyclic2_Default_BSW_ASync_Task_10ms_0_10ms, RteBswUsedOsAlarmRef=Os/Rte_Al_TE2_Default_BSW_ASync_Task_10ms_0_10ms
        EcuM_MainFunctionTimingEvent1 (RteBswEventToTaskMapping): RteBswUsedOsAlarmRef=Os/Rte_Al_TE2_EcuM_EcuM_MainFunction
      Fee
        Fee_MainFunctionTimingEvent0 (RteBswEventToTaskMapping): RteBswUsedOsEventRef=Rte_Ev_Cyclic2_Default_BSW_ASync_Task_10ms_0_10ms, RteBswUsedOsAlarmRef=Os/Rte_Al_TE2_Default_BSW_ASync_Task_10ms_0_10ms
      Fls
        Fls_17_Dmu_MainFunctionTimingEvent0 (RteBswEventToTaskMapping): RteBswUsedOsEventRef=Rte_Ev_Cyclic2_Default_BSW_ASync_Task_10ms_0_10ms, RteBswUsedOsAlarmRef=Os/Rte_Al_TE2_Default_BSW_ASync_Task_10ms_0_10ms
      Irq
      McalLib
      Mcu
      Nm
      NvM
        NvM_MainFunctionTimingEvent0 (RteBswEventToTaskMapping): RteBswUsedOsEventRef=Rte_Ev_Cyclic2_Default_BSW_ASync_Task_10ms_0_10ms, RteBswUsedOsAlarmRef=Os/Rte_Al_TE2_Default_BSW_ASync_Task_10ms_0_10ms
      PduR
      Port
      Pwm
      Sbc
      Spi
        Spi_MainFunction_HandlingTimingEvent0 (RteBswEventToTaskMapping)
      Uart
        Uart_MainFunction_ReadTimingEvent0 (RteBswEventToTaskMapping)
        Uart_MainFunction_WriteTimingEvent0 (RteBswEventToTaskMapping)
      WdgM
        WdgM_MainFunctionTimingEvent0 (RteBswEventToTaskMapping): RteBswUsedOsEventRef=Rte_Ev_Cyclic2_Default_BSW_ASync_Task_10ms_0_10ms, RteBswUsedOsAlarmRef=Os/Rte_Al_TE2_Default_BSW_ASync_Task_10ms_0_10ms
      Wdg
      Xcp
        CanXcp_MainFunctionTimingEvent0 (RteBswEventToTaskMapping): RteBswUsedOsEventRef=Rte_Ev_Cyclic2_Default_BSW_ASync_Task_10ms_0_5ms, RteBswUsedOsAlarmRef=Os/Rte_Al_TE2_Default_BSW_ASync_Task_10ms_0_5ms
        Xcp_MainFunctionTimingEvent0 (RteBswEventToTaskMapping): RteBswUsedOsEventRef=Rte_Ev_Cyclic2_Default_BSW_ASync_Task_10ms_0_5ms, RteBswUsedOsAlarmRef=Os/Rte_Al_TE2_Default_BSW_ASync_Task_10ms_0_5ms
    15 x RteSwComponentInstance:
      BswM_EcuSwComposition
        Timer_BswM_MainFunction (RteEventToTaskMapping): RteUsedOsEventRef=Rte_Ev_Cyclic2_Default_BSW_ASync_Task_10ms_0_10ms, RteUsedOsAlarmRef=Os/Rte_Al_TE2_Default_BSW_ASync_Task_10ms_0_10ms
      ComM_EcuSwComposition
        Timer_ComM_MainFunction_0 (RteEventToTaskMapping): RteUsedOsEventRef=Rte_Ev_Cyclic2_Default_BSW_ASync_Task_10ms_0_20ms, RteUsedOsAlarmRef=Os/Rte_Al_TE2_Default_BSW_ASync_Task_10ms_0_20ms
      Dcm_EcuSwComposition
        Timer_Dcm_MainFunction (RteEventToTaskMapping): RteUsedOsEventRef=Rte_Ev_Cyclic2_Default_BSW_ASync_Task_10ms_0_10ms, RteUsedOsAlarmRef=Os/Rte_Al_TE2_Default_BSW_ASync_Task_10ms_0_10ms
      DemMaster_0_EcuSwComposition
        Timer_Dem_MasterMainFunction (RteEventToTaskMapping): RteUsedOsEventRef=Rte_Ev_Cyclic2_Default_BSW_ASync_Task_10ms_0_10ms, RteUsedOsAlarmRef=Os/Rte_Al_TE2_Default_BSW_ASync_Task_10ms_0_10ms
      DemSatellite_0_EcuSwComposition
        Timer_Dem_SatelliteMainFunction (RteEventToTaskMapping): RteUsedOsEventRef=Rte_Ev_Cyclic2_Default_BSW_ASync_Task_10ms_0_10ms, RteUsedOsAlarmRef=Os/Rte_Al_TE2_Default_BSW_ASync_Task_10ms_0_10ms
      Det_EcuSwComposition
      DigApp_EcuSwComposition
        5 x RteEventToTaskMapping, all with RteUsedOsEventRef=Rte_Ev_Run_DigApp_DcmEcuReset_ModeSwitch:
          MST_DcmEcuReset_ModeSwitch_{0..4}
      EcuM_EcuSwComposition
        Timer_EcuM_MainFunction (RteEventToTaskMapping): RteUsedOsEventRef=Rte_Ev_Cyclic2_Default_BSW_ASync_Task_10ms_0_10ms, RteUsedOsAlarmRef=Os/Rte_Al_TE2_Default_BSW_ASync_Task_10ms_0_10ms
      MotorCdd_EcuSwComposition
        EXTO_AdcSampleReady_Rp_AdcSampleReady_AdcSampleReady (RteEventToTaskMapping): RteUsedOsEventRef=Rte_Ev_Run_MotorCdd_AdcSampleReady_Rp_AdcSampleReady_AdcSampleReady
        TMT_MotorCdd_MainFunction (RteEventToTaskMapping): RteUsedOsEventRef=Rte_Ev_Cyclic_MotorTask_0_1ms, RteUsedOsAlarmRef=Os/Rte_Al_TE_MotorTask_0_1ms
      MotorControll_EcuSwComposition
        TMT_MotorControll_MainFunction (RteEventToTaskMapping): RteUsedOsEventRef=Rte_Ev_Cyclic_MotorTask_0_1ms, RteUsedOsAlarmRef=Os/Rte_Al_TE_MotorTask_0_1ms
      NvM_EcuSwComposition
        Timer_NvM_MainFunction (RteEventToTaskMapping): RteUsedOsEventRef=Rte_Ev_Cyclic2_Default_BSW_ASync_Task_10ms_0_10ms, RteUsedOsAlarmRef=Os/Rte_Al_TE2_Default_BSW_ASync_Task_10ms_0_10ms
      Os_OsCore0_swc_EcuSwComposition
      Os_OsCore1_swc_EcuSwComposition
      StartApp_EcuSwComposition
        4 x RteEventToTaskMapping:
          TMT_StartApp_Cyclic1000ms: RteUsedOsEventRef=Rte_Ev_Run_StartApp_StartApp_Cyclic1000ms, RteUsedOsAlarmRef=Os/Rte_Al_TE_StartApp_StartApp_Cyclic1000ms
          TMT_StartApp_Cyclic10ms: RteUsedOsEventRef=Rte_Ev_Run_StartApp_StartApp_Cyclic10ms, RteUsedOsAlarmRef=Os/Rte_Al_TE_StartApp_StartApp_Cyclic10ms
          TMT_StartApp_Cyclic1ms: RteUsedOsEventRef=Rte_Ev_Run_StartApp_StartApp_Cyclic1ms, RteUsedOsAlarmRef=Os/Rte_Al_TE_StartApp_StartApp_Cyclic1ms
          TMT_StartApp_Cyclic500ms: RteUsedOsEventRef=Rte_Ev_Run_StartApp_StartApp_Cyclic250ms, RteUsedOsAlarmRef=Os/Rte_Al_TE_StartApp_StartApp_Cyclic250ms
      WdgM_SystemApplication_OsCore0_EcuSwComposition
        Timer_WdgM_MainFunction (RteEventToTaskMapping): RteUsedOsEventRef=Rte_Ev_Cyclic2_Default_BSW_ASync_Task_10ms_0_10ms, RteUsedOsAlarmRef=Os/Rte_Al_TE2_Default_BSW_ASync_Task_10ms_0_10ms
    RteOsInteraction
      9 x RteUsedOsActivation, all with RteExpectedActivationOffset=0:
        Rte_Al_TE2_EcuM_EcuM_MainFunction: RteActivationOsAlarmRef=Os/Rte_Al_TE2_EcuM_EcuM_MainFunction, RteActivationOsTaskRef=BswCore1Task
        Rte_Al_TE_StartApp_StartApp_Cyclic1000ms: RteActivationOsAlarmRef=Os/Rte_Al_TE_StartApp_StartApp_Cyclic1000ms, RteActivationOsTaskRef=Default_Appl_Task
        Rte_Al_TE_StartApp_StartApp_Cyclic10ms: RteActivationOsAlarmRef=Os/Rte_Al_TE_StartApp_StartApp_Cyclic10ms, RteActivationOsTaskRef=Default_Appl_Task
        Rte_Al_TE_StartApp_StartApp_Cyclic1ms: RteActivationOsAlarmRef=Os/Rte_Al_TE_StartApp_StartApp_Cyclic1ms, RteActivationOsTaskRef=Default_Appl_Task
        Rte_Al_TE_StartApp_StartApp_Cyclic250ms: RteActivationOsAlarmRef=Os/Rte_Al_TE_StartApp_StartApp_Cyclic250ms, RteActivationOsTaskRef=Default_Appl_Task
        Rte_Al_TE2_Default_BSW_ASync_Task_10ms_0_10ms: RteActivationOsAlarmRef=Os/Rte_Al_TE2_Default_BSW_ASync_Task_10ms_0_10ms, RteActivationOsTaskRef=Default_BSW_ASync_Task_10ms
        Rte_Al_TE2_Default_BSW_ASync_Task_10ms_0_20ms: RteActivationOsAlarmRef=Os/Rte_Al_TE2_Default_BSW_ASync_Task_10ms_0_20ms, RteActivationOsTaskRef=Default_BSW_ASync_Task_10ms
        Rte_Al_TE2_Default_BSW_ASync_Task_10ms_0_5ms: RteActivationOsAlarmRef=Os/Rte_Al_TE2_Default_BSW_ASync_Task_10ms_0_5ms, RteActivationOsTaskRef=Default_BSW_ASync_Task_10ms
        Rte_Al_TE_MotorTask_0_1ms: RteActivationOsAlarmRef=Os/Rte_Al_TE_MotorTask_0_1ms, RteActivationOsTaskRef=MotorTask
  module config NvM
  module config Os
    BswCore1Task (OsTask): OsTaskActivation=1, OsTaskPriority=20, OsTaskSchedule=NON
    Rte_Al_TE2_EcuM_EcuM_MainFunction (OsAlarm): OsAlarmCounterRef=SystemTimer1
      OsAlarmAction
        OsAlarmActivateTask: OsAlarmActivateTaskRef=BswCore1Task
    Default_Appl_Init_Task (OsTask): OsTaskActivation=1, OsTaskPriority=45, OsTaskSchedule=NON
    Default_Appl_Task (OsTask):
      OsTaskActivation = 1
      OsTaskPriority = 5
      OsTaskSchedule = NON
      OsTaskEventRef = Rte_Ev_Run_DigApp_DcmEcuReset_ModeSwitch
      OsTaskEventRef = Rte_Ev_Run_StartApp_StartApp_Cyclic1000ms
      OsTaskEventRef = Rte_Ev_Run_StartApp_StartApp_Cyclic10ms
      OsTaskEventRef = Rte_Ev_Run_StartApp_StartApp_Cyclic1ms
      OsTaskEventRef = Rte_Ev_Run_StartApp_StartApp_Cyclic250ms
    4 x OsAlarm, all with OsAlarmCounterRef=SystemTimer:
      Rte_Al_TE_StartApp_StartApp_Cyclic1000ms
        OsAlarmAction
          OsAlarmSetEvent: OsAlarmSetEventRef=Rte_Ev_Run_StartApp_StartApp_Cyclic1000ms, OsAlarmSetEventTaskRef=Default_Appl_Task
      Rte_Al_TE_StartApp_StartApp_Cyclic10ms
        OsAlarmAction
          OsAlarmSetEvent: OsAlarmSetEventRef=Rte_Ev_Run_StartApp_StartApp_Cyclic10ms, OsAlarmSetEventTaskRef=Default_Appl_Task
      Rte_Al_TE_StartApp_StartApp_Cyclic1ms
        OsAlarmAction
          OsAlarmSetEvent: OsAlarmSetEventRef=Rte_Ev_Run_StartApp_StartApp_Cyclic1ms, OsAlarmSetEventTaskRef=Default_Appl_Task
      Rte_Al_TE_StartApp_StartApp_Cyclic250ms
        OsAlarmAction
          OsAlarmSetEvent: OsAlarmSetEventRef=Rte_Ev_Run_StartApp_StartApp_Cyclic250ms, OsAlarmSetEventTaskRef=Default_Appl_Task
    Default_BSW_ASync_Task_10ms (OsTask):
      OsTaskActivation = 1
      OsTaskPriority = 30
      OsTaskSchedule = NON
      OsTaskEventRef = Rte_Ev_Cyclic2_Default_BSW_ASync_Task_10ms_0_10ms
      OsTaskEventRef = Rte_Ev_Cyclic2_Default_BSW_ASync_Task_10ms_0_20ms
      OsTaskEventRef = Rte_Ev_Cyclic2_Default_BSW_ASync_Task_10ms_0_5ms
    3 x OsAlarm, all with OsAlarmCounterRef=SystemTimer:
      Rte_Al_TE2_Default_BSW_ASync_Task_10ms_0_10ms
        OsAlarmAction
          OsAlarmSetEvent: OsAlarmSetEventRef=Rte_Ev_Cyclic2_Default_BSW_ASync_Task_10ms_0_10ms, OsAlarmSetEventTaskRef=Default_BSW_ASync_Task_10ms
      Rte_Al_TE2_Default_BSW_ASync_Task_10ms_0_20ms
        OsAlarmAction
          OsAlarmSetEvent: OsAlarmSetEventRef=Rte_Ev_Cyclic2_Default_BSW_ASync_Task_10ms_0_20ms, OsAlarmSetEventTaskRef=Default_BSW_ASync_Task_10ms
      Rte_Al_TE2_Default_BSW_ASync_Task_10ms_0_5ms
        OsAlarmAction
          OsAlarmSetEvent: OsAlarmSetEventRef=Rte_Ev_Cyclic2_Default_BSW_ASync_Task_10ms_0_5ms, OsAlarmSetEventTaskRef=Default_BSW_ASync_Task_10ms
    Default_MotorInitTask (OsTask): OsTaskActivation=1, OsTaskPriority=0, OsTaskSchedule=FULL
    MotorTask (OsTask):
      OsTaskActivation = 1
      OsTaskPriority = 100
      OsTaskSchedule = FULL
      OsTaskEventRef = Rte_Ev_Cyclic_MotorTask_0_1ms
      OsTaskEventRef = Rte_Ev_Run_MotorCdd_AdcSampleReady_Rp_AdcSampleReady_AdcSampleReady
    Rte_Al_TE_MotorTask_0_1ms (OsAlarm): OsAlarmCounterRef=SystemTimer1, OsAlarmAccessingApplication=SystemApplication_OsCore0
      OsAlarmAction
        OsAlarmSetEvent: OsAlarmSetEventRef=Rte_Ev_Cyclic_MotorTask_0_1ms, OsAlarmSetEventTaskRef=MotorTask
    10 x OsEvent:
      Rte_Ev_Cyclic2_Default_BSW_ASync_Task_10ms_0_10ms
      Rte_Ev_Cyclic2_Default_BSW_ASync_Task_10ms_0_20ms
      Rte_Ev_Cyclic2_Default_BSW_ASync_Task_10ms_0_5ms
      Rte_Ev_Cyclic_MotorTask_0_1ms
      Rte_Ev_Run_DigApp_DcmEcuReset_ModeSwitch
      Rte_Ev_Run_MotorCdd_AdcSampleReady_Rp_AdcSampleReady_AdcSampleReady
      Rte_Ev_Run_StartApp_StartApp_Cyclic1000ms
      Rte_Ev_Run_StartApp_StartApp_Cyclic10ms
      Rte_Ev_Run_StartApp_StartApp_Cyclic1ms
      Rte_Ev_Run_StartApp_StartApp_Cyclic250ms
    OsApplication_OsCore1 (OsApplication):
      OsTrusted = true
      OsAppTaskRef = BswCore1Task
      OsAppAlarmRef = Os/Rte_Al_TE2_EcuM_EcuM_MainFunction
      OsAppTaskRef = Default_MotorInitTask
      OsAppTaskRef = MotorTask
      OsAppAlarmRef = Os/Rte_Al_TE_MotorTask_0_1ms
    SystemApplication_OsCore0 (OsApplication):
      OsTrusted = true
      OsAppTaskRef = Default_Appl_Init_Task
      OsAppTaskRef = Default_Appl_Task
      OsAppAlarmRef = Os/Rte_Al_TE_StartApp_StartApp_Cyclic1000ms
      OsAppAlarmRef = Os/Rte_Al_TE_StartApp_StartApp_Cyclic10ms
      OsAppAlarmRef = Os/Rte_Al_TE_StartApp_StartApp_Cyclic1ms
      OsAppAlarmRef = Os/Rte_Al_TE_StartApp_StartApp_Cyclic250ms
      OsAppTaskRef = Default_BSW_ASync_Task_10ms
      OsAppAlarmRef = Os/Rte_Al_TE2_Default_BSW_ASync_Task_10ms_0_10ms
      OsAppAlarmRef = Os/Rte_Al_TE2_Default_BSW_ASync_Task_10ms_0_20ms
      OsAppAlarmRef = Os/Rte_Al_TE2_Default_BSW_ASync_Task_10ms_0_5ms
  module config EcuC
  ecuc value collection DaVinci_Project: ecuc-values=[Com, Rte, Os, EcuC, NvM]
