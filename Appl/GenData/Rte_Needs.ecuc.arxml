AUTOSAR XML (schema 4-0-3)
package /DaVinci_Project
  module config Rte
    7 x RteBswModuleInstance:
      BswM
        BswM_MainFunctionTimingEvent0 (RteBswEventToTaskMapping): RteBswUsedOsAlarmRef=Os/Rte_Al_TE2_Default_BSW_ASync_Task_0_10ms
      Det
      Dio
      EcuM
        EcuM_MainFunctionTimingEvent0 (RteBswEventToTaskMapping): RteBswUsedOsAlarmRef=Os/Rte_Al_TE2_Default_BSW_ASync_Task_0_10ms
      McalLib
      Mcu
      Port
    5 x RteSwComponentInstance:
      BswM_EcuSwComposition
        Timer_BswM_MainFunction (RteEventToTaskMapping): RteUsedOsAlarmRef=Os/Rte_Al_TE2_Default_BSW_ASync_Task_0_10ms
      Det_EcuSwComposition
      EcuM_EcuSwComposition
        Timer_EcuM_MainFunction (RteEventToTaskMapping): RteUsedOsAlarmRef=Os/Rte_Al_TE2_Default_BSW_ASync_Task_0_10ms
      Os_OsCore0_swc_EcuSwComposition
      StartApp_EcuSwComposition
        TMT_StartApp_Cyclic1ms (RteEventToTaskMapping): RteUsedOsEventRef=Rte_Ev_Run_StartApp_StartApp_Cyclic1ms, RteUsedOsAlarmRef=Os/Rte_Al_TE_StartApp_StartApp_Cyclic1ms
        TMT_StartApp_Cyclic500ms (RteEventToTaskMapping): RteUsedOsEventRef=Rte_Ev_Run_StartApp_StartApp_Cyclic500ms, RteUsedOsAlarmRef=Os/Rte_Al_TE_StartApp_StartApp_Cyclic500ms
    RteOsInteraction
      3 x RteUsedOsActivation, all with RteExpectedActivationOffset=0:
        Rte_Al_TE_StartApp_StartApp_Cyclic1ms: RteActivationOsAlarmRef=Os/Rte_Al_TE_StartApp_StartApp_Cyclic1ms, RteActivationOsTaskRef=Default_Appl_Task
        Rte_Al_TE_StartApp_StartApp_Cyclic500ms: RteActivationOsAlarmRef=Os/Rte_Al_TE_StartApp_StartApp_Cyclic500ms, RteActivationOsTaskRef=Default_Appl_Task
        Rte_Al_TE2_Default_BSW_ASync_Task_0_10ms: RteActivationOsAlarmRef=Os/Rte_Al_TE2_Default_BSW_ASync_Task_0_10ms, RteActivationOsTaskRef=Default_BSW_ASync_Task
  module config NvM
  module config Os
    Default_Appl_Init_Task (OsTask): OsTaskActivation=1, OsTaskPriority=45, OsTaskSchedule=NON
    Default_Appl_Task (OsTask):
      OsTaskActivation = 1
      OsTaskPriority = 5
      OsTaskSchedule = NON
      OsTaskEventRef = Rte_Ev_Run_StartApp_StartApp_Cyclic1ms
      OsTaskEventRef = Rte_Ev_Run_StartApp_StartApp_Cyclic500ms
    Rte_Al_TE_StartApp_StartApp_Cyclic1ms (OsAlarm): OsAlarmCounterRef=SystemTimer
      OsAlarmAction
        OsAlarmSetEvent: OsAlarmSetEventRef=Rte_Ev_Run_StartApp_StartApp_Cyclic1ms, OsAlarmSetEventTaskRef=Default_Appl_Task
    Rte_Al_TE_StartApp_StartApp_Cyclic500ms (OsAlarm): OsAlarmCounterRef=SystemTimer
      OsAlarmAction
        OsAlarmSetEvent: OsAlarmSetEventRef=Rte_Ev_Run_StartApp_StartApp_Cyclic500ms, OsAlarmSetEventTaskRef=Default_Appl_Task
    Default_BSW_ASync_Task (OsTask): OsTaskActivation=1, OsTaskPriority=30, OsTaskSchedule=NON
    Rte_Al_TE2_Default_BSW_ASync_Task_0_10ms (OsAlarm): OsAlarmCounterRef=SystemTimer
      OsAlarmAction
        OsAlarmActivateTask: OsAlarmActivateTaskRef=Default_BSW_ASync_Task
    Rte_Ev_Run_StartApp_StartApp_Cyclic1ms (OsEvent)
    Rte_Ev_Run_StartApp_StartApp_Cyclic500ms (OsEvent)
  module config EcuC
  ecuc value collection DaVinci_Project: ecuc-values=[Com, Rte, Os, EcuC, NvM]
