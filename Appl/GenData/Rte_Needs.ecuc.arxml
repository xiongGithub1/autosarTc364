AUTOSAR XML (schema 4-0-3)
package /DaVinci_Project
  module config Rte
    20 x RteBswModuleInstance:
      Adc
      BswM
        BswM_MainFunctionTimingEvent0 (RteBswEventToTaskMapping): RteBswUsedOsEventRef=Rte_Ev_Cyclic2_Default_BSW_ASync_Task_0_10ms, RteBswUsedOsAlarmRef=Os/Rte_Al_TE2_Default_BSW_ASync_Task_0_10ms
      Can
        5 x RteBswEventToTaskMapping:
          Can_MainFunction_BusOffTimingEvent0: RteBswUsedOsEventRef=Rte_Ev_Cyclic2_Default_BSW_ASync_Task_0_10ms, RteBswUsedOsAlarmRef=Os/Rte_Al_TE2_Default_BSW_ASync_Task_0_10ms
          Can_MainFunction_ModeTimingEvent0: RteBswUsedOsEventRef=Rte_Ev_Cyclic2_Default_BSW_ASync_Task_0_10ms, RteBswUsedOsAlarmRef=Os/Rte_Al_TE2_Default_BSW_ASync_Task_0_10ms
          Can_MainFunction_ReadTimingEvent0: RteBswUsedOsEventRef=Rte_Ev_Cyclic2_Default_BSW_ASync_Task_0_10ms, RteBswUsedOsAlarmRef=Os/Rte_Al_TE2_Default_BSW_ASync_Task_0_10ms
          Can_MainFunction_WakeupTimingEvent0
          Can_MainFunction_WriteTimingEvent0: RteBswUsedOsEventRef=Rte_Ev_Cyclic2_Default_BSW_ASync_Task_0_10ms, RteBswUsedOsAlarmRef=Os/Rte_Al_TE2_Default_BSW_ASync_Task_0_10ms
      CanIf
      CanSM
        CanSM_MainFunctionTimingEvent0 (RteBswEventToTaskMapping): RteBswUsedOsEventRef=Rte_Ev_Cyclic2_Default_BSW_ASync_Task_0_10ms, RteBswUsedOsAlarmRef=Os/Rte_Al_TE2_Default_BSW_ASync_Task_0_10ms
      Com
        Com_MainFunctionRx_ComMainFunctionRxTimingEvent0 (RteBswEventToTaskMapping): RteBswUsedOsEventRef=Rte_Ev_Cyclic2_Default_BSW_ASync_Task_0_10ms, RteBswUsedOsAlarmRef=Os/Rte_Al_TE2_Default_BSW_ASync_Task_0_10ms
        Com_MainFunctionTx_ComMainFunctionTxTimingEvent0 (RteBswEventToTaskMapping): RteBswUsedOsEventRef=Rte_Ev_Cyclic2_Default_BSW_ASync_Task_0_10ms, RteBswUsedOsAlarmRef=Os/Rte_Al_TE2_Default_BSW_ASync_Task_0_10ms
      ComM
        ComM_MainFunction_0TimingEvent0 (RteBswEventToTaskMapping): RteBswUsedOsEventRef=Rte_Ev_Cyclic2_Default_BSW_ASync_Task_0_20ms, RteBswUsedOsAlarmRef=Os/Rte_Al_TE2_Default_BSW_ASync_Task_0_20ms
      ComXf
      Det
      Dio
      Dma
      E2EXf
      EcuM
        EcuM_MainFunctionTimingEvent0 (RteBswEventToTaskMapping): RteBswUsedOsEventRef=Rte_Ev_Cyclic2_Default_BSW_ASync_Task_0_10ms, RteBswUsedOsAlarmRef=Os/Rte_Al_TE2_Default_BSW_ASync_Task_0_10ms
      Irq
      McalLib
      Mcu
      PduR
      Port
      Pwm
      Spi
        Spi_MainFunction_HandlingTimingEvent0 (RteBswEventToTaskMapping)
    9 x RteSwComponentInstance:
      BswM_EcuSwComposition
        Timer_BswM_MainFunction (RteEventToTaskMapping): RteUsedOsEventRef=Rte_Ev_Cyclic2_Default_BSW_ASync_Task_0_10ms, RteUsedOsAlarmRef=Os/Rte_Al_TE2_Default_BSW_ASync_Task_0_10ms
      ComM_EcuSwComposition
        Timer_ComM_MainFunction_0 (RteEventToTaskMapping): RteUsedOsEventRef=Rte_Ev_Cyclic2_Default_BSW_ASync_Task_0_20ms, RteUsedOsAlarmRef=Os/Rte_Al_TE2_Default_BSW_ASync_Task_0_20ms
      Det_EcuSwComposition
      EcuM_EcuSwComposition
        Timer_EcuM_MainFunction (RteEventToTaskMapping): RteUsedOsEventRef=Rte_Ev_Cyclic2_Default_BSW_ASync_Task_0_10ms, RteUsedOsAlarmRef=Os/Rte_Al_TE2_Default_BSW_ASync_Task_0_10ms
      MotorControll_EcuSwComposition
      Os_OsCore0_swc_EcuSwComposition
      StartApp_EcuSwComposition
        4 x RteEventToTaskMapping:
          TMT_StartApp_Cyclic1000ms: RteUsedOsEventRef=Rte_Ev_Run_StartApp_StartApp_Cyclic1000ms, RteUsedOsAlarmRef=Os/Rte_Al_TE_StartApp_StartApp_Cyclic1000ms
          TMT_StartApp_Cyclic10ms: RteUsedOsEventRef=Rte_Ev_Run_StartApp_StartApp_Cyclic10ms, RteUsedOsAlarmRef=Os/Rte_Al_TE_StartApp_StartApp_Cyclic10ms
          TMT_StartApp_Cyclic1ms: RteUsedOsEventRef=Rte_Ev_Run_StartApp_StartApp_Cyclic1ms, RteUsedOsAlarmRef=Os/Rte_Al_TE_StartApp_StartApp_Cyclic1ms
          TMT_StartApp_Cyclic500ms: RteUsedOsEventRef=Rte_Ev_Run_StartApp_StartApp_Cyclic250ms, RteUsedOsAlarmRef=Os/Rte_Al_TE_StartApp_StartApp_Cyclic250ms
      tle5012BD_CDD_EcuSwComposition
      tle9183_CDD_EcuSwComposition
    RteOsInteraction
      6 x RteUsedOsActivation, all with RteExpectedActivationOffset=0:
        Rte_Al_TE_StartApp_StartApp_Cyclic1000ms: RteActivationOsAlarmRef=Os/Rte_Al_TE_StartApp_StartApp_Cyclic1000ms, RteActivationOsTaskRef=Default_Appl_Task
        Rte_Al_TE_StartApp_StartApp_Cyclic10ms: RteActivationOsAlarmRef=Os/Rte_Al_TE_StartApp_StartApp_Cyclic10ms, RteActivationOsTaskRef=Default_Appl_Task
        Rte_Al_TE_StartApp_StartApp_Cyclic1ms: RteActivationOsAlarmRef=Os/Rte_Al_TE_StartApp_StartApp_Cyclic1ms, RteActivationOsTaskRef=Default_Appl_Task
        Rte_Al_TE_StartApp_StartApp_Cyclic250ms: RteActivationOsAlarmRef=Os/Rte_Al_TE_StartApp_StartApp_Cyclic250ms, RteActivationOsTaskRef=Default_Appl_Task
        Rte_Al_TE2_Default_BSW_ASync_Task_0_10ms: RteActivationOsAlarmRef=Os/Rte_Al_TE2_Default_BSW_ASync_Task_0_10ms, RteActivationOsTaskRef=Default_BSW_ASync_Task
        Rte_Al_TE2_Default_BSW_ASync_Task_0_20ms: RteActivationOsAlarmRef=Os/Rte_Al_TE2_Default_BSW_ASync_Task_0_20ms, RteActivationOsTaskRef=Default_BSW_ASync_Task
  module config NvM
  module config Os
    Default_Appl_Init_Task (OsTask): OsTaskActivation=1, OsTaskPriority=45, OsTaskSchedule=NON
    Default_Appl_Task (OsTask):
      OsTaskActivation = 1
      OsTaskPriority = 5
      OsTaskSchedule = NON
      OsTaskEventRef = Rte_Ev_Run_StartApp_StartApp_Cyclic1000ms
      OsTaskEventRef = Rte_Ev_Run_StartApp_StartApp_Cyclic10ms
      OsTaskEventRef = Rte_Ev_Run_StartApp_StartApp_Cyclic1ms
      OsTaskEventRef = Rte_Ev_Run_StartApp_StartApp_Cyclic250ms
    4 x OsAlarm, all with OsAlarmCounterRef=SystemTimer:
      Rte_Al_TE_StartApp_StartApp_Cyclic1000ms
        OsAlarmAction
          OsAlarmSetEvent: OsAlarmSetEventRef=Rte_Ev_Run_StartApp_StartApp_Cyclic1000ms, OsAlarmSetEventTaskRef=Default_Appl_Task
      Rte_Al_TE_StartApp_StartApp_Cyclic10ms
        OsAlarmAction
          OsAlarmSetEvent: OsAlarmSetEventRef=Rte_Ev_Run_StartApp_StartApp_Cyclic10ms, OsAlarmSetEventTaskRef=Default_Appl_Task
      Rte_Al_TE_StartApp_StartApp_Cyclic1ms
        OsAlarmAction
          OsAlarmSetEvent: OsAlarmSetEventRef=Rte_Ev_Run_StartApp_StartApp_Cyclic1ms, OsAlarmSetEventTaskRef=Default_Appl_Task
      Rte_Al_TE_StartApp_StartApp_Cyclic250ms
        OsAlarmAction
          OsAlarmSetEvent: OsAlarmSetEventRef=Rte_Ev_Run_StartApp_StartApp_Cyclic250ms, OsAlarmSetEventTaskRef=Default_Appl_Task
    Default_BSW_ASync_Task (OsTask):
      OsTaskActivation = 1
      OsTaskPriority = 30
      OsTaskSchedule = NON
      OsTaskEventRef = Rte_Ev_Cyclic2_Default_BSW_ASync_Task_0_10ms
      OsTaskEventRef = Rte_Ev_Cyclic2_Default_BSW_ASync_Task_0_20ms
    Rte_Al_TE2_Default_BSW_ASync_Task_0_10ms (OsAlarm): OsAlarmCounterRef=SystemTimer
      OsAlarmAction
        OsAlarmSetEvent: OsAlarmSetEventRef=Rte_Ev_Cyclic2_Default_BSW_ASync_Task_0_10ms, OsAlarmSetEventTaskRef=Default_BSW_ASync_Task
    Rte_Al_TE2_Default_BSW_ASync_Task_0_20ms (OsAlarm): OsAlarmCounterRef=SystemTimer
      OsAlarmAction
        OsAlarmSetEvent: OsAlarmSetEventRef=Rte_Ev_Cyclic2_Default_BSW_ASync_Task_0_20ms, OsAlarmSetEventTaskRef=Default_BSW_ASync_Task
    6 x OsEvent:
      Rte_Ev_Cyclic2_Default_BSW_ASync_Task_0_10ms
      Rte_Ev_Cyclic2_Default_BSW_ASync_Task_0_20ms
      Rte_Ev_Run_StartApp_StartApp_Cyclic1000ms
      Rte_Ev_Run_StartApp_StartApp_Cyclic10ms
      Rte_Ev_Run_StartApp_StartApp_Cyclic1ms
      Rte_Ev_Run_StartApp_StartApp_Cyclic250ms
  module config EcuC
  ecuc value collection DaVinci_Project: ecuc-values=[Com, Rte, Os, EcuC, NvM]
