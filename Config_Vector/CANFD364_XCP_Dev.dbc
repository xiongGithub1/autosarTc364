VERSION "1.0.0"

NS_ :

BS_:

BU_: CANape MyECU

BO_ 1795 msg_XCP_CTO_Request: 8 CANape
 SG_ XcpCtoRequest : 0|64@1+ (1,0) [0|0] ""  MyECU

BO_ 1796 msg_XCP_CTO_Response: 8 MyECU
 SG_ XcpCtoResponse : 0|64@1+ (1,0) [0|0] ""  CANape

CM_ "DEVELOPMENT-ONLY XCP on CAN transport IDs. Do NOT import into DaVinci Com / series System Extract. Configure CanIf+PduR+Xcp PDUs manually (or via EcuC). CANape may load this DBC only for channel ID reference; A2L remains the calibration object source.";
CM_ BO_ 1795 "XCP CTO Request, standard ID 0x703 (1795). Tester/CANape -> ECU.";
CM_ BO_ 1796 "XCP CTO Response, standard ID 0x704 (1796). ECU -> Tester/CANape.";

BA_DEF_ BO_  "VFrameFormat" ENUM  "StandardCAN","ExtendedCAN","reserved","reserved","reserved","reserved","reserved","reserved","reserved","reserved","reserved","reserved","reserved","reserved","StandardCAN_FD","ExtendedCAN_FD";
BA_DEF_ BO_  "GenMsgILSupport" ENUM  "No","Yes";
BA_DEF_ BO_  "GenMsgSendType" ENUM  "cyclicX","spontanX","cyclicIfActiveX","spontanWithDelay","cyclicAndSpontanX","cyclicAndSpontanWithDelay","spontanWithRepetition","cyclicIfActiveAndSpontanWD","cyclicIfActiveFast","cyclicWithRepeatOnDemand";
BA_DEF_  "Baudrate" INT 0 1000000;
BA_DEF_  "BusType" STRING ;
BA_DEF_  "Manufacturer" STRING ;
BA_DEF_  "DbName" STRING ;
BA_DEF_DEF_  "VFrameFormat" "StandardCAN";
BA_DEF_DEF_  "GenMsgILSupport" "No";
BA_DEF_DEF_  "GenMsgSendType" "spontanX";
BA_DEF_DEF_  "Baudrate" 500000;
BA_DEF_DEF_  "BusType" "CAN";
BA_DEF_DEF_  "Manufacturer" "CLBT";
BA_DEF_DEF_  "DbName" "CANFD364_XCP_Dev";
