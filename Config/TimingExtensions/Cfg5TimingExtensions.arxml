AUTOSAR XML (schema 00048)
package /COM/VECTOR/CFG/TimingExtensions
  ecu timing Cfg5TimingExtension
