AUTOSAR XML (schema 00048)
package /ComponentTypes
  ecu abstraction sw component type IowHa
    behavior IowHa_InternalBehavior
  swc implementation IowHa_Implementation: behavior=IowHa_InternalBehavior
