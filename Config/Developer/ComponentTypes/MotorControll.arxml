AUTOSAR XML (schema 00048)
package /ComponentTypes
  application sw component type MotorControll
    behavior MotorControll_InternalBehavior
      init event MotorControll_InitEvent: start-on-event=MotorControll_Init
      runnable MotorControll_Init
  swc implementation MotorControll_Implementation: behavior=MotorControll_InternalBehavior
