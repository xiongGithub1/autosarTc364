AUTOSAR XML (schema 00048)
package /ComponentTypes
  application sw component type StartApp
    behavior StartApp_InternalBehavior
      init event StartApp_InitEvent: start-on-event=StartApp_Init
      timing event TMT_StartApp_Cyclic1ms: start-on-event=StartApp_Cyclic1ms, period=0.001
      timing event TMT_StartApp_Cyclic500ms: start-on-event=StartApp_Cyclic500ms, period=0.5
      runnable StartApp_Cyclic500ms
      runnable StartApp_Cyclic1ms
      runnable StartApp_Init
  swc implementation StartApp_Implementation: behavior=StartApp_InternalBehavior
