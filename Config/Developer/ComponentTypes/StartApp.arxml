AUTOSAR XML (schema 00048)
package /ComponentTypes
  application sw component type StartApp
    behavior StartApp_InternalBehavior: data-type-mapping=MotorDataTypeMappingSet
      init event StartApp_InitEvent: start-on-event=StartApp_Init
      4 x timing event:
        TMT_StartApp_Cyclic1ms: start-on-event=StartApp_Cyclic1ms, period=0.001
        TMT_StartApp_Cyclic500ms: start-on-event=StartApp_Cyclic250ms, period=0.25
        TMT_StartApp_Cyclic10ms: start-on-event=StartApp_Cyclic10ms, period=0.01
        TMT_StartApp_Cyclic1000ms: start-on-event=StartApp_Cyclic1000ms, period=1
      5 x runnable:
        StartApp_Cyclic250ms
        StartApp_Cyclic1ms
        StartApp_Init
        StartApp_Cyclic10ms
        StartApp_Cyclic1000ms
  swc implementation StartApp_Implementation: behavior=StartApp_InternalBehavior
