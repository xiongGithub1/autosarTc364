AUTOSAR XML (schema 00048)
package /ComponentTypes
  complex device driver sw component type tle9183_CDD
    behavior tle9183_CDD_InternalBehavior
      init event tle9183_CDD_InitEvent: start-on-event=tle9183_CDD_Init
      runnable tle9183_CDD_Init
  swc implementation tle9183_CDD_Implementation: behavior=tle9183_CDD_InternalBehavior
