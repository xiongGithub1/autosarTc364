AUTOSAR XML (schema 00048)
package /ComponentTypes
  complex device driver sw component type tle5012BD_CDD
    behavior tle5012BD_CDD_InternalBehavior
      init event tle5012BD_CDD_InitEvent: start-on-event=tle5012BD_CDD_Init
      runnable tle5012BD_CDD_Init
  swc implementation tle5012BD_CDD_Implementation: behavior=tle5012BD_CDD_InternalBehavior
