AUTOSAR XML (schema 00048)
standard types defined: boolean, uint8
package /ComponentTypes/DataTypeMappingSets
  data type mapping set MotorDataTypeMappingSet
    data-type-maps:
      application-data-type=Iu_current, implementation-data-type=Iu_A
      application-data-type=Iv_current, implementation-data-type=Iv_A
      application-data-type=Iw_current, implementation-data-type=Iw_A
      application-data-type=Id_Act_Current, implementation-data-type=Id_act
      application-data-type=Iq_Act_Current, implementation-data-type=Iq_act
      application-data-type=Id_ref_Current, implementation-data-type=Id_ref
      application-data-type=Iq_Ref_Current, implementation-data-type=Iq_ref
      application-data-type=MechAngle, implementation-data-type=OriginAngle
      application-data-type=MotorMode, implementation-data-type=MotorMd
      application-data-type=Tle9180_OverVoltage_Fault, implementation-data-type=Tle9180_ov_Fault
      application-data-type=ElectricAngle, implementation-data-type=ElecAngle
      application-data-type=MotorSwitch, implementation-data-type=MotorSw
      application-data-type=MotorBusVoltage, implementation-data-type=motorBusV
      application-data-type=Mech_rpm, implementation-data-type=MechRpm
package /Predefined_DEV/ImplementationDataTypes
  impl type NvM_RequestResultType: compu {0=NVM_REQ_OK, 1=NVM_REQ_NOT_OK, 2=NVM_REQ_PENDING, 3=NVM_REQ_INTEGRITY_FAILED, 4=NVM_REQ_BLOCK_SKIPPED, 5=NVM_REQ_NV_INVALIDATED, 6=NVM_REQ_CANCELED, 7=NVM_REQ_REDUNDANCY_FAILED, 8=NVM_REQ_RESTORED_FROM_ROM}, implementation-data-type=uint8
  impl type NvM_ServiceIdType: compu {6=NVM_READ_BLOCK, 7=NVM_WRITE_BLOCK, 8=NVM_RESTORE_BLOCK_DEFAULTS, 9=NVM_ERASE_BLOCK, 11=NVM_INVALIDATE_NV_BLOCK, 12=NVM_READ_ALL}, implementation-data-type=uint8
  impl type Dem_UdsStatusByteType: compu {mask 1: 1=DEM_UDS_STATUS_TF, mask 2: 2=DEM_UDS_STATUS_TFTOC, mask 4: 4=DEM_UDS_STATUS_PDTC, mask 8: 8=DEM_UDS_STATUS_CDTC, mask 16: 16=DEM_UDS_STATUS_TNCSLC, mask 32: 32=DEM_UDS_STATUS_TFSLC, mask 64: 64=DEM_UDS_STATUS_TNCTOC, mask 128: 128=DEM_UDS_STATUS_WIR}, range raw 0..255, implementation-data-type=uint8
package /DataType/Constraint
  range DC_sig_LampCnt: raw 0..255
  range DC_sig_NM_MyECU_CBV: raw 0..255
  range DC_sig_NM_MyECU_UserData_{0..5}: raw 0..255
  range DC_sig_RearInteriorLight: raw 0..1
  range DC_sig_State_RearInteriorLight: raw 0..1
  range DC_sig_State_RearLeftDoor: raw 0..1
  range DC_sig_State_RearRightDoor: raw 0..1
package /DataType/Semantics
  compu method CM_sig_LampCnt: identical
  compu method CM_sig_NM_MyECU_CBV: identical
  compu method CM_sig_NM_MyECU_UserData_{0..5}: identical
  compu method CM_sig_RearInteriorLight: identical
  compu method CM_sig_State_RearInteriorLight: identical
  compu method CM_sig_State_RearLeftDoor: identical
  compu method CM_sig_State_RearRightDoor: identical
package /DataTypes
  9 x app type, all with category=VALUE, sw-calibration-access=READ-ONLY:
    Iu_current: unit=A
    Iv_current: unit=A
    Iw_current: unit=A
    Mech_rpm
    Id_ref_Current
    Iq_Ref_Current
    Id_Act_Current
    Iq_Act_Current
    MotorMode
  5 x impl type, all with category=VALUE, sw-calibration-access=READ-ONLY, type-emitter=RTE:
    Iu_A: base-type=float32
      symbol props Ia: symbol=float32
    Iv_A: base-type=float32
      symbol props Ib: symbol=float32
    Iw_A: base-type=float32
      symbol props Iw: symbol=float32
    OriginAngle: base-type=uint16
      symbol props mechAngle: symbol=uint16
    ElecAngle: base-type=float32
      symbol props elecAngle: symbol=float32
  app type MechAngle: category=VALUE, sw-calibration-access=READ-ONLY
  app type ElectricAngle: category=VALUE, sw-calibration-access=READ-ONLY
  app type MotorBusVoltage: category=VALUE, sw-calibration-access=READ-ONLY
  impl type motorBusV: category=VALUE, base-type=float32, sw-calibration-access=READ-ONLY, type-emitter=RTE
    symbol props motorBusVoltage: symbol=float32
  app type Tle9180_OverVoltage_Fault: category=BOOLEAN, sw-calibration-access=READ-ONLY
  impl type Tle9180_ov_Fault: category=VALUE, base-type=boolean, sw-calibration-access=READ-ONLY, type-emitter=RTE
    symbol props Tle9180_ov_fault: symbol=boolean
  impl type MotorMd: category=VALUE, base-type=uint8, sw-calibration-access=READ-ONLY, type-emitter=RTE
    symbol props motorMd: symbol=uint8
  app type MotorSwitch: category=BOOLEAN, sw-calibration-access=READ-ONLY
  6 x impl type, all with category=VALUE, sw-calibration-access=READ-ONLY, type-emitter=RTE:
    MotorSw: base-type=boolean
      symbol props MotorSw: symbol=boolean
    Id_ref: base-type=float32
      symbol props Id_ref: symbol=float32
    Id_act: base-type=float32
      symbol props Id_act: symbol=float32
    Iq_ref: base-type=float32
      symbol props Iq_ref: symbol=float32
    Iq_act: base-type=float32
      symbol props Iq_act: symbol=float32
    MechRpm: base-type=float32
      symbol props MechRpm: symbol=float32
  app type MotorSpeed_ref: category=VALUE, sw-calibration-access=READ-ONLY
  impl type MotorSpeedRef: category=VALUE, base-type=float32, sw-calibration-access=READ-ONLY, type-emitter=RTE
    symbol props MotorSpeedRef: symbol=float32
package /DataTypes/Units
  unit A
