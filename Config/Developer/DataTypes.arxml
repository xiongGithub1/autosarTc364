AUTOSAR XML (schema 00048)
standard types defined: boolean, uint8, sint16, uint16
package /ComponentTypes/DataTypeMappingSets
  data type mapping set MotorDataTypeMappingSet
    data-type-maps:
      application-data-type=Iu_current, implementation-data-type=Iu_A
      application-data-type=Iv_current, implementation-data-type=Iv_A
      application-data-type=Iw_current, implementation-data-type=Iw_A
      application-data-type=Id_Act_Current, implementation-data-type=Id_act
      application-data-type=Iq_Act_Current, implementation-data-type=Iq_act
      application-data-type=Id_ref_Current, implementation-data-type=Id_ref
      application-data-type=Iq_Ref_Current, implementation-data-type=Iq_ref
      application-data-type=MechAngle, implementation-data-type=OriginAngle
      application-data-type=MotorMode, implementation-data-type=MotorMd
      application-data-type=Tle9180_OverVoltage_Fault, implementation-data-type=Tle9180_ov_Fault
      application-data-type=ElectricAngle, implementation-data-type=ElecAngle
      application-data-type=MotorSwitch, implementation-data-type=MotorSw
      application-data-type=MotorBusVoltage, implementation-data-type=motorBusV
      application-data-type=Mech_rpm, implementation-data-type=MechRpm
package /Predefined_DEV/ImplementationDataTypes
  impl type NvM_RequestResultType: compu {0=NVM_REQ_OK, 1=NVM_REQ_NOT_OK, 2=NVM_REQ_PENDING, 3=NVM_REQ_INTEGRITY_FAILED, 4=NVM_REQ_BLOCK_SKIPPED, 5=NVM_REQ_NV_INVALIDATED, 6=NVM_REQ_CANCELED, 7=NVM_REQ_REDUNDANCY_FAILED, 8=NVM_REQ_RESTORED_FROM_ROM}, implementation-data-type=uint8
  impl type NvM_ServiceIdType: compu {6=NVM_READ_BLOCK, 7=NVM_WRITE_BLOCK, 8=NVM_RESTORE_BLOCK_DEFAULTS, 9=NVM_ERASE_BLOCK, 11=NVM_INVALIDATE_NV_BLOCK, 12=NVM_READ_ALL}, implementation-data-type=uint8
  impl type Dem_UdsStatusByteType: compu {mask 1: 1=DEM_UDS_STATUS_TF, mask 2: 2=DEM_UDS_STATUS_TFTOC, mask 4: 4=DEM_UDS_STATUS_PDTC, mask 8: 8=DEM_UDS_STATUS_CDTC, mask 16: 16=DEM_UDS_STATUS_TNCSLC, mask 32: 32=DEM_UDS_STATUS_TFSLC, mask 64: 64=DEM_UDS_STATUS_TNCTOC, mask 128: 128=DEM_UDS_STATUS_WIR}, range raw 0..255, implementation-data-type=uint8
package /DataType
  base type uint8_8_none: category=FIXED_LENGTH, base-type-size=8, base-type-encoding=NONE
package /DataType/Constraint
  range DC_sig_LampCnt: raw 0..255
  range DC_sig_NM_MyECU_CBV: raw 0..255
  range DC_sig_NM_MyECU_UserData_{0..5}: raw 0..255
  range DC_sig_RearInteriorLight: raw 0..1
  range DC_sig_State_RearInteriorLight: raw 0..1
  range DC_sig_State_RearLeftDoor: raw 0..1
  range DC_sig_State_RearRightDoor: raw 0..1
  range DC_MotorFoc_AdcFilterAlpha: raw 0..100
  range DC_MotorFoc_AdcFilterEnabled: raw 0..1
  range DC_MotorFoc_AdcFilterReady: raw 0..1
  range DC_MotorFoc_AdcOffsetSampleCount: raw 0..65535
  range DC_MotorFoc_AdcOffsetVo{1..3}: raw -32768..32767
  range DC_MotorFoc_AdcSyncCounter: raw 0..65535
  range DC_MotorFoc_AngleRaw: raw 0..65535
  range DC_MotorFoc_CurrentOffsetReady: raw 0..1
  range DC_MotorFoc_CurrentOffsetSampleCount: raw 0..255
  range DC_MotorFoc_ElectricalAngle_rad: raw -32768..32767
  range DC_MotorFoc_Fault: raw 0..1
  range DC_MotorFoc_FaultIu_A: raw -32768..32767
  range DC_MotorFoc_FaultIv_A: raw -32768..32767
  range DC_MotorFoc_FaultIw_A: raw -32768..32767
  range DC_MotorFoc_FaultPwm: raw 0..1
  range DC_MotorFoc_FaultReason: raw 0..255
  range DC_MotorFoc_FaultReasonPwm: raw 0..255
  range DC_MotorFoc_FaultVdc_V: raw -32768..32767
  range DC_MotorFoc_GateDriverOutputEnabled: raw 0..1
  range DC_MotorFoc_GateDriverState: raw 0..255
  range DC_MotorFoc_Id_A: raw -32768..32767
  range DC_MotorFoc_IdRef_A: raw -32768..32767
  range DC_MotorFoc_Iq_A: raw -32768..32767
  range DC_MotorFoc_IqRef_A: raw -32768..32767
  range DC_MotorFoc_Iu_A: raw -32768..32767
  range DC_MotorFoc_IuFiltered_A: raw -32768..32767
  range DC_MotorFoc_IuRaw_A: raw -32768..32767
  range DC_MotorFoc_Iv_A: raw -32768..32767
  range DC_MotorFoc_IvFiltered_A: raw -32768..32767
  range DC_MotorFoc_IvRaw_A: raw -32768..32767
  range DC_MotorFoc_Iw_A: raw -32768..32767
  range DC_MotorFoc_IwFiltered_A: raw -32768..32767
  range DC_MotorFoc_IwRaw_A: raw -32768..32767
  range DC_MotorFoc_MechanicalSpeed_rpm: raw -32768..32767
  range DC_MotorFoc_MotorMode: raw 0..255
  range DC_MotorFoc_MotorModePwm: raw 0..255
  range DC_MotorFoc_Page: raw 0..255
  range DC_MotorFoc_PwmPeriod: raw 0..65535
  range DC_MotorFoc_PwmU: raw 0..65535
  range DC_MotorFoc_PwmV: raw 0..65535
  range DC_MotorFoc_PwmW: raw 0..65535
  range DC_MotorFoc_Sequence: raw 0..65535
  range DC_MotorFoc_ValphaRef_V: raw -32768..32767
  range DC_MotorFoc_VbetaRef_V: raw -32768..32767
  range DC_MotorFoc_Vdc_V: raw -32768..32767
  range DC_MotorFoc_VdcMax_V: raw -32768..32767
  range DC_MotorFoc_VdRef_V: raw -32768..32767
  range DC_MotorFoc_Vinv_V: raw -32768..32767
  range DC_MotorFoc_VqRef_V: raw -32768..32767
  range DC_MotorFoc_Vro_V: raw -32768..32767
  range DC_ElectricAngle: raw -32768..32767
  range DC_Id_Ref: raw -32768..32767
  range DC_Iq_Ref: raw -32768..32767
  range DC_MotorMode: raw 0..7
  range DC_Signal_XCP_Request_MyECU: raw 0..18446744073709551615
  range DC_Signal_XCP_Response_MyECU: raw 0..18446744073709551615
  range DC_tle9180_Ov_Fault: raw 0..1
  range DC_Vbus: raw -32768..32767
package /DataType/Semantics
  compu method CM_sig_LampCnt: identical
  compu method CM_sig_NM_MyECU_CBV: identical
  compu method CM_sig_NM_MyECU_UserData_{0..5}: identical
  compu method CM_sig_RearInteriorLight: identical
  compu method CM_sig_State_RearInteriorLight: identical
  compu method CM_sig_State_RearLeftDoor: identical
  compu method CM_sig_State_RearRightDoor: identical
  compu method CM_MotorFoc_AdcFilterAlpha: phys=raw*0.01 for raw 0..100
  compu method CM_MotorFoc_AdcFilterEnabled: identical
  compu method CM_MotorFoc_AdcFilterReady: identical
  compu method CM_MotorFoc_AdcOffsetSampleCount: identical
  compu method CM_MotorFoc_AdcOffsetVo{1..3}: identical
  compu method CM_MotorFoc_AdcSyncCounter: identical
  compu method CM_MotorFoc_AngleRaw: identical
  compu method CM_MotorFoc_CurrentOffsetReady: identical
  compu method CM_MotorFoc_CurrentOffsetSampleCount: identical
  compu method CM_MotorFoc_ElectricalAngle_rad: phys=raw*0.001 for raw -32768..32767; unit rad
  compu method CM_MotorFoc_Fault: identical
  compu method CM_MotorFoc_FaultIu_A: phys=raw*0.01 for raw -32768..32767; unit A
  compu method CM_MotorFoc_FaultIv_A: phys=raw*0.01 for raw -32768..32767; unit A
  compu method CM_MotorFoc_FaultIw_A: phys=raw*0.01 for raw -32768..32767; unit A
  compu method CM_MotorFoc_FaultPwm: identical
  compu method CM_MotorFoc_FaultReason: 0=Cx00_None, 1=Cx01_UnderVoltage, 2=Cx02_OverCurrent
  compu method CM_MotorFoc_FaultReasonPwm: 0=Cx00_None, 1=Cx01_UnderVoltage, 2=Cx02_OverCurrent
  compu method CM_MotorFoc_FaultVdc_V: phys=raw*0.1 for raw -32768..32767; unit V
  compu method CM_MotorFoc_GateDriverOutputEnabled: identical
  compu method CM_MotorFoc_GateDriverState: identical
  compu method CM_MotorFoc_Id_A: phys=raw*0.01 for raw -32768..32767; unit A
  compu method CM_MotorFoc_IdRef_A: phys=raw*0.01 for raw -32768..32767; unit A
  compu method CM_MotorFoc_Iq_A: phys=raw*0.01 for raw -32768..32767; unit A
  compu method CM_MotorFoc_IqRef_A: phys=raw*0.01 for raw -32768..32767; unit A
  compu method CM_MotorFoc_Iu_A: phys=raw*0.01 for raw -32768..32767; unit A
  compu method CM_MotorFoc_IuFiltered_A: phys=raw*0.01 for raw -32768..32767; unit A
  compu method CM_MotorFoc_IuRaw_A: phys=raw*0.01 for raw -32768..32767; unit A
  compu method CM_MotorFoc_Iv_A: phys=raw*0.01 for raw -32768..32767; unit A
  compu method CM_MotorFoc_IvFiltered_A: phys=raw*0.01 for raw -32768..32767; unit A
  compu method CM_MotorFoc_IvRaw_A: phys=raw*0.01 for raw -32768..32767; unit A
  compu method CM_MotorFoc_Iw_A: phys=raw*0.01 for raw -32768..32767; unit A
  compu method CM_MotorFoc_IwFiltered_A: phys=raw*0.01 for raw -32768..32767; unit A
  compu method CM_MotorFoc_IwRaw_A: phys=raw*0.01 for raw -32768..32767; unit A
  compu method CM_MotorFoc_MechanicalSpeed_rpm: identical
  compu method CM_MotorFoc_MotorMode: 0=Cx00_Idle, 1=Cx01_Stop, 2=Cx02_FocSpeed, 3=Cx03_FocCurrent, 4=Cx04_OpenLoop, 5=Cx05_Calibration, 6=Cx06_CalibrationErase
  compu method CM_MotorFoc_MotorModePwm: 0=Cx00_Idle, 1=Cx01_Stop, 2=Cx02_FocSpeed, 3=Cx03_FocCurrent, 4=Cx04_OpenLoop, 5=Cx05_Calibration, 6=Cx06_CalibrationErase
  compu method CM_MotorFoc_Page: 160=CxA0_Control, 161=CxA1_Pwm, 162=CxA2_Adc
  compu method CM_MotorFoc_PwmPeriod: identical
  compu method CM_MotorFoc_PwmU: identical
  compu method CM_MotorFoc_PwmV: identical
  compu method CM_MotorFoc_PwmW: identical
  compu method CM_MotorFoc_Sequence: identical
  compu method CM_MotorFoc_ValphaRef_V: phys=raw*0.001 for raw -32768..32767; unit V
  compu method CM_MotorFoc_VbetaRef_V: phys=raw*0.001 for raw -32768..32767; unit V
  compu method CM_MotorFoc_Vdc_V: phys=raw*0.1 for raw -32768..32767; unit V
  compu method CM_MotorFoc_VdcMax_V: phys=raw*0.1 for raw -32768..32767; unit V
  compu method CM_MotorFoc_VdRef_V: phys=raw*0.001 for raw -32768..32767; unit V
  compu method CM_MotorFoc_Vinv_V: phys=raw*0.001 for raw -32768..32767; unit V
  compu method CM_MotorFoc_VqRef_V: phys=raw*0.001 for raw -32768..32767; unit V
  compu method CM_MotorFoc_Vro_V: phys=raw*0.001 for raw -32768..32767; unit V
  compu method CM_ElectricAngle: phys=raw*0.001 for raw -32768..32767; unit rad
  compu method CM_Id_Ref: phys=raw*0.01 for raw -32768..32767; unit A
  compu method CM_Iq_Ref: phys=raw*0.01 for raw -32768..32767; unit A
  compu method CM_MotorMode: 0=Cx00_Idle, 1=Cx01_Stop, 2=Cx02_FocSpeed, 3=Cx03_FocCurrent, 4=Cx04_OpenLoop, 5=Cx05_Calibration, 6=Cx06_CalibrationErase, 7=Cx07_CalibrationSave
  compu method CM_Signal_XCP_Request_MyECU: identical
  compu method CM_Signal_XCP_Response_MyECU: identical
  compu method CM_tle9180_Ov_Fault: 0=Cx0_NoFault, 1=Cx1_OverVoltageFault
  compu method CM_Vbus: phys=raw*0.1 for raw -32768..32767; unit V
package /DataType/Unit
  7 x unit:
    U_A: display-name=A, factor-si-to-unit=1, offset-si-to-unit=0
    U_count: display-name=count
    U_rad: display-name=rad, factor-si-to-unit=1, offset-si-to-unit=0
    U_rpm: display-name=rpm
    U_sample: display-name=sample
    U_tick: display-name=tick
    U_V: display-name=V, factor-si-to-unit=1, offset-si-to-unit=0
package /DataTypes
  9 x app type, all with category=VALUE:
    Iu_current: sw-calibration-access=READ-ONLY, unit=A
    Iv_current: sw-calibration-access=READ-ONLY, unit=A
    Iw_current: sw-calibration-access=READ-ONLY, unit=A
    Mech_rpm: sw-calibration-access=READ-ONLY
    Id_ref_Current: sw-calibration-access=READ-ONLY
    Iq_Ref_Current: sw-calibration-access=READ-ONLY
    Id_Act_Current: sw-calibration-access=READ-ONLY
    Iq_Act_Current: sw-calibration-access=READ-ONLY
    MotorMode: sw-calibration-access=READ-WRITE
  5 x impl type, all with category=VALUE, sw-calibration-access=READ-ONLY, type-emitter=RTE:
    Iu_A: base-type=float32
      symbol props Ia: symbol=float32
    Iv_A: base-type=float32
      symbol props Ib: symbol=float32
    Iw_A: base-type=float32
      symbol props Iw: symbol=float32
    OriginAngle: base-type=uint16
      symbol props mechAngle: symbol=uint16
    ElecAngle: base-type=float32
      symbol props elecAngle: symbol=float32
  app type MechAngle: category=VALUE, sw-calibration-access=READ-ONLY
  app type ElectricAngle: category=VALUE, sw-calibration-access=READ-ONLY
  app type MotorBusVoltage: category=VALUE, sw-calibration-access=READ-ONLY
  impl type motorBusV: category=VALUE, base-type=float32, sw-calibration-access=READ-ONLY, type-emitter=RTE
    symbol props motorBusVoltage: symbol=float32
  app type Tle9180_OverVoltage_Fault: category=BOOLEAN, sw-calibration-access=READ-ONLY
  impl type Tle9180_ov_Fault: category=VALUE, base-type=boolean, sw-calibration-access=READ-ONLY, type-emitter=RTE
    symbol props Tle9180_ov_fault: symbol=boolean
  impl type MotorMd: category=VALUE, base-type=uint8, sw-calibration-access=READ-ONLY, type-emitter=RTE
    symbol props motorMd: symbol=uint8
  app type MotorSwitch: category=BOOLEAN, sw-calibration-access=READ-ONLY
  6 x impl type, all with category=VALUE, sw-calibration-access=READ-ONLY, type-emitter=RTE:
    MotorSw: base-type=boolean
      symbol props MotorSw: symbol=boolean
    Id_ref: base-type=float32
      symbol props Id_ref: symbol=float32
    Id_act: base-type=float32
      symbol props Id_act: symbol=float32
    Iq_ref: base-type=float32
      symbol props Iq_ref: symbol=float32
    Iq_act: base-type=float32
      symbol props Iq_act: symbol=float32
    MechRpm: base-type=float32
      symbol props MechRpm: symbol=float32
  app type MotorSpeed_ref: category=VALUE, sw-calibration-access=READ-ONLY
  impl type MotorSpeedRef: category=VALUE, base-type=float32, sw-calibration-access=READ-ONLY, type-emitter=RTE
    symbol props MotorSpeedRef: symbol=float32
package /DataTypes/Units
  unit A
