AUTOSAR XML (schema 00048)
package /VehicleProject
  system System
    root-software-compositions:
      root sw composition prototype EcuSwComposition: software-composition=ECU_Composition
package /ECUCompositionTypes
  composition sw component type ECU_Composition
    4 x component:
      StartApp: type=StartApp
      MotorControll: type=MotorControll
      MotorCdd: type=MotorCdd
      DigApp: type=DigApp
    connect MotorCdd.Pp_MotorDcBusVoltage -> MotorControll.Pp_MotorDcBusVoltage
    connect MotorCdd.Pp_MotorElectricalAngle -> MotorControll.Pp_MotorElectricalAngle
    connect MotorCdd.Pp_MotorFaultStatus -> MotorControll.Pp_MotorFaultStatus
    connect MotorControll.Pp_MotorCtrlCmd -> MotorCdd.Pp_MotorCtrlCmd
    connect MotorControll.Pp_MotorCurrentRef -> MotorCdd.Pp_MotorCurrentRef
package /EndToEndProtections
  end to end protection set EndToEndProtectionSet
