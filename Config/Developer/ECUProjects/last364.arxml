AUTOSAR XML (schema 00048)
package /VehicleProject
  system System
    root-software-compositions:
      root sw composition prototype EcuSwComposition: software-composition=ECU_Composition
package /ECUCompositionTypes
  composition sw component type ECU_Composition
    4 x component:
      StartApp: type=StartApp
      MotorControll: type=MotorControll
      tle5012BD_CDD: type=tle5012BD_CDD
      tle9183_CDD: type=tle9183_CDD
package /EndToEndProtections
  end to end protection set EndToEndProtectionSet
