AUTOSAR XML (schema 00048)
package /ECUCompositionTypes
  composition sw component type ECU_Composition
    component StartApp: type=StartApp
package /EndToEndProtections
  end to end protection set EndToEndProtectionSet
package /Systems
  system last364
    root-software-compositions:
      root sw composition prototype EcuSwComposition: software-composition=ECU_Composition
