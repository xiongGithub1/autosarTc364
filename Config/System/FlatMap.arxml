AUTOSAR XML (schema 00050)
package /COM/VECTOR/CFG/WORKFLOW/SYSDESC/SYNC
  flat map FLATMAP
    4 x flat instance descriptor:
      StartApp: upstream-reference=EcuSwComposition.StartApp, ecu-extract-reference=COMPOSITIONTYPE.StartApp
      MotorControll: upstream-reference=EcuSwComposition.MotorControll, ecu-extract-reference=COMPOSITIONTYPE.MotorControll
      tle5012BD_CDD: upstream-reference=EcuSwComposition.tle5012BD_CDD, ecu-extract-reference=COMPOSITIONTYPE.tle5012BD_CDD
      tle9183_CDD: upstream-reference=EcuSwComposition.tle9183_CDD, ecu-extract-reference=COMPOSITIONTYPE.tle9183_CDD
