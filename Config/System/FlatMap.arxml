AUTOSAR XML (schema 00050)
package /COM/VECTOR/CFG/WORKFLOW/SYSDESC/SYNC
  flat map FLATMAP
    4 x flat instance descriptor:
      StartApp: upstream-reference=EcuSwComposition.StartApp, ecu-extract-reference=COMPOSITIONTYPE.StartApp
      MotorControll: upstream-reference=EcuSwComposition.MotorControll, ecu-extract-reference=COMPOSITIONTYPE.MotorControll
      MotorCdd: upstream-reference=EcuSwComposition.MotorCdd, ecu-extract-reference=COMPOSITIONTYPE.MotorCdd
      DigApp: upstream-reference=EcuSwComposition.DigApp, ecu-extract-reference=COMPOSITIONTYPE.DigApp
