AUTOSAR XML (schema 00050)
package /COM/VECTOR/CFG/WORKFLOW/SYSDESC/SYNC
  flat map FLATMAP
    flat instance descriptor StartApp: upstream-reference=EcuSwComposition.StartApp, ecu-extract-reference=COMPOSITIONTYPE.StartApp
    flat instance descriptor MotorControll: upstream-reference=EcuSwComposition.MotorControll, ecu-extract-reference=COMPOSITIONTYPE.MotorControll
    flat instance descriptor MotorCdd: upstream-reference=EcuSwComposition.MotorCdd, ecu-extract-reference=COMPOSITIONTYPE.MotorCdd
