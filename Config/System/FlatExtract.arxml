AUTOSAR XML (schema 00050)
package /COM/VECTOR/CFG/WORKFLOW/SYSDESC/SYNC
  system SYSTEM: category=ECU_EXTRACT
    system mapping MAPPINGS
    root-software-compositions:
      root sw composition prototype COMPOSITIONTYPE: flat-map=FLATMAP, software-composition=COMPOSITIONTYPE
  composition sw component type COMPOSITIONTYPE  # UB:Derived from original system description
    14 x component:
      Det: type=Det
      Os_OsCore0_swc: type=Os_OsCore0_swc
      BswM: type=BswM
      StartApp: type=StartApp
      ComM: type=ComM
      EcuM: type=EcuM
      MotorControll: type=MotorControll
      MotorCdd: type=MotorCdd
      NvM: type=NvM
      Os_OsCore1_swc: type=Os_OsCore1_swc
      DemMaster_0: type=DemMaster_0
      DemSatellite_0: type=DemSatellite_0
      Dcm: type=Dcm
      DigApp: type=DigApp
    connect MotorCdd.Pp_MotorCdd_EnableInverter -> MotorControll.Pp_MotorCdd_EnableInverter
    connect MotorCdd.Pp_MotorDcBusVoltage -> MotorControll.Pp_MotorDcBusVoltage  # UB:Derived from original system description
    connect MotorCdd.Pp_MotorElectricalAngle -> MotorControll.Pp_MotorElectricalAngle  # UB:Derived from original system description
    connect MotorCdd.Pp_MotorFaultStatus -> MotorControll.Pp_MotorFaultStatus  # UB:Derived from original system description
    connect MotorControll.Pp_MotorCtrlCmd -> MotorCdd.Pp_MotorCtrlCmd  # UB:Derived from original system description
    connect MotorControll.Pp_MotorCurrentRef -> MotorCdd.Pp_MotorCurrentRef  # UB:Derived from original system description
    connect EcuM.StateRequest_EcuMConf_EcuMFixedUserConfig_EcuMFixedUserConfig -> StartApp.EcuM_StateRequest
    connect ComM.UR_CN_CAN00_06ecbb07 -> StartApp.ComM_UserRequest
    connect DigApp.DataServices_Boot_Software_Boot_Software_Identification -> Dcm.DataServices_Boot_Software_Boot_Software_Identification
    connect DigApp.DataServices_Example_ReadWriteData_GlobalTime -> Dcm.DataServices_Example_ReadWriteData_GlobalTime
    connect DigApp.RoutineServices_SampleRoutineControl_StartOnly -> Dcm.RoutineServices_SampleRoutineControl_StartOnly
    connect DigApp.DataServices_DID_0xF413_DID_Data -> Dcm.DataServices_DID_0xF413_DID_Data
    connect DigApp.DataServices_Vehicle_Identification_VIN -> Dcm.DataServices_Vehicle_Identification_VIN
    connect DigApp.DataServices_DID_0xF412_DID_Data -> Dcm.DataServices_DID_0xF412_DID_Data
    connect DigApp.SecurityAccess_Level_3 -> Dcm.SecurityAccess_Level_3
    connect DigApp.DataServices_SerialNumber_SerialNumber -> Dcm.DataServices_SerialNumber_SerialNumber
    connect DigApp.DataServices_SampleIoControl_DID_Data -> Dcm.DataServices_SampleIoControl_DID_Data
    connect DigApp.DataServices_Hardware_Version_Hardware_Version_Number -> Dcm.DataServices_Hardware_Version_Hardware_Version_Number
    connect DigApp.DataServices_Spare_Part_Number_Spare_Part_Number -> Dcm.DataServices_Spare_Part_Number_Spare_Part_Number
    connect DigApp.DataServices_DataDiagnosticIdentifier_DID_DataDiagnosticIdentifier -> Dcm.DataServices_DataDiagnosticIdentifier_DID_DataDiagnosticIdentifier
    connect DigApp.DataServices_Example_ReadOnlyDID_DID_Data_GlobalTime -> Dcm.DataServices_Example_ReadOnlyDID_DID_Data_GlobalTime
    connect DigApp.DataServices_DID_0xF410_DID_Data -> Dcm.DataServices_DID_0xF410_DID_Data
    connect DigApp.SecurityAccess_UnlockedL1 -> Dcm.SecurityAccess_UnlockedL1
    connect DigApp.DataServices_Boot_Software_NumberOfModules -> Dcm.DataServices_Boot_Software_NumberOfModules
    connect DigApp.DataServices_EcuIdentification_Part_Number -> Dcm.DataServices_EcuIdentification_Part_Number
    connect DigApp.RoutineServices_SampleRoutineControl -> Dcm.RoutineServices_SampleRoutineControl
  end to end protection set E2EPROTECTIONSET
  port interface mapping set PORTINTERFACEMAPPINGSET
