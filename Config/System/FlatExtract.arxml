AUTOSAR XML (schema 00050)
package /COM/VECTOR/CFG/WORKFLOW/SYSDESC/SYNC
  system SYSTEM: category=ECU_EXTRACT
    system mapping MAPPINGS
    root-software-compositions:
      root sw composition prototype COMPOSITIONTYPE: flat-map=FLATMAP, software-composition=COMPOSITIONTYPE
  composition sw component type COMPOSITIONTYPE  # UB:Derived from original system description
    9 x component:
      Det: type=Det
      Os_OsCore0_swc: type=Os_OsCore0_swc
      BswM: type=BswM
      StartApp: type=StartApp
      ComM: type=ComM
      EcuM: type=EcuM
      MotorControll: type=MotorControll
      tle5012BD_CDD: type=tle5012BD_CDD
      tle9183_CDD: type=tle9183_CDD
  end to end protection set E2EPROTECTIONSET
  port interface mapping set PORTINTERFACEMAPPINGSET
