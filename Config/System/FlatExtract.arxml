AUTOSAR XML (schema 00050)
package /COM/VECTOR/CFG/WORKFLOW/SYSDESC/SYNC
  system SYSTEM: category=ECU_EXTRACT
    system mapping MAPPINGS
    root-software-compositions:
      root sw composition prototype COMPOSITIONTYPE: flat-map=FLATMAP, software-composition=COMPOSITIONTYPE
  composition sw component type COMPOSITIONTYPE  # UB:Derived from original system description
    13 x component:
      Det: type=Det
      Os_OsCore0_swc: type=Os_OsCore0_swc
      BswM: type=BswM
      StartApp: type=StartApp
      ComM: type=ComM
      EcuM: type=EcuM
      MotorControll: type=MotorControll
      MotorCdd: type=MotorCdd
      NvM: type=NvM
      Os_OsCore1_swc: type=Os_OsCore1_swc
      DemMaster_0: type=DemMaster_0
      DemSatellite_0: type=DemSatellite_0
      Dcm: type=Dcm
    connect MotorCdd.Pp_MotorCdd_EnableInverter -> MotorControll.Pp_MotorCdd_EnableInverter
    connect MotorCdd.Pp_MotorDcBusVoltage -> MotorControll.Pp_MotorDcBusVoltage  # UB:Derived from original system description
    connect MotorCdd.Pp_MotorElectricalAngle -> MotorControll.Pp_MotorElectricalAngle  # UB:Derived from original system description
    connect MotorCdd.Pp_MotorFaultStatus -> MotorControll.Pp_MotorFaultStatus  # UB:Derived from original system description
    connect MotorControll.Pp_MotorCtrlCmd -> MotorCdd.Pp_MotorCtrlCmd  # UB:Derived from original system description
    connect MotorControll.Pp_MotorCurrentRef -> MotorCdd.Pp_MotorCurrentRef  # UB:Derived from original system description
    connect EcuM.StateRequest_EcuMConf_EcuMFixedUserConfig_EcuMFixedUserConfig -> StartApp.EcuM_StateRequest
    connect ComM.UR_CN_CAN00_06ecbb07 -> StartApp.ComM_UserRequest
  end to end protection set E2EPROTECTIONSET
  port interface mapping set PORTINTERFACEMAPPINGSET
