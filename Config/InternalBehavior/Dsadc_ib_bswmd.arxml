AUTOSAR XML (schema 00048)
package /AURIX2G/EcucDefs/Dsadc_ib_bswmd/BswModuleDescriptions
  bsw module description Dsadc
    bsw internal behavior DsadcBehavior
      exclusive area ChannelData
      exclusive area IntegratorRestart
