AUTOSAR XML (schema 00048)
package /MICROSAR
  bsw implementation E2EXf_Impl: programming-language=C, sw-version=1.16.00, used-code-generator=DaVinci Configurator, vendor-id=30, ar-release-version=4.03.01
    resource consumption ResourceConsumption
      13 x memory section:
        CODE: sw-addrmethod=CODE
        CONST_UNSPECIFIED: sw-addrmethod=CONST
        VAR_INIT_UNSPECIFIED: sw-addrmethod=SystemApplication_OsCore0_VAR_INIT
        VAR_NOINIT_UNSPECIFIED: sw-addrmethod=SystemApplication_OsCore0_VAR_NO_INIT
        VAR_ZERO_INIT_8BIT: sw-addrmethod=SystemApplication_OsCore0_VAR_INIT
        VAR_NOCACHE_ZERO_INIT_8BIT: sw-addrmethod=SystemApplication_OsCore0_VAR_NOCACHE_INIT
        VAR_ZERO_INIT_UNSPECIFIED: sw-addrmethod=SystemApplication_OsCore0_VAR_INIT
        CODE_OsApplication_OsCore1: sw-addrmethod=CODE
        CODE_SystemApplication_OsCore0: sw-addrmethod=CODE
        VAR_OsApplication_OsCore1_INIT_UNSPECIFIED: sw-addrmethod=OsApplication_OsCore1_VAR_INIT
        VAR_OsApplication_OsCore1_NOINIT_UNSPECIFIED: sw-addrmethod=OsApplication_OsCore1_VAR_NO_INIT
        VAR_SystemApplication_OsCore0_INIT_UNSPECIFIED: sw-addrmethod=SystemApplication_OsCore0_VAR_INIT
        VAR_SystemApplication_OsCore0_NOINIT_UNSPECIFIED: sw-addrmethod=SystemApplication_OsCore0_VAR_NO_INIT
package /MICROSAR/E2EXf_ib_bswmd/BswModuleDescriptions
  bsw module description E2EXf
    bsw internal behavior E2EXfBehavior
