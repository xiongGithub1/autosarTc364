AUTOSAR XML (schema 00048)
package /MICROSAR/Sbc_ib_bswmd/BswModuleDescriptions
  bsw module description Sbc
    bsw internal behavior Sbc_Behavior
      5 x exclusive area:
        SBC_EXCLUSIVE_AREA_{0..4}
