AUTOSAR XML (schema 00048)
package /MICROSAR
  bsw implementation Rte_Impl: programming-language=C, sw-version=4.29.00, used-code-generator=DaVinci Configurator, vendor-id=30, ar-release-version=4.03.01
    resource consumption ResourceConsumption
      23 x memory section:
        CODE: sw-addrmethod=CODE
        VAR_NOINIT_UNSPECIFIED: sw-addrmethod=VAR_NO_INIT
        VAR_ZERO_INIT_UNSPECIFIED: sw-addrmethod=VAR_ZERO_INIT
        VAR_ZERO_INIT_8BIT: sw-addrmethod=VAR_ZERO_INIT
        VAR_INIT_UNSPECIFIED: sw-addrmethod=VAR_INIT
        CONST_UNSPECIFIED: sw-addrmethod=CONST
        APPL_CODE: sw-addrmethod=CODE
        BSWM_APPL_CODE: sw-addrmethod=CODE
        DET_APPL_CODE: sw-addrmethod=CODE
        ECUM_APPL_CODE: sw-addrmethod=CODE
        OS_OSCORE0_SWC_APPL_CODE: sw-addrmethod=CODE
        STARTAPP_APPL_CODE: sw-addrmethod=CODE
        DEFAULT_APPL_INIT_TASK_CODE: sw-addrmethod=CODE
        DEFAULT_APPL_TASK_CODE: sw-addrmethod=CODE
        DEFAULT_BSW_ASYNC_TASK_CODE: sw-addrmethod=CODE
        DEFAULT_INIT_TASK_CODE: sw-addrmethod=CODE
        DEFAULT_INIT_TASK_TRUSTED_CODE: sw-addrmethod=CODE
        IDLETASK_OSCORE0_CODE: sw-addrmethod=CODE
        COMM_APPL_CODE: sw-addrmethod=CODE
        MOTORCONTROLL_APPL_CODE: sw-addrmethod=CODE
        MOTORCDD_APPL_CODE: sw-addrmethod=CODE
        MOTORTASK_CODE: sw-addrmethod=CODE
        NVM_APPL_CODE: sw-addrmethod=CODE
package /MICROSAR/Rte_ib_bswmd/BswModuleDescriptions
  bsw module description Rte
    bsw internal behavior RteBehavior
