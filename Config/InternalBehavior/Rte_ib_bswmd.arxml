AUTOSAR XML (schema 00048)
package /MICROSAR
  bsw implementation Rte_Impl: programming-language=C, sw-version=4.29.00, used-code-generator=DaVinci Configurator, vendor-id=30, ar-release-version=4.03.01
    resource consumption ResourceConsumption
      57 x memory section:
        CODE: sw-addrmethod=CODE
        VAR_NOINIT_UNSPECIFIED: sw-addrmethod=SystemApplication_OsCore0_VAR_NO_INIT
        VAR_ZERO_INIT_UNSPECIFIED: sw-addrmethod=SystemApplication_OsCore0_VAR_INIT
        VAR_ZERO_INIT_8BIT: sw-addrmethod=SystemApplication_OsCore0_VAR_INIT
        VAR_INIT_UNSPECIFIED: sw-addrmethod=SystemApplication_OsCore0_VAR_INIT
        CONST_UNSPECIFIED: sw-addrmethod=CONST
        APPL_CODE: sw-addrmethod=CODE
        BSWM_APPL_CODE: sw-addrmethod=CODE
        DET_APPL_CODE: sw-addrmethod=CODE
        ECUM_APPL_CODE: sw-addrmethod=CODE
        OS_OSCORE0_SWC_APPL_CODE: sw-addrmethod=CODE
        STARTAPP_APPL_CODE: sw-addrmethod=CODE
        DEFAULT_APPL_INIT_TASK_CODE: sw-addrmethod=CODE
        DEFAULT_APPL_TASK_CODE: sw-addrmethod=CODE
        DEFAULT_INIT_TASK_CODE: sw-addrmethod=CODE
        DEFAULT_INIT_TASK_TRUSTED_CODE: sw-addrmethod=CODE
        IDLETASK_OSCORE0_CODE: sw-addrmethod=CODE
        COMM_APPL_CODE: sw-addrmethod=CODE
        MOTORCONTROLL_APPL_CODE: sw-addrmethod=CODE
        MOTORCDD_APPL_CODE: sw-addrmethod=CODE
        NVM_APPL_CODE: sw-addrmethod=CODE
        DEFAULT_BSW_ASYNC_TASK_10MS_CODE: sw-addrmethod=CODE
        VAR_NOCACHE_NOINIT_UNSPECIFIED: sw-addrmethod=SystemApplication_OsCore0_VAR_NOCACHE_NO_INIT
        VAR_NOCACHE_ZERO_INIT_UNSPECIFIED: sw-addrmethod=SystemApplication_OsCore0_VAR_NOCACHE_INIT
        VAR_NOCACHE_ZERO_INIT_8BIT: sw-addrmethod=SystemApplication_OsCore0_VAR_NOCACHE_INIT
        VAR_GLOBALSHARED_NOCACHE_ZERO_INIT_8BIT: sw-addrmethod=GLOBALSHARED_VAR_NOCACHE_INIT
        VAR_NOCACHE_INIT_UNSPECIFIED: sw-addrmethod=SystemApplication_OsCore0_VAR_NOCACHE_INIT
        OS_OSCORE1_SWC_APPL_CODE: sw-addrmethod=CODE
        IDLETASK_OSCORE_1_CODE: sw-addrmethod=CODE
        OSAPPLICATION_OSCORE1_CODE: sw-addrmethod=CODE
        VAR_OsApplication_OsCore1_NOINIT_UNSPECIFIED: sw-addrmethod=OsApplication_OsCore1_VAR_NO_INIT
        VAR_OsApplication_OsCore1_NOCACHE_NOINIT_UNSPECIFIED: sw-addrmethod=OsApplication_OsCore1_VAR_NOCACHE_NO_INIT
        VAR_OsApplication_OsCore1_ZERO_INIT_UNSPECIFIED: sw-addrmethod=OsApplication_OsCore1_VAR_INIT
        VAR_OsApplication_OsCore1_NOCACHE_ZERO_INIT_UNSPECIFIED: sw-addrmethod=OsApplication_OsCore1_VAR_NOCACHE_INIT
        VAR_OsApplication_OsCore1_NOCACHE_ZERO_INIT_8BIT: sw-addrmethod=OsApplication_OsCore1_VAR_NOCACHE_INIT
        VAR_OsApplication_OsCore1_INIT_UNSPECIFIED: sw-addrmethod=OsApplication_OsCore1_VAR_INIT
        VAR_OsApplication_OsCore1_NOCACHE_INIT_UNSPECIFIED: sw-addrmethod=OsApplication_OsCore1_VAR_NOCACHE_INIT
        SYSTEMAPPLICATION_OSCORE0_CODE: sw-addrmethod=CODE
        VAR_SystemApplication_OsCore0_NOINIT_UNSPECIFIED: sw-addrmethod=SystemApplication_OsCore0_VAR_NO_INIT
        VAR_SystemApplication_OsCore0_NOCACHE_NOINIT_UNSPECIFIED: sw-addrmethod=SystemApplication_OsCore0_VAR_NOCACHE_NO_INIT
        VAR_SystemApplication_OsCore0_ZERO_INIT_UNSPECIFIED: sw-addrmethod=SystemApplication_OsCore0_VAR_INIT
        VAR_SystemApplication_OsCore0_NOCACHE_ZERO_INIT_UNSPECIFIED: sw-addrmethod=SystemApplication_OsCore0_VAR_NOCACHE_INIT
        VAR_SystemApplication_OsCore0_NOCACHE_ZERO_INIT_8BIT: sw-addrmethod=SystemApplication_OsCore0_VAR_NOCACHE_INIT
        VAR_SystemApplication_OsCore0_INIT_UNSPECIFIED: sw-addrmethod=SystemApplication_OsCore0_VAR_INIT
        VAR_SystemApplication_OsCore0_NOCACHE_INIT_UNSPECIFIED: sw-addrmethod=SystemApplication_OsCore0_VAR_NOCACHE_INIT
        DEFAULT_MOTORINITTASK_CODE: sw-addrmethod=CODE
        DEFAULT_INIT_TASK_CORE1_CODE: sw-addrmethod=CODE
        DEFAULT_INIT_TASK_CORE1_TRUSTED_CODE: sw-addrmethod=CODE
        BSWCORE1TASK_CODE: sw-addrmethod=CODE
        MOTORTASK_CODE: sw-addrmethod=CODE
        DCM_APPL_CODE: sw-addrmethod=CODE
        DEMMASTER_0_APPL_CODE: sw-addrmethod=CODE
        DEMSATELLITE_0_APPL_CODE: sw-addrmethod=CODE
        DIGAPP_APPL_CODE: sw-addrmethod=CODE
        BRSMAINBACKGROUNDTASK_CODE: sw-addrmethod=CODE
        BRSMAINTASK_CODE: sw-addrmethod=CODE
        WDGM_SYSTEMAPPLICATION_OSCORE0_APPL_CODE: sw-addrmethod=CODE
package /MICROSAR/Rte_ib_bswmd/BswModuleDescriptions
  bsw module description Rte: provided-entrys=Rte_ComSendSignalProxyPeriodic
    bsw internal behavior RteBehavior
      bsw schedulable entity Rte_ComSendSignalProxyPeriodic: implemented-entry=Rte_ComSendSignalProxyPeriodic
      bsw timing event Rte_ComSendSignalProxyPeriodicTimingEvent0: starts-on-event=Rte_ComSendSignalProxyPeriodic, period=0.005
  bsw module entry Rte_ComSendSignalProxyPeriodic: call-type=SCHEDULED, execution-context=TASK
