AUTOSAR XML (schema 00048)
package /ActiveEcuC
  module config IpduM: implementation-config-variant=VARIANT-PRE-COMPILE, module-description=IpduM_Impl
    IpduMPublishedInformation: IpduMRxDirectComInvocation=false
    IpduMGeneral:
      IpduMStaticPartExists = true
      IpduMConfigurationTimeBase = 0.01
      IpduMRxTimeBase = 0.01
      IpduMTxTimeBase = 0.01
      IpduMDevErrorDetect = true
      IpduMHeaderByteOrder = IPDUM_BIG_ENDIAN
      IpduMVersionInfoApi = false
      IpduMSafeBswChecks = false
    IpduMConfig
      msg_MyECU_Lamp_oCAN00_818e1651_Tx (IpduMTxPathway)
        IpduMTxRequest_30b6d8a0 (IpduMTxRequest):
          IpduMByteOrder = LITTLE_ENDIAN
          IpduMIPduUnusedAreasDefault = 0
          IpduMTxTriggerMode = DYNAMIC_PART_TRIGGER
          IpduMTxConfirmationPduId = 0
          IpduMInitialDynamicPart = msg_MyECU_Lamp_oCAN00_abcb4e0d
          IpduMOutgoingPduRef = msg_MyECU_Lamp_oCAN00_818e1651_Tx
          IpduMSelectorFieldPosition: IpduMSelectorFieldLength=8, IpduMSelectorFieldPosition=0
          3 x IpduMTxDynamicPart, all with IpduMJitUpdate=false, IpduMTxDynamicConfirmation=false:
            msg_MyECU_Lamp_oCAN00_67614e93: IpduMTxDynamicHandleId=1, IpduMTxDynamicPduRef=msg_MyECU_Lamp_MxA1_oCAN00_7bc5773a_Tx
              IpduMSegment_48 (IpduMSegment): IpduMSegmentLength=208, IpduMSegmentPosition=48
              IpduMSegment_0 (IpduMSegment): IpduMSegmentLength=32, IpduMSegmentPosition=0
            msg_MyECU_Lamp_oCAN00_abcb4e0d: IpduMTxDynamicHandleId=2, IpduMTxDynamicPduRef=msg_MyECU_Lamp_MxA0_oCAN00_b76f77a4_Tx
              IpduMSegment_48 (IpduMSegment): IpduMSegmentLength=208, IpduMSegmentPosition=48
              IpduMSegment_0 (IpduMSegment): IpduMSegmentLength=32, IpduMSegmentPosition=0
            msg_MyECU_Lamp_oCAN00_e9ee4970: IpduMTxDynamicHandleId=3, IpduMTxDynamicPduRef=msg_MyECU_Lamp_MxA2_oCAN00_f54a70d9_Tx
              IpduMSegment_48 (IpduMSegment): IpduMSegmentLength=208, IpduMSegmentPosition=48
              IpduMSegment_0 (IpduMSegment): IpduMSegmentLength=32, IpduMSegmentPosition=0
          msg_MyECU_Lamp_oCAN00_6ae678ab (IpduMTxStaticPart): IpduMJitUpdate=false, IpduMTxStaticConfirmation=false, IpduMTxStaticHandleId=0, IpduMTxStaticPduRef=msg_MyECU_Lamp_Mx_oCAN00_e57ca999_Tx
            IpduMSegment_32 (IpduMSegment): IpduMSegmentLength=16, IpduMSegmentPosition=32
    IpduMGeneration:
      IpduMOutOfBoundsWriteProtectionStrategy = NONE
      IpduMOutOfBoundsWriteSanitizer = false
      IpduMOutOfBoundsReadSanitizer = false
      IpduMReduceConstantData2Define = false
      IpduMBoolDataInArrayOfStructStrategy = BITMASKING
      IpduMDeduplicateIndirectedData = true
      IpduMDataDeduplicationStrategy = WITH_CAST
      IpduMReduceBoolDataByNegationThreshold = 2
      IpduMReduceBoolDataByNumericalComparisonThreshold = 2
      IpduMReduceBoolDataByNumericalRelationThreshold = 2
      IpduMReduceBoolDataByNumericalOperandStrategy = WITH_ANY_VALUE
      IpduMReduceNumericalDataByOffsetThreshold = 2
      IpduMReduceNumericalDataByArraySubtractionThreshold = 2
      IpduMReduceDataByStreaming = false
      IpduMShortSymbols = false
      IpduMInterfacesForDeactivatedData = false
      IpduMReferringKeysInComments = false
