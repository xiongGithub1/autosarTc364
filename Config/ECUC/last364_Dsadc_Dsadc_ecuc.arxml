AUTOSAR XML (schema 00048)
package /ActiveEcuC
  module config Dsadc: implementation-config-variant=VARIANT-POST-BUILD-LOADABLE, module-description=Dsadc_Impl
    DsadcGeneral:
      DsadcDevErrorDetect = true
      DsadcSafetyEnable = false
      DsadcDeInitApi = true
      DsadcInitCheckApi = false
      DsadcVersionInfoApi = false
      DsadcInitDeInitApiMode = DSADC_MCAL_SUPERVISOR
      DsadcRuntimeApiMode = DSADC_MCAL_SUPERVISOR
      DsadcRestartIntegratorApi = false
    CommonPublishedInformation:
      ArMajorVersion = 4
      ArMinorVersion = 2
      ArPatchVersion = 2
      SwMajorVersion = 20
      SwMinorVersion = 10
      SwPatchVersion = 0
      ModuleId = 255
      VendorId = 17
      Release = _TRICORE_TC364_TQFP
    DsadcConfigSet
      DsadcGlobalConfiguration:
        DsadcDitheringTrimValue = DSADC_DITHERING_MIN_50_MILVLT
        DsadcSleepMode = SLEEP_ENABLE
        DsadcSupplyVoltageLevel = VOLTAGESUPPLY_5V
        DsadcSyncClockGen = UNSYNCHRONIZED_MODE
      DsadcCarrierGeneratorConfiguration:
        DsadcPwmGenerationMode = DSADC_NORMAL_MODE
        DsadcCarrierFrequencyClockDiv = DSADC_CG_CLOCKDIVIDER_DIV2
        DsadcCarrierSignalPolarity = DSADC_CARR_SIG_NORMAL
        DsadcCarrierSignalType = DSADC_CARR_SIG_STOPPED
      DsadcChannel_TLE5501_COSP (DsadcChannelConfiguration):
        DsadcChannelId = 0
        DsadcHwChannelNum = DSADC_CHANNEL_0
        DsadcAccessMode = DSADC_SINGLE_READ
        DsadcTriggerMode = DSADC_TRIGGER_MODE_NORMAL
        DsadcTimestampFeature = DSADC_TIMESTAMP_DISABLED
        DsadcGateActiveLevel = DSADC_GATE_LOW_LEVEL
        DsadcBufferFullNotification = NULL_PTR
        DsadcNewResultNotification = NULL_PTR
        DsadcWindowCloseNotification = NULL_PTR
        DsadcModulatorConfiguration:
          DsadcAnalogClockSyncDelay = 0
          DsadcClockDivider = DSADC_CLOCKDIVIDER_DIV4
          DsadcDitheringEnable = false
          DsadcInputGain = DSADC_INPUT_GAIN_FACTOR_1
          DsadcInputMuxActionMode = DSADC_INPUTMUX_PRESET_MODE
          DsadcInputMuxControlMode = DSADC_INMUX_SOFTWARE_CONTROL
          DsadcInputPinSelection = INPUT_PIN_0_AN2_AN3
          DsadcIntegratorResetEnable = false
          DsadcNegativeInputLine = DSADC_NEG_INPUT_PIN
          DsadcPositiveInputLine = DSADC_POS_INPUT_PIN
        DsadcDemodulatorConfiguration: DsadcIntegratorTriggerMode=DSADC_INTR_BYPASSED, DsadcResultDisplayMode=DSADC_RES_SIGNED_MODE, DsadcTriggerSelect=TRIGGER_0_NO_DSADC_TRIG
        DsadcCommonModeVoltConfig:
          DsadcCommonModeVoltageEnable = false
          DsadcCommonModeVoltageSelect = DSADC_VCM_VREFX_2
          DsadcComModeVoltPosAEnable = false
          DsadcComModeVoltPosBEnable = false
          DsadcComModeVoltPosCEnable = false
          DsadcComModeVoltPosDEnable = false
          DsadcComModeVoltNegAEnable = false
          DsadcComModeVoltNegBEnable = false
          DsadcComModeVoltNegCEnable = false
          DsadcComModeVoltNegDEnable = false
        DsadcFilterConfiguration:
          DsadcFIR0FilterEnable = true
          DsadcFIR1FilterEnable = true
          DsadcFIR1FilterDecimationEnable = true
          DsadcPreFilterEnable = true
          DsadcOvershootCompensationEn = false
          DsadcCICFilterDecimationFactor = 32
          DsadcCICFilterStartValue = 32
          DsadcAlternateServiceReq = DSADC_ALT_SERVICE_DISABLE
          DsadcOffsetCompFilterEnable = DSADC_OFFCOMP_FILTER_DISABLE
          DsadcOffsetCompValueProtect = false
          DsadcOffsetCompValue = 0
          DsadcAuxFilterConfig: DsadcAuxCicFilterEnable=false, DsadcAuxFilterCicDecimationFactor=DSADC_AUXCIC_OSR_16
          DsadcGainCalibConfig
            DsadcGainCorrConfig: DsadcCICFilterOutputShiftPos=BITS_15_TO_31, DsadcGainCorrMulFactor=1.0983
            DsadcCalibAlgoConfig:
              DsadcCalibCICFilterOutputShiftPos = BITS_27_TO_43
              DsadcCalibGainCorrMulFactor = 1.406
              DsadcCICDecimationRate = DSADC_CIC_DECIMATION_RATE_512
              DsadcGainCalibMulFactor = 1
              DsadcCalibAlgoTargetValue = 25000
          DsadcComparatorConfiguration: DsadcComparatorEventSelect=DSADC_RESULT_ALWAYS, DsadcLowerBoundaryValue=-25000, DsadcUpperBoundaryValue=25000
      DsadcChannel_TLE5501_SIN (DsadcChannelConfiguration):
        DsadcChannelId = 1
        DsadcHwChannelNum = DSADC_CHANNEL_1
        DsadcAccessMode = DSADC_SINGLE_READ
        DsadcTriggerMode = DSADC_TRIGGER_MODE_NORMAL
        DsadcTimestampFeature = DSADC_TIMESTAMP_DISABLED
        DsadcGateActiveLevel = DSADC_GATE_LOW_LEVEL
        DsadcBufferFullNotification = NULL_PTR
        DsadcNewResultNotification = NULL_PTR
        DsadcWindowCloseNotification = NULL_PTR
        DsadcModulatorConfiguration:
          DsadcAnalogClockSyncDelay = 0
          DsadcClockDivider = DSADC_CLOCKDIVIDER_DIV4
          DsadcDitheringEnable = false
          DsadcInputGain = DSADC_INPUT_GAIN_FACTOR_1
          DsadcInputMuxActionMode = DSADC_INPUTMUX_PRESET_MODE
          DsadcInputMuxControlMode = DSADC_INMUX_SOFTWARE_CONTROL
          DsadcInputPinSelection = INPUT_PIN_0_AN36_AN37
          DsadcIntegratorResetEnable = false
          DsadcNegativeInputLine = DSADC_NEG_INPUT_PIN
          DsadcPositiveInputLine = DSADC_POS_INPUT_PIN
        DsadcDemodulatorConfiguration: DsadcIntegratorTriggerMode=DSADC_INTR_BYPASSED, DsadcResultDisplayMode=DSADC_RES_SIGNED_MODE, DsadcTriggerSelect=TRIGGER_0_NO_DSADC_TRIG
        DsadcCommonModeVoltConfig:
          DsadcCommonModeVoltageEnable = false
          DsadcCommonModeVoltageSelect = DSADC_VCM_VREFX_2
          DsadcComModeVoltPosAEnable = false
          DsadcComModeVoltPosBEnable = false
          DsadcComModeVoltPosCEnable = false
          DsadcComModeVoltPosDEnable = false
          DsadcComModeVoltNegAEnable = false
          DsadcComModeVoltNegBEnable = false
          DsadcComModeVoltNegCEnable = false
          DsadcComModeVoltNegDEnable = false
        DsadcFilterConfiguration:
          DsadcFIR0FilterEnable = true
          DsadcFIR1FilterEnable = true
          DsadcFIR1FilterDecimationEnable = true
          DsadcPreFilterEnable = true
          DsadcOvershootCompensationEn = false
          DsadcCICFilterDecimationFactor = 32
          DsadcCICFilterStartValue = 32
          DsadcAlternateServiceReq = DSADC_ALT_SERVICE_DISABLE
          DsadcOffsetCompFilterEnable = DSADC_OFFCOMP_FILTER_DISABLE
          DsadcOffsetCompValueProtect = false
          DsadcOffsetCompValue = 0
          DsadcAuxFilterConfig: DsadcAuxCicFilterEnable=false, DsadcAuxFilterCicDecimationFactor=DSADC_AUXCIC_OSR_16
          DsadcGainCalibConfig
            DsadcGainCorrConfig: DsadcCICFilterOutputShiftPos=BITS_15_TO_31, DsadcGainCorrMulFactor=1.0983
            DsadcCalibAlgoConfig:
              DsadcCalibCICFilterOutputShiftPos = BITS_27_TO_43
              DsadcCalibGainCorrMulFactor = 1.406
              DsadcCICDecimationRate = DSADC_CIC_DECIMATION_RATE_512
              DsadcGainCalibMulFactor = 1
              DsadcCalibAlgoTargetValue = 25000
          DsadcComparatorConfiguration: DsadcComparatorEventSelect=DSADC_RESULT_ALWAYS, DsadcLowerBoundaryValue=-25000, DsadcUpperBoundaryValue=25000
