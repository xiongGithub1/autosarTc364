AUTOSAR XML (schema 00050)
package /Dio
  module config Dio: implementation-config-variant=VARIANT-LINK-TIME, module-description=Dio_Impl
    CommonPublishedInformation:
      ArMajorVersion = 4
      ArMinorVersion = 2
      ArPatchVersion = 2
      ModuleId = 120
      Release = _TRICORE_TC364_TQFP
      SwMajorVersion = 20
      SwMinorVersion = 0
      SwPatchVersion = 1
      VendorId = 17
    DioConfig
      DioPort_0 (DioPort): DioPortId=33
        DioChannel_led1 (DioChannel): DioChannelId=0
        DioChannel_Led2 (DioChannel): DioChannelId=1
    DioGeneral: DioDevErrorDetect=true, DioFlipChannelApi=true, DioMaskedWritePortApi=true, DioSafetyEnable=false, DioVersionInfoApi=false
