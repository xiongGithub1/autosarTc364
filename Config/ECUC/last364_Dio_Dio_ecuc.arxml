AUTOSAR XML (schema 00048)
package /Dio
  module config Dio: implementation-config-variant=VARIANT-LINK-TIME, module-description=Dio_Impl
    CommonPublishedInformation:
      ArMajorVersion = 4
      ArMinorVersion = 2
      ArPatchVersion = 2
      ModuleId = 120
      Release = _TRICORE_TC364_TQFP
      SwMajorVersion = 20
      SwMinorVersion = 0
      SwPatchVersion = 1
      VendorId = 17
    DioConfig
      5 x DioPort:
        DioPort_P33: DioPortId=33
          DioChannel_led1 (DioChannel): DioChannelId=0
          DioChannel_led2 (DioChannel): DioChannelId=1
        DioPort_P20: DioPortId=20
          3 x DioChannel:
            DioChannel_Can1Nstb: DioChannelId=6
            DioChannel_Can1Nerr: DioChannelId=10
            DioChannel_Can1En: DioChannelId=9
        DioPort_P00: DioPortId=0
          3 x DioChannel:
            DioChannel_9183SOFF: DioChannelId=2
            DioChannel_9183ERR: DioChannelId=4
            DioChannel_9183INH: DioChannelId=12
        DioPort_P02: DioPortId=2
          DioChannel_9183ENA (DioChannel): DioChannelId=8
        DioPort_P15: DioPortId=15
          DioChannel_test (DioChannel): DioChannelId=2
          DioChannel_test2 (DioChannel): DioChannelId=3
    DioGeneral: DioDevErrorDetect=true, DioFlipChannelApi=true, DioMaskedWritePortApi=true, DioSafetyEnable=false, DioVersionInfoApi=false
