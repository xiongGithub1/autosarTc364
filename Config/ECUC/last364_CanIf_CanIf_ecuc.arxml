AUTOSAR XML (schema 00048)
package /ActiveEcuC
  module config CanIf: implementation-config-variant=VARIANT-PRE-COMPILE, module-description=CanIf_Impl
    CanIfCtrlDrvCfg_7d254554 (CanIfCtrlDrvCfg): CanIfCtrlDrvTxCancellation=false, CanIfCtrlDrvInitHohConfigRef=CanIfInitHohCfg, CanIfCtrlDrvNameRef=CanGeneral
      CT_CAN00_9df8a959 (CanIfCtrlCfg): CanIfCtrlId=0, CanIfCtrlWakeupSupport=false, CanIfCtrlJ1939DynAddrSupport=DISABLED, CanIfCtrlCanCtrlRef=CT_CAN00_9df8a959
    CanIfDispatchCfg:
      CanIfDispatchUserCtrlBusOffName = CanSM_ControllerBusOff
      CanIfDispatchUserCtrlBusOffUL = CAN_SM
      CanIfDispatchUserCtrlModeIndicationName = CanSM_ControllerModeIndication
      CanIfDispatchUserCtrlModeIndicationUL = CAN_SM
    CanIfInitCfg
      msg_Transmit_oCAN00_29db34a4_Tx (CanIfTxPduCfg):
        CanIfTxPduCanId = 512
        CanIfTxPduCanIdType = STANDARD_CAN
        CanIfTxPduDlc = 1
        CanIfTxPduUserTxConfirmationName = PduR_CanIfTxConfirmation
        CanIfTxPduUserTxConfirmationUL = PDUR
        CanIfTxPduId = 4
        CanIfTxPduReadNotifyStatus = false
        CanIfTxPduType = STATIC
        CanIfTxPduTruncation = true
        CanIfTxPduBufferRef = CHNL_0fb271d2
        CanIfTxPduRef = msg_Transmit_oCAN00_9631a86b_Tx
      CHNL_0fb271d2 (CanIfBufferCfg):
        CanIfBufferSize = 5
        CanIfTxBufferHandlingType = PRIO_BY_CANID
        CanIfTxBufferMappedTxPdus = 5
        CanIfTxBufferMaxPduLength = 12
        CanIfBufferHthRef = CN_CAN00_5e566ad9_Tx
      CanIfInitHohCfg: CanIfInitRefCfgSet=CanConfigSet
        CN_CAN00_5e566ad9_Tx (CanIfHthCfg): CanIfHthCanCtrlIdRef=CT_CAN00_9df8a959, CanIfHthIdSymRef=CN_CAN00_5e566ad9_Tx
        CN_CAN00_770af0b0_Rx (CanIfHrhCfg): CanIfHrhSoftwareFilter=true, CanIfHrhCanCtrlIdRef=CT_CAN00_9df8a959, CanIfHrhIdSymRef=CN_CAN00_770af0b0_Rx
      msg_Receive_oCAN00_76f25845_Rx (CanIfRxPduCfg):
        CanIfRxPduCanId = 528
        CanIfRxPduCanIdType = STANDARD_CAN
        CanIfRxPduDlc = 1
        CanIfRxPduUserRxIndicationName = PduR_CanIfRxIndication
        CanIfRxPduUserRxIndicationUL = PDUR
        CanIfRxPduId = 4
        CanIfRxPduReadData = false
        CanIfRxPduReadNotifyStatus = false
        CanIfRxPduDlcCheck = true
        CanIfRxPduHrhIdRef = CN_CAN00_770af0b0_Rx
        CanIfRxPduRef = msg_Receive_oCAN00_3867e0b8_Rx
      msg_MotorStatus_oCAN00_41e9a736_Tx (CanIfTxPduCfg):
        CanIfTxPduCanId = 1297
        CanIfTxPduCanIdType = STANDARD_FD_CAN
        CanIfTxPduDlc = 12
        CanIfTxPduUserTxConfirmationName = PduR_CanIfTxConfirmation
        CanIfTxPduUserTxConfirmationUL = PDUR
        CanIfTxPduId = 3
        CanIfTxPduReadNotifyStatus = false
        CanIfTxPduType = STATIC
        CanIfTxPduTruncation = true
        CanIfTxPduBufferRef = CHNL_0fb271d2
        CanIfTxPduRef = msg_MotorStatus_oCAN00_a6063320_Tx
      msg_XCP_Request_Rx (CanIfRxPduCfg):
        CanIfRxPduCanIdType = STANDARD_FD_CAN
        CanIfRxPduDlc = 8
        CanIfRxPduId = 3
        CanIfRxPduReadData = false
        CanIfRxPduReadNotifyStatus = false
        CanIfRxPduUserRxIndicationName = Xcp_CanIfRxIndication
        CanIfRxPduUserRxIndicationUL = XCP
        CanIfRxPduDlcCheck = true
        CanIfRxPduCanId = 1795
        CanIfRxPduHrhIdRef = CN_CAN00_770af0b0_Rx
        CanIfRxPduRef = msg_XCP_Request_Rx
      msg_XCP_Request_Tx (CanIfTxPduCfg):
        CanIfTxPduCanId = 1796
        CanIfTxPduCanIdType = STANDARD_FD_CAN
        CanIfTxPduDlc = 8
        CanIfTxPduId = 1
        CanIfTxPduReadNotifyStatus = false
        CanIfTxPduType = STATIC
        CanIfTxPduUserTxConfirmationUL = XCP
        CanIfTxPduTruncation = true
        CanIfTxPduUserTxConfirmationName = Xcp_CanIfTxConfirmation
        CanIfTxPduBufferRef = CHNL_0fb271d2
        CanIfTxPduRef = msg_XCP_Request_Tx
      msg_diag_Response_MyECU_Tp_oCAN00_59e48f7a_Tx (CanIfTxPduCfg):
        CanIfTxPduCanId = 1884
        CanIfTxPduCanIdType = STANDARD_CAN
        CanIfTxPduDlc = 8
        CanIfTxPduUserTxConfirmationName = CanTp_TxConfirmation
        CanIfTxPduUserTxConfirmationUL = CAN_TP
        CanIfTxPduId = 0
        CanIfTxPduReadNotifyStatus = false
        CanIfTxPduType = STATIC
        CanIfTxPduTruncation = true
        CanIfTxPduBufferRef = CHNL_0fb271d2
        CanIfTxPduRef = msg_diag_Response_MyECU_Tp_oCAN00_0ed9d144_Tx
      msg_diag_RequestGlobal_Tp_oCAN00_5c56b065_Rx (CanIfRxPduCfg):
        CanIfRxPduCanId = 2015
        CanIfRxPduCanIdType = STANDARD_NO_FD_CAN
        CanIfRxPduDlc = 8
        CanIfRxPduUserRxIndicationName = CanTp_RxIndication
        CanIfRxPduUserRxIndicationType = PDUID_PDUINFOPTR
        CanIfRxPduUserRxIndicationUL = CAN_TP
        CanIfRxPduId = 1
        CanIfRxPduReadData = false
        CanIfRxPduReadNotifyStatus = false
        CanIfRxPduDlcCheck = true
        CanIfRxPduHrhIdRef = CN_CAN00_770af0b0_Rx
        CanIfRxPduRef = msg_diag_RequestGlobal_Tp_oCAN00_7b1e9193_Rx
      msg_diag_Request_MyECU_Tp_oCAN00_2c5ccddc_Rx (CanIfRxPduCfg):
        CanIfRxPduCanId = 1868
        CanIfRxPduCanIdType = STANDARD_NO_FD_CAN
        CanIfRxPduDlc = 8
        CanIfRxPduUserRxIndicationName = CanTp_RxIndication
        CanIfRxPduUserRxIndicationType = PDUID_PDUINFOPTR
        CanIfRxPduUserRxIndicationUL = CAN_TP
        CanIfRxPduId = 2
        CanIfRxPduReadData = false
        CanIfRxPduReadNotifyStatus = false
        CanIfRxPduDlcCheck = true
        CanIfRxPduHrhIdRef = CN_CAN00_770af0b0_Rx
        CanIfRxPduRef = msg_diag_Request_MyECU_Tp_oCAN00_ecbacca2_Rx
      msg_nm_MyECU_oCAN00_dfbc2140_Tx (CanIfTxPduCfg):
        CanIfTxPduCanId = 1536
        CanIfTxPduCanIdType = STANDARD_CAN
        CanIfTxPduDlc = 8
        CanIfTxPduUserTxConfirmationName = CanNm_TxConfirmation
        CanIfTxPduUserTxConfirmationUL = CAN_NM
        CanIfTxPduId = 2
        CanIfTxPduReadNotifyStatus = false
        CanIfTxPduType = STATIC
        CanIfTxPduTruncation = true
        CanIfTxPduBufferRef = CHNL_0fb271d2
        CanIfTxPduRef = msg_nm_MyECU_oCAN00_077ec9e6_Tx
      MyECU_f835e395_Rx (CanIfRxPduCfg):
        CanIfRxPduCanIdType = STANDARD_CAN
        CanIfRxPduDlc = 8
        CanIfRxPduUserRxIndicationName = CanNm_RxIndication
        CanIfRxPduUserRxIndicationUL = CAN_NM
        CanIfRxPduId = 0
        CanIfRxPduReadData = false
        CanIfRxPduReadNotifyStatus = false
        CanIfRxPduDlcCheck = true
        CanIfRxPduHrhIdRef = CN_CAN00_770af0b0_Rx
        CanIfRxPduRef = MyECU_df2f1767_Rx
        CHNL_39b6d69b (CanIfRxPduCanIdRange): CanIfRxPduCanIdRangeLowerCanId=1536, CanIfRxPduCanIdRangeUpperCanId=1791
    CanIfPrivateCfg:
      CanIfPrivateSoftwareFilterType = LINEAR
      CanIfPrivateDlcCheck = true
      CanIfSupportTTCAN = false
      CanIfTransceiverMapping = false
      CanIfTransceiverHandling = false
      CanIfSupportExtendedIds = false
      CanIfSupportNmOsek = false
      CanIfTxBufferType = BYTE_QUEUE
      CanIfWakeupSupport = false
      CanIfStaticFdTxBufferSupport = true
      CanIfRxSearchConsiderMsgType = true
      CanIfTxBufferFifoSupport = false
      CanIfSetPduReceptionModeSupport = false
      CanIfCheckWakeupCanRetType = false
      CanIfDataChecksumRxSupport = false
      CanIfDataChecksumTxSupport = false
    CanIfPublicCfg:
      CanIfPublicPnSupport = false
      CanIfPublicCancelTransmitSupport = false
      CanIfPublicDevErrorDetect = true
      CanIfPublicHandleTypeEnum = UINT8
      CanIfPublicMultipleDrvSupport = false
      CanIfPublicNumberOfCanHwUnits = 1
      CanIfPublicReadRxPduDataApi = false
      CanIfPublicReadRxPduNotifyStatusApi = false
      CanIfPublicReadTxPduNotifyStatusApi = false
      CanIfPublicSetDynamicTxIdApi = false
      CanIfPublicTxBuffering = true
      CanIfPublicTxConfirmPollingSupport = false
      CanIfPublicVersionInfoApi = false
      CanIfPublicWakeupCheckValidSupport = false
      CanIfPnWakeupTxPduFilterSupport = false
      CanIfPnTrcvHandlingSupport = false
      CanIfJ1939DynAddrSupport = DISABLED
      CanIfSafeBswChecks = false
      CanIfBusMirroringSupport = false
      CanIfEnableSecurityEventReporting = false
      CanIfSupportCanDrvAsr440 = false
      CanIfSupportMultipartition = false
      CanIfSetBaudrateApi = false
