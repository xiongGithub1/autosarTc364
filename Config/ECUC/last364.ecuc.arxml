AUTOSAR XML (schema 00048)
package /ActiveEcuC
  ecuc value collection ActiveEcuC: ecu-extract=SYSTEM
    ecuc-values:
      MemMap
      vBRS
      BswM
      vSet
      vBaseEnv
      Det
      Rte
      Os
      McalLib
      ComXf
      E2EXf
      EcuC
      EcuM
      PduR
      CanIf
      Can
      ComM
      CanSM
      Com
      ResourceM
      Dio
      Port
      Mcu
      Spi
      Adc
      Dma
      Irq
      Pwm
      Sbc
      MemIf
      Fls
      NvM
      Fee
      Crc
      vLinkGen
      Xcp
      Dcm
      CanTp
      Dem
      Uart
      CanNm
      Nm
      Wdg
      WdgIf
      WdgM
      Dsadc
