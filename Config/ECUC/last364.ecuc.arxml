AUTOSAR XML (schema 00050)
package /ActiveEcuC
  ecuc value collection ActiveEcuC: ecu-extract=SYSTEM, ecuc-values=[ResourceM, Dio, Mcu, Port, MemMap, vBRS, BswM, EcuM, vSet, vBaseEnv, Det, Rte, Os, EcuC, McalLib]
