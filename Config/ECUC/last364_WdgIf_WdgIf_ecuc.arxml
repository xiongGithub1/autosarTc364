AUTOSAR XML (schema 00048)
package /ActiveEcuC
  module config WdgIf: implementation-config-variant=VARIANT-PRE-COMPILE, module-description=WdgIf_Impl
    WdgIfDevice:
      WdgIfDeviceIndex = 0
      WdgIfDeviceIncludeFile = Wdg_17_Scu.h
      WdgIfDeviceSetMode = Wdg_17_Scu_SetMode
      WdgIfDeviceSetTriggerCondition = Wdg_17_Scu_SetTriggerCondition
      WdgIfDriverRef = WdgGeneral
    WdgIfGeneral: WdgIfDevErrorDetect=true, WdgIfVersionInfoApi=false, WdgIfUseStateCombiner=false
