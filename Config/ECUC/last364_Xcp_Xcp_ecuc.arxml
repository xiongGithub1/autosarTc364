AUTOSAR XML (schema 00048)
package /ActiveEcuC
  module config Xcp: implementation-config-variant=VARIANT-PRE-COMPILE, module-description=Xcp_Impl
    XcpConfig
      XcpTransportLayer
        XcpOnCan:
          XcpOnCanMaxCto = 8
          XcpOnCanMaxDto = 8
          XcpOnCanConfirmationTimeout = 10
          XcpOnCanMultiConnectionProtection = false
          XcpOnCanVariableDlc = false
          XcpPduMode = false
      XcpPdu
        XcpRxPdu: XcpRxPduId=0, XcpRxPduRef=msg_XCP_Request_Rx, XcpTxPduContRef=XcpTxPdu
      XcpPdu_1 (XcpPdu)
        XcpTxPdu: XcpTxPduId=0, XcpTxPduRef=msg_XCP_Request_Tx
    XcpCmdConfig: XcpOpenCommandInterface=false
      XcpStandard:
        XcpBlockUpload = false
        XcpCommunicationModeInfo = false
        XcpGetIdGeneric = false
        XcpMemoryReadProtection = false
        XcpSeedKey = false
        XcpUserDefinedCommand = false
      XcpAsynchMessage: XcpEventCodes=false, XcpServiceRequestMessage=false
    XcpGeneral:
      XcpDevErrorDetect = true
      XcpMainFunctionPeriod = 0.005
      XcpMaxEventChannel = 255
      XcpOnCddEnabled = false
      XcpOnEthernetEnabled = false
      XcpOnFlexRayEnabled = false
      XcpPrescalerSupported = false
      XcpVersionInfoApi = false
      XcpBootloaderDownload = false
      XcpControl = true
      XcpMultiClientSupport = false
      XcpRuntimeMeasurementSupport = false
      XcpSafeBswChecks = false
      XcpSessionStatusAPI = true
      XcpTypeSafeCopy = false
      XcpDAQMemAccessByApplication = false
      XcpOnCanEnabled = true
      XcpCounterRef = SystemTimer
      XcpA2L: XcpTimeoutT1=2000, XcpTimeoutT2=10000, XcpTimeoutT3=2000, XcpTimeoutT4=2000, XcpTimeoutT5=2000, XcpTimeoutT6=2000, XcpTimeoutT7=0
