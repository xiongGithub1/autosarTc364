AUTOSAR XML (schema 00048)
package /ActiveEcuC
  module config Xcp: implementation-config-variant=VARIANT-PRE-COMPILE, module-description=Xcp_Impl
    XcpConfig
      XcpTransportLayer
        XcpOnCan:
          XcpOnCanMaxCto = 8
          XcpOnCanMaxDto = 8
          XcpOnCanConfirmationTimeout = 10
          XcpOnCanMultiConnectionProtection = false
          XcpOnCanVariableDlc = false
          XcpPduMode = false
      XcpPdu
        XcpRxPdu: XcpRxPduId=0, XcpRxPduRef=msg_XCP_Request_Rx, XcpTxPduContRef=XcpTxPdu
      XcpPdu_1 (XcpPdu)
        XcpTxPdu: XcpTxPduId=0, XcpTxPduRef=msg_XCP_Request_Tx
      XcpCoreDefinition: XcpSendQueueSize=256
      XcpEventChannel:
        XcpEventChannelMaxDaqList = 1
        XcpEventChannelNumber = 0
        XcpEventChannelTimeCycle = 0
        XcpEventChannelTimeUnit = TIMESTAMP_UNIT_1MS
        XcpEventChannelType = DAQ
        XcpEventChannelCoreRef = XcpCoreDefinition
    XcpCmdConfig: XcpOpenCommandInterface=false
      XcpStandard:
        XcpBlockUpload = false
        XcpCommunicationModeInfo = false
        XcpGetIdGeneric = false
        XcpMemoryReadProtection = false
        XcpSeedKey = false
        XcpUserDefinedCommand = false
      XcpAsynchMessage: XcpEventCodes=false, XcpServiceRequestMessage=false
      XcpCalibration: XcpBlockDownload=true, XcpMIN_STForBlockDownload=0, XcpModifyBits=true, XcpShortDownload=true
      XcpProgramming: XcpMinStPgm=0, XcpProgrammingWriteProtection=false
      XcpDaqAndStim:
        XcpFixedTimestamp = false
        XcpGetDAQEventInfo = false
        XcpMaxNumberOfOdtDaq = 123
        XcpMaxNumberOfOdtEntries = 124
        XcpMaxNumberOfOdtStim = 1
        XcpOverrunIndication = true
        XcpResolutionInfo = false
        XcpResumeMode = false
        XcpSynchronousDataStimulation = false
        XcpWriteDAQMultiple = false
        XcpDAQMessageHeader = ODT
        XcpComplementaryDAQ = false
    XcpGeneral:
      XcpDevErrorDetect = true
      XcpMainFunctionPeriod = 0.005
      XcpMaxEventChannel = 255
      XcpOnCddEnabled = false
      XcpOnEthernetEnabled = false
      XcpOnFlexRayEnabled = false
      XcpPrescalerSupported = false
      XcpVersionInfoApi = false
      XcpBootloaderDownload = false
      XcpControl = true
      XcpMultiClientSupport = false
      XcpRuntimeMeasurementSupport = false
      XcpSafeBswChecks = false
      XcpSessionStatusAPI = true
      XcpTypeSafeCopy = false
      XcpDAQMemAccessByApplication = false
      XcpOnCanEnabled = true
      XcpCounterRef = SystemTimer
      XcpA2L: XcpTimeoutT1=2000, XcpTimeoutT2=10000, XcpTimeoutT3=2000, XcpTimeoutT4=2000, XcpTimeoutT5=2000, XcpTimeoutT6=2000, XcpTimeoutT7=0
