AUTOSAR XML (schema 00048)
package /ActiveEcuC
  module config Dma: implementation-config-variant=VARIANT-POST-BUILD-LOADABLE, module-description=Dma_Impl
    DmaGeneral:
      DmaDevErrorDetect = true
      DmaMultiCoreErrorDetect = false
      DmaSafetyEnable = false
      DmaInitCheckApi = false
      DmaDeInitApi = true
      DmaChDeInitApi = true
      DmaSuspendApi = true
      DmaTriggerApi = true
      DmaDataPendingApi = false
      DmaBufferSwitchApi = false
      DmaGetVersionInfoApi = false
      DmaMaxTransactionSetPerChannel = 1
      DmaInitDeInitApiMode = DMA_MCAL_SUPERVISORMODE
      DmaRuntimeApiMode = DMA_MCAL_SUPERVISORMODE
    DmaChannelConfig_5012Rx (DmaChannelConfig):
      DmaChannelId = 1
      DmaChannelAssignedPartition = 0
      DmaChannelNumTransactionSet = 1
      DmaTcsInterruptTransactionLoss = false
      DmaChannelNotification = NULL_PTR
      DmaErrorNotification = NULL_PTR
      DmaChannelUser = Other
      DmaChannelTransactionSet:
        DmaTcsIndex = 0
        DmaTcsSourceAddress = NULL_PTR
        DmaTcsDestinationAddress = NULL_PTR
        DmaTcsDoubleBuffer = NULL_PTR
        DmaUserHeaderFileWithExternDeclarations = NULL
        DmaTcsMoveLength = DMA_WIDTH_8BITS
        DmaPatternMode = Pattern_Detection_Disabled
        DmaTcsTransferLength = DMA_MOVES_1
        DmaTcsTransactionLength = 0
        DmaTcsCircularBufferSourceEnable = false
        DmaTcsCircularBufferDestinationEnable = false
        DmaTcsCircularBufferSourceLength = DMA_CIRCULAR_BUFFER_LENGTH_1BYTE
        DmaTcsCircularBufferDestinationLength = DMA_CIRCULAR_BUFFER_LENGTH_1BYTE
        DmaTcsSourceAddressModificationFactor = DMA_FACTOR_1
        DmaTcsDestinationAddressModificationFactor = DMA_FACTOR_1
        DmaTcsAppendTimeStamp = false
        DmaTcsSourceAddressMovement = DMA_INCREASING
        DmaTcsDestinationAddressMovement = DMA_INCREASING
        DmaTcsShadowRegisterConfiguration = DMA_SHADOWING_DISABLED
        DmaCLLNextIndex = 0
        DmaNextTcsIndex = 0
        DmaTcsTriggerFrequency = DMA_TRANSFER_PER_TRIGGER
        DmaTcsHardwareTrigger = DMA_NO_HARDWARE_TRIGGER
        DmaTcsDaisyChaining = false
        DmaTcsInterruptSourceAddressWrap = false
        DmaTcsInterruptDestinationAddressWrap = false
        DmaTcsDataTransferInterrupt = false
        DmaTcsInterruptDataTransfer = DMA_INTERRUPT_PER_TRANSACTION
        DmaTcsInterruptDataTransferThreshold = 0
        DmaTcsSwapDataCRCByteOrder = false
        DmaTcsAutoStartEnable = false
        DmaTcsReferenceAddressCrc = 0
        DmaTcsReferenceDataCrc = 0
    DmaMoveEngineConfig: DmaMESourceErrorInterrupt=false, DmaMEDestinationErrorInterrupt=false, DmaMELinkedListErrorInterrupt=false
    CommonPublishedInformation:
      VendorId = 17
      ModuleId = 255
      ArMajorVersion = 4
      ArMinorVersion = 2
      ArPatchVersion = 2
      SwMajorVersion = 20
      SwMinorVersion = 10
      SwPatchVersion = 0
      Release = _TRICORE_TC364_TQFP
    DmaPatternConfig: DmaPattern0=0, DmaPattern1=0
    4 x DmaResourcePartition, all with DmaResourcePartitionBusMode=DMA_RP_SUPERVISOR_MODE, DmaPermittedBusMaster=4294967295:
      DmaResourcePartition
      DmaResourcePartition_{1..3}
    5 x DmaChannelConfig, all with DmaChannelAssignedPartition=0, DmaChannelNumTransactionSet=1, DmaTcsInterruptTransactionLoss=false, DmaChannelNotification=NULL_PTR, DmaErrorNotification=NULL_PTR, DmaChannelUser=Other:
      DmaChannelConfig_5012Tx: DmaChannelId=2
        DmaChannelTransactionSet:
          DmaTcsIndex = 0
          DmaTcsSourceAddress = NULL_PTR
          DmaTcsDestinationAddress = NULL_PTR
          DmaTcsDoubleBuffer = NULL_PTR
          DmaUserHeaderFileWithExternDeclarations = NULL
          DmaTcsMoveLength = DMA_WIDTH_8BITS
          DmaPatternMode = Pattern_Detection_Disabled
          DmaTcsTransferLength = DMA_MOVES_1
          DmaTcsTransactionLength = 0
          DmaTcsCircularBufferSourceEnable = false
          DmaTcsCircularBufferDestinationEnable = false
          DmaTcsCircularBufferSourceLength = DMA_CIRCULAR_BUFFER_LENGTH_1BYTE
          DmaTcsCircularBufferDestinationLength = DMA_CIRCULAR_BUFFER_LENGTH_1BYTE
          DmaTcsSourceAddressModificationFactor = DMA_FACTOR_1
          DmaTcsDestinationAddressModificationFactor = DMA_FACTOR_1
          DmaTcsAppendTimeStamp = false
          DmaTcsSourceAddressMovement = DMA_INCREASING
          DmaTcsDestinationAddressMovement = DMA_INCREASING
          DmaTcsShadowRegisterConfiguration = DMA_SHADOWING_DISABLED
          DmaCLLNextIndex = 0
          DmaNextTcsIndex = 0
          DmaTcsTriggerFrequency = DMA_TRANSFER_PER_TRIGGER
          DmaTcsHardwareTrigger = DMA_NO_HARDWARE_TRIGGER
          DmaTcsDaisyChaining = false
          DmaTcsInterruptSourceAddressWrap = false
          DmaTcsInterruptDestinationAddressWrap = false
          DmaTcsDataTransferInterrupt = false
          DmaTcsInterruptDataTransfer = DMA_INTERRUPT_PER_TRANSACTION
          DmaTcsInterruptDataTransferThreshold = 0
          DmaTcsSwapDataCRCByteOrder = false
          DmaTcsAutoStartEnable = false
          DmaTcsReferenceAddressCrc = 0
          DmaTcsReferenceDataCrc = 0
      DmaChannelConfig_9180Rx: DmaChannelId=3
        DmaChannelTransactionSet:
          DmaTcsIndex = 0
          DmaTcsSourceAddress = NULL_PTR
          DmaTcsDestinationAddress = NULL_PTR
          DmaTcsDoubleBuffer = NULL_PTR
          DmaUserHeaderFileWithExternDeclarations = NULL
          DmaTcsMoveLength = DMA_WIDTH_8BITS
          DmaPatternMode = Pattern_Detection_Disabled
          DmaTcsTransferLength = DMA_MOVES_1
          DmaTcsTransactionLength = 0
          DmaTcsCircularBufferSourceEnable = false
          DmaTcsCircularBufferDestinationEnable = false
          DmaTcsCircularBufferSourceLength = DMA_CIRCULAR_BUFFER_LENGTH_1BYTE
          DmaTcsCircularBufferDestinationLength = DMA_CIRCULAR_BUFFER_LENGTH_1BYTE
          DmaTcsSourceAddressModificationFactor = DMA_FACTOR_1
          DmaTcsDestinationAddressModificationFactor = DMA_FACTOR_1
          DmaTcsAppendTimeStamp = false
          DmaTcsSourceAddressMovement = DMA_INCREASING
          DmaTcsDestinationAddressMovement = DMA_INCREASING
          DmaTcsShadowRegisterConfiguration = DMA_SHADOWING_DISABLED
          DmaCLLNextIndex = 0
          DmaNextTcsIndex = 0
          DmaTcsTriggerFrequency = DMA_TRANSFER_PER_TRIGGER
          DmaTcsHardwareTrigger = DMA_NO_HARDWARE_TRIGGER
          DmaTcsDaisyChaining = false
          DmaTcsInterruptSourceAddressWrap = false
          DmaTcsInterruptDestinationAddressWrap = false
          DmaTcsDataTransferInterrupt = false
          DmaTcsInterruptDataTransfer = DMA_INTERRUPT_PER_TRANSACTION
          DmaTcsInterruptDataTransferThreshold = 0
          DmaTcsSwapDataCRCByteOrder = false
          DmaTcsAutoStartEnable = false
          DmaTcsReferenceAddressCrc = 0
          DmaTcsReferenceDataCrc = 0
      DmaChannelConfig_9180Tx: DmaChannelId=4
        DmaChannelTransactionSet:
          DmaTcsIndex = 0
          DmaTcsSourceAddress = NULL_PTR
          DmaTcsDestinationAddress = NULL_PTR
          DmaTcsDoubleBuffer = NULL_PTR
          DmaUserHeaderFileWithExternDeclarations = NULL
          DmaTcsMoveLength = DMA_WIDTH_8BITS
          DmaPatternMode = Pattern_Detection_Disabled
          DmaTcsTransferLength = DMA_MOVES_1
          DmaTcsTransactionLength = 0
          DmaTcsCircularBufferSourceEnable = false
          DmaTcsCircularBufferDestinationEnable = false
          DmaTcsCircularBufferSourceLength = DMA_CIRCULAR_BUFFER_LENGTH_1BYTE
          DmaTcsCircularBufferDestinationLength = DMA_CIRCULAR_BUFFER_LENGTH_1BYTE
          DmaTcsSourceAddressModificationFactor = DMA_FACTOR_1
          DmaTcsDestinationAddressModificationFactor = DMA_FACTOR_1
          DmaTcsAppendTimeStamp = false
          DmaTcsSourceAddressMovement = DMA_INCREASING
          DmaTcsDestinationAddressMovement = DMA_INCREASING
          DmaTcsShadowRegisterConfiguration = DMA_SHADOWING_DISABLED
          DmaCLLNextIndex = 0
          DmaNextTcsIndex = 0
          DmaTcsTriggerFrequency = DMA_TRANSFER_PER_TRIGGER
          DmaTcsHardwareTrigger = DMA_NO_HARDWARE_TRIGGER
          DmaTcsDaisyChaining = false
          DmaTcsInterruptSourceAddressWrap = false
          DmaTcsInterruptDestinationAddressWrap = false
          DmaTcsDataTransferInterrupt = false
          DmaTcsInterruptDataTransfer = DMA_INTERRUPT_PER_TRANSACTION
          DmaTcsInterruptDataTransferThreshold = 0
          DmaTcsSwapDataCRCByteOrder = false
          DmaTcsAutoStartEnable = false
          DmaTcsReferenceAddressCrc = 0
          DmaTcsReferenceDataCrc = 0
      DmaChannelConfig_35584Rx: DmaChannelId=5
        DmaChannelTransactionSet:
          DmaTcsIndex = 0
          DmaTcsSourceAddress = NULL_PTR
          DmaTcsDestinationAddress = NULL_PTR
          DmaTcsDoubleBuffer = NULL_PTR
          DmaUserHeaderFileWithExternDeclarations = NULL
          DmaTcsMoveLength = DMA_WIDTH_8BITS
          DmaPatternMode = Pattern_Detection_Disabled
          DmaTcsTransferLength = DMA_MOVES_1
          DmaTcsTransactionLength = 0
          DmaTcsCircularBufferSourceEnable = false
          DmaTcsCircularBufferDestinationEnable = false
          DmaTcsCircularBufferSourceLength = DMA_CIRCULAR_BUFFER_LENGTH_1BYTE
          DmaTcsCircularBufferDestinationLength = DMA_CIRCULAR_BUFFER_LENGTH_1BYTE
          DmaTcsSourceAddressModificationFactor = DMA_FACTOR_1
          DmaTcsDestinationAddressModificationFactor = DMA_FACTOR_1
          DmaTcsAppendTimeStamp = false
          DmaTcsSourceAddressMovement = DMA_INCREASING
          DmaTcsDestinationAddressMovement = DMA_INCREASING
          DmaTcsShadowRegisterConfiguration = DMA_SHADOWING_DISABLED
          DmaCLLNextIndex = 0
          DmaNextTcsIndex = 0
          DmaTcsTriggerFrequency = DMA_TRANSFER_PER_TRIGGER
          DmaTcsHardwareTrigger = DMA_NO_HARDWARE_TRIGGER
          DmaTcsDaisyChaining = false
          DmaTcsInterruptSourceAddressWrap = false
          DmaTcsInterruptDestinationAddressWrap = false
          DmaTcsDataTransferInterrupt = false
          DmaTcsInterruptDataTransfer = DMA_INTERRUPT_PER_TRANSACTION
          DmaTcsInterruptDataTransferThreshold = 0
          DmaTcsSwapDataCRCByteOrder = false
          DmaTcsAutoStartEnable = false
          DmaTcsReferenceAddressCrc = 0
          DmaTcsReferenceDataCrc = 0
      DmaChannelConfig_35584Tx: DmaChannelId=6
        DmaChannelTransactionSet:
          DmaTcsIndex = 0
          DmaTcsSourceAddress = NULL_PTR
          DmaTcsDestinationAddress = NULL_PTR
          DmaTcsDoubleBuffer = NULL_PTR
          DmaUserHeaderFileWithExternDeclarations = NULL
          DmaTcsMoveLength = DMA_WIDTH_8BITS
          DmaPatternMode = Pattern_Detection_Disabled
          DmaTcsTransferLength = DMA_MOVES_1
          DmaTcsTransactionLength = 0
          DmaTcsCircularBufferSourceEnable = false
          DmaTcsCircularBufferDestinationEnable = false
          DmaTcsCircularBufferSourceLength = DMA_CIRCULAR_BUFFER_LENGTH_1BYTE
          DmaTcsCircularBufferDestinationLength = DMA_CIRCULAR_BUFFER_LENGTH_1BYTE
          DmaTcsSourceAddressModificationFactor = DMA_FACTOR_1
          DmaTcsDestinationAddressModificationFactor = DMA_FACTOR_1
          DmaTcsAppendTimeStamp = false
          DmaTcsSourceAddressMovement = DMA_INCREASING
          DmaTcsDestinationAddressMovement = DMA_INCREASING
          DmaTcsShadowRegisterConfiguration = DMA_SHADOWING_DISABLED
          DmaCLLNextIndex = 0
          DmaNextTcsIndex = 0
          DmaTcsTriggerFrequency = DMA_TRANSFER_PER_TRIGGER
          DmaTcsHardwareTrigger = DMA_NO_HARDWARE_TRIGGER
          DmaTcsDaisyChaining = false
          DmaTcsInterruptSourceAddressWrap = false
          DmaTcsInterruptDestinationAddressWrap = false
          DmaTcsDataTransferInterrupt = false
          DmaTcsInterruptDataTransfer = DMA_INTERRUPT_PER_TRANSACTION
          DmaTcsInterruptDataTransferThreshold = 0
          DmaTcsSwapDataCRCByteOrder = false
          DmaTcsAutoStartEnable = false
          DmaTcsReferenceAddressCrc = 0
          DmaTcsReferenceDataCrc = 0
