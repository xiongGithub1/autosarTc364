AUTOSAR XML (schema 00048)
package /InitialEcuC
  ecuc value collection InitialEcuC: ecuc-values=[Can, CanIf, CanSM, Com, ComM, EcuC, EcuM, IpduM, PduR]
  module config Can
    CanConfigSet
      CT_CAN00_9df8a959 (CanController):  # CAN00
        CanControllerActivation = true
        CanControllerDefaultBaudrate = CanControllerBaudrateConfig
        CanControllerSystemRef = CT_CAN00
        CanWakeupSourceRef = EcuMCommonConfiguration/CN_CAN00_5e566ad9
        CanControllerBaudrateConfig
      CN_CAN00_5e566ad9_Tx (CanHardwareObject): CanHandleType=BASIC, CanIdValue=0, CanObjectType=TRANSMIT, CanControllerRef=CanConfigSet/CT_CAN00_9df8a959
      CN_CAN00_770af0b0_Rx (CanHardwareObject): CanHandleType=BASIC, CanIdType=STANDARD, CanIdValue=0, CanObjectType=RECEIVE, CanControllerRef=CanConfigSet/CT_CAN00_9df8a959
    CanGeneral: CanIndex=0
  module config CanIf
    CanIfCtrlDrvCfg_7d254554 (CanIfCtrlDrvCfg): CanIfCtrlDrvInitHohConfigRef=CanIfInitHohCfg, CanIfCtrlDrvNameRef=CanGeneral
      CT_CAN00_9df8a959 (CanIfCtrlCfg): CanIfCtrlCanCtrlRef=CanConfigSet/CT_CAN00_9df8a959
    CanIfInitCfg
      CHNL_0fb271d2 (CanIfBufferCfg): CanIfBufferSize=0, CanIfBufferHthRef=CanIfInitHohCfg/CN_CAN00_5e566ad9_Tx
      CanIfInitHohCfg: CanIfInitRefCfgSet=CanConfigSet
        CN_CAN00_770af0b0_Rx (CanIfHrhCfg): CanIfHrhCanCtrlIdRef=CanIfCtrlDrvCfg_7d254554/CT_CAN00_9df8a959, CanIfHrhIdSymRef=CanConfigSet/CN_CAN00_770af0b0_Rx
        CN_CAN00_5e566ad9_Tx (CanIfHthCfg): CanIfHthCanCtrlIdRef=CanIfCtrlDrvCfg_7d254554/CT_CAN00_9df8a959, CanIfHthIdSymRef=CanConfigSet/CN_CAN00_5e566ad9_Tx
      msg_Receive_oCAN00_76f25845_Rx (CanIfRxPduCfg):
        CanIfRxPduCanId = 528
        CanIfRxPduCanIdType = STANDARD_CAN
        CanIfRxPduDlc = 1
        CanIfRxPduUserRxIndicationName = PduR_CanIfRxIndication
        CanIfRxPduUserRxIndicationUL = PDUR
        CanIfRxPduHrhIdRef = CanIfInitHohCfg/CN_CAN00_770af0b0_Rx
        CanIfRxPduRef = EcucPduCollection/msg_Receive_oCAN00_3867e0b8_Rx
      msg_MyECU_Lamp_oCAN00_41befc25_Tx (CanIfTxPduCfg):
        CanIfTxPduCanId = 1297
        CanIfTxPduCanIdType = STANDARD_FD_CAN
        CanIfTxPduDlc = 32
        CanIfTxPduUserTxConfirmationName = PduR_CanIfTxConfirmation
        CanIfTxPduUserTxConfirmationUL = PDUR
        CanIfTxPduBufferRef = CanIfInitCfg/CHNL_0fb271d2
        CanIfTxPduRef = EcucPduCollection/msg_MyECU_Lamp_oCAN00_26f3473b_Tx
      msg_Transmit_oCAN00_29db34a4_Tx (CanIfTxPduCfg):
        CanIfTxPduCanId = 512
        CanIfTxPduCanIdType = STANDARD_CAN
        CanIfTxPduDlc = 1
        CanIfTxPduUserTxConfirmationName = PduR_CanIfTxConfirmation
        CanIfTxPduUserTxConfirmationUL = PDUR
        CanIfTxPduBufferRef = CanIfInitCfg/CHNL_0fb271d2
        CanIfTxPduRef = EcucPduCollection/msg_Transmit_oCAN00_9631a86b_Tx
    CanIfPrivateCfg: CanIfPrivateSoftwareFilterType=LINEAR
    CanIfPublicCfg: CanIfPublicPnSupport=false
  module config CanSM
    CanSMConfiguration
      CHNL_0fb271d2 (CanSMManagerNetwork): CanSMComMNetworkHandleRef=ComMConfigSet/CN_CAN00_5e566ad9
        CT_CAN00_f3aba03e (CanSMController): CanSMControllerId=CanIfCtrlDrvCfg_7d254554/CT_CAN00_9df8a959
  module config Com
    ComConfig
      6 x ComIPdu, all with ComIPduType=NORMAL:
        msg_MyECU_Lamp_MxA0_oCAN00_b76f77a4_Tx: ComIPduDirection=SEND, ComIPduGroupRef=MyECU_oCAN00_Tx_1ae5d671, ComIPduSignalRef=MotorFoc_AngleRaw_MxA0_omsg_MyECU_Lamp_oCAN00_7aec7e78_Tx, ComIPduSignalRef=MotorFoc_CurrentOffsetReady_MxA0_omsg_MyECU_Lamp_oCAN00_81ce1bc4_Tx, ComIPduSignalRef=MotorFoc_CurrentOffsetSampleCount_MxA0_omsg_MyECU_Lamp_oCAN00_6c5c0a81_Tx, ComIPduSignalRef=MotorFoc_ElectricalAngle_rad_MxA0_omsg_MyECU_Lamp_oCAN00_5447ad3f_Tx, ComIPduSignalRef=MotorFoc_FaultReason_MxA0_omsg_MyECU_Lamp_oCAN00_0576dfc4_Tx, ComIPduSignalRef=MotorFoc_Fault_MxA0_omsg_MyECU_Lamp_oCAN00_3dd6add5_Tx, ComIPduSignalRef=MotorFoc_GateDriverOutputEnabled_MxA0_omsg_MyECU_Lamp_oCAN00_6012a7f7_Tx, ComIPduSignalRef=MotorFoc_GateDriverState_MxA0_omsg_MyECU_Lamp_oCAN00_e2e4dde6_Tx, ComIPduSignalRef=MotorFoc_IdRef_A_MxA0_omsg_MyECU_Lamp_oCAN00_832c12be_Tx, ComIPduSignalRef=MotorFoc_Id_A_MxA0_omsg_MyECU_Lamp_oCAN00_888850f5_Tx, ComIPduSignalRef=MotorFoc_IqRef_A_MxA0_omsg_MyECU_Lamp_oCAN00_10111ef3_Tx, ComIPduSignalRef=MotorFoc_Iq_A_MxA0_omsg_MyECU_Lamp_oCAN00_538e9670_Tx, ComIPduSignalRef=MotorFoc_Iu_A_MxA0_omsg_MyECU_Lamp_oCAN00_68113534_Tx, ComIPduSignalRef=MotorFoc_Iv_A_MxA0_omsg_MyECU_Lamp_oCAN00_7b390c47_Tx, ComIPduSignalRef=MotorFoc_Iw_A_MxA0_omsg_MyECU_Lamp_oCAN00_75dee496_Tx, ComIPduSignalRef=MotorFoc_MechanicalSpeed_rpm_MxA0_omsg_MyECU_Lamp_oCAN00_04bd2026_Tx, ComIPduSignalRef=MotorFoc_MotorMode_MxA0_omsg_MyECU_Lamp_oCAN00_aa7dbeca_Tx, ComIPduSignalRef=MotorFoc_Page_MxA0_omsg_MyECU_Lamp_oCAN00_9aab60ea_Tx, ComIPduSignalRef=MotorFoc_Vdc_V_MxA0_omsg_MyECU_Lamp_oCAN00_6919810c_Tx, ComPduIdRef=EcucPduCollection/msg_MyECU_Lamp_MxA0_oCAN00_b76f77a4_Tx
          ComTxIPdu: ComMinimumDelayTime=0, ComTxIPduUnusedAreasDefault=0
            ComTxModeTrue
              ComTxMode: ComTxModeMode=PERIODIC, ComTxModeTimeOffset=0, ComTxModeTimePeriod=0.015
        msg_MyECU_Lamp_MxA1_oCAN00_7bc5773a_Tx: ComIPduDirection=SEND, ComIPduGroupRef=MyECU_oCAN00_Tx_1ae5d671, ComIPduSignalRef=MotorFoc_FaultIu_A_MxA1_omsg_MyECU_Lamp_oCAN00_99a1880c_Tx, ComIPduSignalRef=MotorFoc_FaultIv_A_MxA1_omsg_MyECU_Lamp_oCAN00_8a89b17f_Tx, ComIPduSignalRef=MotorFoc_FaultIw_A_MxA1_omsg_MyECU_Lamp_oCAN00_846e59ae_Tx, ComIPduSignalRef=MotorFoc_FaultPwm_MxA1_omsg_MyECU_Lamp_oCAN00_e43e797b_Tx, ComIPduSignalRef=MotorFoc_FaultReasonPwm_MxA1_omsg_MyECU_Lamp_oCAN00_32050898_Tx, ComIPduSignalRef=MotorFoc_FaultVdc_V_MxA1_omsg_MyECU_Lamp_oCAN00_65447c06_Tx, ComIPduSignalRef=MotorFoc_MotorModePwm_MxA1_omsg_MyECU_Lamp_oCAN00_d3afa653_Tx, ComIPduSignalRef=MotorFoc_Page_MxA1_omsg_MyECU_Lamp_oCAN00_1b8e05cd_Tx, ComIPduSignalRef=MotorFoc_PwmPeriod_MxA1_omsg_MyECU_Lamp_oCAN00_d26baca6_Tx, ComIPduSignalRef=MotorFoc_PwmU_MxA1_omsg_MyECU_Lamp_oCAN00_c33fb364_Tx, ComIPduSignalRef=MotorFoc_PwmV_MxA1_omsg_MyECU_Lamp_oCAN00_6637d808_Tx, ComIPduSignalRef=MotorFoc_PwmW_MxA1_omsg_MyECU_Lamp_oCAN00_0530012c_Tx, ComIPduSignalRef=MotorFoc_ValphaRef_V_MxA1_omsg_MyECU_Lamp_oCAN00_dafa2b94_Tx, ComIPduSignalRef=MotorFoc_VbetaRef_V_MxA1_omsg_MyECU_Lamp_oCAN00_623c36a7_Tx, ComIPduSignalRef=MotorFoc_VdRef_V_MxA1_omsg_MyECU_Lamp_oCAN00_f0517bd4_Tx, ComIPduSignalRef=MotorFoc_VdcMax_V_MxA1_omsg_MyECU_Lamp_oCAN00_8d3d4389_Tx, ComIPduSignalRef=MotorFoc_VqRef_V_MxA1_omsg_MyECU_Lamp_oCAN00_636c7799_Tx, ComPduIdRef=EcucPduCollection/msg_MyECU_Lamp_MxA1_oCAN00_7bc5773a_Tx
          ComTxIPdu: ComMinimumDelayTime=0, ComTxIPduUnusedAreasDefault=0
            ComTxModeTrue
              ComTxMode: ComTxModeMode=PERIODIC, ComTxModeTimeOffset=0.005, ComTxModeTimePeriod=0.015
        msg_MyECU_Lamp_MxA2_oCAN00_f54a70d9_Tx: ComIPduDirection=SEND, ComIPduGroupRef=MyECU_oCAN00_Tx_1ae5d671, ComIPduSignalRef=MotorFoc_AdcFilterAlpha_MxA2_omsg_MyECU_Lamp_oCAN00_4c48c598_Tx, ComIPduSignalRef=MotorFoc_AdcFilterEnabled_MxA2_omsg_MyECU_Lamp_oCAN00_bb1a16f8_Tx, ComIPduSignalRef=MotorFoc_AdcFilterReady_MxA2_omsg_MyECU_Lamp_oCAN00_dd22f986_Tx, ComIPduSignalRef=MotorFoc_AdcOffsetSampleCount_MxA2_omsg_MyECU_Lamp_oCAN00_98a9a073_Tx, ComIPduSignalRef=MotorFoc_AdcOffsetVo1_MxA2_omsg_MyECU_Lamp_oCAN00_7e4e712f_Tx, ComIPduSignalRef=MotorFoc_AdcOffsetVo2_MxA2_omsg_MyECU_Lamp_oCAN00_db461a43_Tx, ComIPduSignalRef=MotorFoc_AdcOffsetVo3_MxA2_omsg_MyECU_Lamp_oCAN00_b841c367_Tx, ComIPduSignalRef=MotorFoc_AdcSyncCounter_MxA2_omsg_MyECU_Lamp_oCAN00_8264daf6_Tx, ComIPduSignalRef=MotorFoc_IuFiltered_A_MxA2_omsg_MyECU_Lamp_oCAN00_edadce4b_Tx, ComIPduSignalRef=MotorFoc_IuRaw_A_MxA2_omsg_MyECU_Lamp_oCAN00_ca30e9cf_Tx, ComIPduSignalRef=MotorFoc_IvFiltered_A_MxA2_omsg_MyECU_Lamp_oCAN00_3e36d2b0_Tx, ComIPduSignalRef=MotorFoc_IvRaw_A_MxA2_omsg_MyECU_Lamp_oCAN00_a7b61a95_Tx, ComIPduSignalRef=MotorFoc_IwFiltered_A_MxA2_omsg_MyECU_Lamp_oCAN00_70bfd919_Tx, ComIPduSignalRef=MotorFoc_IwRaw_A_MxA2_omsg_MyECU_Lamp_oCAN00_83344ba3_Tx, ComIPduSignalRef=MotorFoc_Page_MxA2_omsg_MyECU_Lamp_oCAN00_4390ace5_Tx, ComIPduSignalRef=MotorFoc_Vinv_V_MxA2_omsg_MyECU_Lamp_oCAN00_bd00cc55_Tx, ComIPduSignalRef=MotorFoc_Vro_V_MxA2_omsg_MyECU_Lamp_oCAN00_a894d119_Tx, ComPduIdRef=EcucPduCollection/msg_MyECU_Lamp_MxA2_oCAN00_f54a70d9_Tx
          ComTxIPdu: ComMinimumDelayTime=0, ComTxIPduUnusedAreasDefault=0
            ComTxModeTrue
              ComTxMode: ComTxModeMode=PERIODIC, ComTxModeTimeOffset=0.01, ComTxModeTimePeriod=0.015
        msg_MyECU_Lamp_Mx_oCAN00_e57ca999_Tx: ComIPduDirection=SEND, ComIPduGroupRef=MyECU_oCAN00_Tx_1ae5d671, ComIPduSignalRef=MotorFoc_Sequence_Mx_omsg_MyECU_Lamp_oCAN00_339a541d_Tx, ComPduIdRef=EcucPduCollection/msg_MyECU_Lamp_Mx_oCAN00_e57ca999_Tx
          ComTxIPdu: ComMinimumDelayTime=0, ComTxIPduUnusedAreasDefault=0
            ComTxModeTrue
              ComTxMode: ComTxModeMode=DIRECT, ComTxModeNumberOfRepetitions=0, ComTxModeRepetitionPeriod=0
        msg_Receive_oCAN00_2b456e3f_Rx: ComIPduDirection=RECEIVE, ComIPduGroupRef=MyECU_oCAN00_Rx_4cbf71f7, ComIPduSignalRef=sig_State_RearInteriorLight_omsg_Receive_oCAN00_63323183_Rx, ComIPduSignalRef=sig_State_RearLeftDoor_omsg_Receive_oCAN00_84ad4140_Rx, ComIPduSignalRef=sig_State_RearRightDoor_omsg_Receive_oCAN00_a8945098_Rx, ComPduIdRef=EcucPduCollection/msg_Receive_oCAN00_2b456e3f_Rx
        msg_Transmit_oCAN00_0723e95e_Tx: ComIPduDirection=SEND, ComIPduGroupRef=MyECU_oCAN00_Tx_1ae5d671, ComIPduSignalRef=sig_RearInteriorLight_omsg_Transmit_oCAN00_49a633c1_Tx, ComPduIdRef=EcucPduCollection/msg_Transmit_oCAN00_0723e95e_Tx
          ComTxIPdu: ComMinimumDelayTime=0, ComTxIPduUnusedAreasDefault=0
            ComTxModeFalse
              ComTxMode: ComTxModeMode=PERIODIC, ComTxModeTimeOffset=0, ComTxModeTimePeriod=0.1
            ComTxModeTrue
              ComTxMode: ComTxModeMode=PERIODIC, ComTxModeTimeOffset=0, ComTxModeTimePeriod=0.1
      MyECU_oCAN00_Rx_4cbf71f7 (ComIPduGroup)
      MyECU_oCAN00_Tx_1ae5d671 (ComIPduGroup)
      58 x ComSignal, all with ComSignalEndianness=LITTLE_ENDIAN:
        MotorFoc_AdcFilterAlpha_MxA2_omsg_MyECU_Lamp_oCAN00_4c48c598_Tx: ComBitPosition=24, ComBitSize=8, ComSignalInitValue=0, ComSignalType=UINT8, ComTransferProperty=PENDING, ComSystemTemplateSystemSignalRef=MotorFoc_AdcFilterAlpha
        MotorFoc_AdcFilterEnabled_MxA2_omsg_MyECU_Lamp_oCAN00_bb1a16f8_Tx: ComBitPosition=8, ComBitSize=8, ComSignalInitValue=0, ComSignalType=UINT8, ComTransferProperty=PENDING, ComSystemTemplateSystemSignalRef=MotorFoc_AdcFilterEnabled
        MotorFoc_AdcFilterReady_MxA2_omsg_MyECU_Lamp_oCAN00_dd22f986_Tx: ComBitPosition=16, ComBitSize=8, ComSignalInitValue=0, ComSignalType=UINT8, ComTransferProperty=PENDING, ComSystemTemplateSystemSignalRef=MotorFoc_AdcFilterReady
        MotorFoc_AdcOffsetSampleCount_MxA2_omsg_MyECU_Lamp_oCAN00_98a9a073_Tx: ComBitPosition=240, ComBitSize=16, ComSignalInitValue=0, ComSignalType=UINT16, ComTransferProperty=PENDING, ComSystemTemplateSystemSignalRef=MotorFoc_AdcOffsetSampleCount
        MotorFoc_AdcOffsetVo1_MxA2_omsg_MyECU_Lamp_oCAN00_7e4e712f_Tx: ComBitPosition=144, ComBitSize=16, ComSignalInitValue=0, ComSignalType=SINT16, ComTransferProperty=PENDING, ComSystemTemplateSystemSignalRef=MotorFoc_AdcOffsetVo1
        MotorFoc_AdcOffsetVo2_MxA2_omsg_MyECU_Lamp_oCAN00_db461a43_Tx: ComBitPosition=160, ComBitSize=16, ComSignalInitValue=0, ComSignalType=SINT16, ComTransferProperty=PENDING, ComSystemTemplateSystemSignalRef=MotorFoc_AdcOffsetVo2
        MotorFoc_AdcOffsetVo3_MxA2_omsg_MyECU_Lamp_oCAN00_b841c367_Tx: ComBitPosition=176, ComBitSize=16, ComSignalInitValue=0, ComSignalType=SINT16, ComTransferProperty=PENDING, ComSystemTemplateSystemSignalRef=MotorFoc_AdcOffsetVo3
        MotorFoc_AdcSyncCounter_MxA2_omsg_MyECU_Lamp_oCAN00_8264daf6_Tx: ComBitPosition=224, ComBitSize=16, ComSignalInitValue=0, ComSignalType=UINT16, ComTransferProperty=PENDING, ComSystemTemplateSystemSignalRef=MotorFoc_AdcSyncCounter
        MotorFoc_AngleRaw_MxA0_omsg_MyECU_Lamp_oCAN00_7aec7e78_Tx: ComBitPosition=176, ComBitSize=16, ComSignalInitValue=0, ComSignalType=UINT16, ComTransferProperty=PENDING, ComSystemTemplateSystemSignalRef=MotorFoc_AngleRaw
        MotorFoc_CurrentOffsetReady_MxA0_omsg_MyECU_Lamp_oCAN00_81ce1bc4_Tx: ComBitPosition=208, ComBitSize=8, ComSignalInitValue=0, ComSignalType=UINT8, ComTransferProperty=PENDING, ComSystemTemplateSystemSignalRef=MotorFoc_CurrentOffsetReady
        MotorFoc_CurrentOffsetSampleCount_MxA0_omsg_MyECU_Lamp_oCAN00_6c5c0a81_Tx: ComBitPosition=216, ComBitSize=8, ComSignalInitValue=0, ComSignalType=UINT8, ComTransferProperty=PENDING, ComSystemTemplateSystemSignalRef=MotorFoc_CurrentOffsetSampleCount
        MotorFoc_ElectricalAngle_rad_MxA0_omsg_MyECU_Lamp_oCAN00_5447ad3f_Tx: ComBitPosition=192, ComBitSize=16, ComSignalInitValue=0, ComSignalType=SINT16, ComTransferProperty=PENDING, ComSystemTemplateSystemSignalRef=MotorFoc_ElectricalAngle_rad
        MotorFoc_FaultIu_A_MxA1_omsg_MyECU_Lamp_oCAN00_99a1880c_Tx: ComBitPosition=192, ComBitSize=16, ComSignalInitValue=0, ComSignalType=SINT16, ComTransferProperty=PENDING, ComSystemTemplateSystemSignalRef=MotorFoc_FaultIu_A
        MotorFoc_FaultIv_A_MxA1_omsg_MyECU_Lamp_oCAN00_8a89b17f_Tx: ComBitPosition=208, ComBitSize=16, ComSignalInitValue=0, ComSignalType=SINT16, ComTransferProperty=PENDING, ComSystemTemplateSystemSignalRef=MotorFoc_FaultIv_A
        MotorFoc_FaultIw_A_MxA1_omsg_MyECU_Lamp_oCAN00_846e59ae_Tx: ComBitPosition=224, ComBitSize=16, ComSignalInitValue=0, ComSignalType=SINT16, ComTransferProperty=PENDING, ComSystemTemplateSystemSignalRef=MotorFoc_FaultIw_A
        MotorFoc_FaultPwm_MxA1_omsg_MyECU_Lamp_oCAN00_e43e797b_Tx: ComBitPosition=16, ComBitSize=8, ComSignalInitValue=0, ComSignalType=UINT8, ComTransferProperty=PENDING, ComSystemTemplateSystemSignalRef=MotorFoc_FaultPwm
        MotorFoc_FaultReasonPwm_MxA1_omsg_MyECU_Lamp_oCAN00_32050898_Tx: ComBitPosition=24, ComBitSize=8, ComSignalInitValue=0, ComSignalType=UINT8, ComTransferProperty=PENDING, ComSystemTemplateSystemSignalRef=MotorFoc_FaultReasonPwm
        MotorFoc_FaultReason_MxA0_omsg_MyECU_Lamp_oCAN00_0576dfc4_Tx: ComBitPosition=24, ComBitSize=8, ComSignalInitValue=0, ComSignalType=UINT8, ComTransferProperty=PENDING, ComSystemTemplateSystemSignalRef=MotorFoc_FaultReason
        MotorFoc_FaultVdc_V_MxA1_omsg_MyECU_Lamp_oCAN00_65447c06_Tx: ComBitPosition=240, ComBitSize=16, ComSignalInitValue=0, ComSignalType=SINT16, ComTransferProperty=PENDING, ComSystemTemplateSystemSignalRef=MotorFoc_FaultVdc_V
        MotorFoc_Fault_MxA0_omsg_MyECU_Lamp_oCAN00_3dd6add5_Tx: ComBitPosition=16, ComBitSize=8, ComSignalInitValue=0, ComSignalType=UINT8, ComTransferProperty=PENDING, ComSystemTemplateSystemSignalRef=MotorFoc_Fault
        MotorFoc_GateDriverOutputEnabled_MxA0_omsg_MyECU_Lamp_oCAN00_6012a7f7_Tx: ComBitPosition=248, ComBitSize=8, ComSignalInitValue=0, ComSignalType=UINT8, ComTransferProperty=PENDING, ComSystemTemplateSystemSignalRef=MotorFoc_GateDriverOutputEnabled
        MotorFoc_GateDriverState_MxA0_omsg_MyECU_Lamp_oCAN00_e2e4dde6_Tx: ComBitPosition=240, ComBitSize=8, ComSignalInitValue=0, ComSignalType=UINT8, ComTransferProperty=PENDING, ComSystemTemplateSystemSignalRef=MotorFoc_GateDriverState
        MotorFoc_IdRef_A_MxA0_omsg_MyECU_Lamp_oCAN00_832c12be_Tx: ComBitPosition=48, ComBitSize=16, ComSignalInitValue=0, ComSignalType=SINT16, ComTransferProperty=PENDING, ComSystemTemplateSystemSignalRef=MotorFoc_IdRef_A
        MotorFoc_Id_A_MxA0_omsg_MyECU_Lamp_oCAN00_888850f5_Tx: ComBitPosition=80, ComBitSize=16, ComSignalInitValue=0, ComSignalType=SINT16, ComTransferProperty=PENDING, ComSystemTemplateSystemSignalRef=MotorFoc_Id_A
        MotorFoc_IqRef_A_MxA0_omsg_MyECU_Lamp_oCAN00_10111ef3_Tx: ComBitPosition=64, ComBitSize=16, ComSignalInitValue=0, ComSignalType=SINT16, ComTransferProperty=PENDING, ComSystemTemplateSystemSignalRef=MotorFoc_IqRef_A
        MotorFoc_Iq_A_MxA0_omsg_MyECU_Lamp_oCAN00_538e9670_Tx: ComBitPosition=96, ComBitSize=16, ComSignalInitValue=0, ComSignalType=SINT16, ComTransferProperty=PENDING, ComSystemTemplateSystemSignalRef=MotorFoc_Iq_A
        MotorFoc_IuFiltered_A_MxA2_omsg_MyECU_Lamp_oCAN00_edadce4b_Tx: ComBitPosition=96, ComBitSize=16, ComSignalInitValue=0, ComSignalType=SINT16, ComTransferProperty=PENDING, ComSystemTemplateSystemSignalRef=MotorFoc_IuFiltered_A
        MotorFoc_IuRaw_A_MxA2_omsg_MyECU_Lamp_oCAN00_ca30e9cf_Tx: ComBitPosition=48, ComBitSize=16, ComSignalInitValue=0, ComSignalType=SINT16, ComTransferProperty=PENDING, ComSystemTemplateSystemSignalRef=MotorFoc_IuRaw_A
        MotorFoc_Iu_A_MxA0_omsg_MyECU_Lamp_oCAN00_68113534_Tx: ComBitPosition=112, ComBitSize=16, ComSignalInitValue=0, ComSignalType=SINT16, ComTransferProperty=PENDING, ComSystemTemplateSystemSignalRef=MotorFoc_Iu_A
        MotorFoc_IvFiltered_A_MxA2_omsg_MyECU_Lamp_oCAN00_3e36d2b0_Tx: ComBitPosition=112, ComBitSize=16, ComSignalInitValue=0, ComSignalType=SINT16, ComTransferProperty=PENDING, ComSystemTemplateSystemSignalRef=MotorFoc_IvFiltered_A
        MotorFoc_IvRaw_A_MxA2_omsg_MyECU_Lamp_oCAN00_a7b61a95_Tx: ComBitPosition=64, ComBitSize=16, ComSignalInitValue=0, ComSignalType=SINT16, ComTransferProperty=PENDING, ComSystemTemplateSystemSignalRef=MotorFoc_IvRaw_A
        MotorFoc_Iv_A_MxA0_omsg_MyECU_Lamp_oCAN00_7b390c47_Tx: ComBitPosition=128, ComBitSize=16, ComSignalInitValue=0, ComSignalType=SINT16, ComTransferProperty=PENDING, ComSystemTemplateSystemSignalRef=MotorFoc_Iv_A
        MotorFoc_IwFiltered_A_MxA2_omsg_MyECU_Lamp_oCAN00_70bfd919_Tx: ComBitPosition=128, ComBitSize=16, ComSignalInitValue=0, ComSignalType=SINT16, ComTransferProperty=PENDING, ComSystemTemplateSystemSignalRef=MotorFoc_IwFiltered_A
        MotorFoc_IwRaw_A_MxA2_omsg_MyECU_Lamp_oCAN00_83344ba3_Tx: ComBitPosition=80, ComBitSize=16, ComSignalInitValue=0, ComSignalType=SINT16, ComTransferProperty=PENDING, ComSystemTemplateSystemSignalRef=MotorFoc_IwRaw_A
        MotorFoc_Iw_A_MxA0_omsg_MyECU_Lamp_oCAN00_75dee496_Tx: ComBitPosition=144, ComBitSize=16, ComSignalInitValue=0, ComSignalType=SINT16, ComTransferProperty=PENDING, ComSystemTemplateSystemSignalRef=MotorFoc_Iw_A
        MotorFoc_MechanicalSpeed_rpm_MxA0_omsg_MyECU_Lamp_oCAN00_04bd2026_Tx: ComBitPosition=224, ComBitSize=16, ComSignalInitValue=0, ComSignalType=SINT16, ComTransferProperty=PENDING, ComSystemTemplateSystemSignalRef=MotorFoc_MechanicalSpeed_rpm
        MotorFoc_MotorModePwm_MxA1_omsg_MyECU_Lamp_oCAN00_d3afa653_Tx: ComBitPosition=8, ComBitSize=8, ComSignalInitValue=0, ComSignalType=UINT8, ComTransferProperty=PENDING, ComSystemTemplateSystemSignalRef=MotorFoc_MotorModePwm
        MotorFoc_MotorMode_MxA0_omsg_MyECU_Lamp_oCAN00_aa7dbeca_Tx: ComBitPosition=8, ComBitSize=8, ComSignalInitValue=0, ComSignalType=UINT8, ComTransferProperty=PENDING, ComSystemTemplateSystemSignalRef=MotorFoc_MotorMode
        MotorFoc_Page_MxA0_omsg_MyECU_Lamp_oCAN00_9aab60ea_Tx: ComBitPosition=0, ComBitSize=8, ComSignalInitValue=160, ComSignalType=UINT8, ComTransferProperty=PENDING, ComSystemTemplateSystemSignalRef=MotorFoc_Page
        MotorFoc_Page_MxA1_omsg_MyECU_Lamp_oCAN00_1b8e05cd_Tx: ComBitPosition=0, ComBitSize=8, ComSignalInitValue=161, ComSignalType=UINT8, ComTransferProperty=PENDING, ComSystemTemplateSystemSignalRef=MotorFoc_Page
        MotorFoc_Page_MxA2_omsg_MyECU_Lamp_oCAN00_4390ace5_Tx: ComBitPosition=0, ComBitSize=8, ComSignalInitValue=162, ComSignalType=UINT8, ComTransferProperty=PENDING, ComSystemTemplateSystemSignalRef=MotorFoc_Page
        MotorFoc_PwmPeriod_MxA1_omsg_MyECU_Lamp_oCAN00_d26baca6_Tx: ComBitPosition=160, ComBitSize=16, ComSignalInitValue=0, ComSignalType=UINT16, ComTransferProperty=PENDING, ComSystemTemplateSystemSignalRef=MotorFoc_PwmPeriod
        MotorFoc_PwmU_MxA1_omsg_MyECU_Lamp_oCAN00_c33fb364_Tx: ComBitPosition=112, ComBitSize=16, ComSignalInitValue=0, ComSignalType=UINT16, ComTransferProperty=PENDING, ComSystemTemplateSystemSignalRef=MotorFoc_PwmU
        MotorFoc_PwmV_MxA1_omsg_MyECU_Lamp_oCAN00_6637d808_Tx: ComBitPosition=128, ComBitSize=16, ComSignalInitValue=0, ComSignalType=UINT16, ComTransferProperty=PENDING, ComSystemTemplateSystemSignalRef=MotorFoc_PwmV
        MotorFoc_PwmW_MxA1_omsg_MyECU_Lamp_oCAN00_0530012c_Tx: ComBitPosition=144, ComBitSize=16, ComSignalInitValue=0, ComSignalType=UINT16, ComTransferProperty=PENDING, ComSystemTemplateSystemSignalRef=MotorFoc_PwmW
        MotorFoc_Sequence_Mx_omsg_MyECU_Lamp_oCAN00_339a541d_Tx: ComBitPosition=32, ComBitSize=16, ComSignalInitValue=0, ComSignalType=UINT16, ComTransferProperty=TRIGGERED_WITHOUT_REPETITION, ComSystemTemplateSystemSignalRef=MotorFoc_Sequence
        MotorFoc_ValphaRef_V_MxA1_omsg_MyECU_Lamp_oCAN00_dafa2b94_Tx: ComBitPosition=80, ComBitSize=16, ComSignalInitValue=0, ComSignalType=SINT16, ComTransferProperty=PENDING, ComSystemTemplateSystemSignalRef=MotorFoc_ValphaRef_V
        MotorFoc_VbetaRef_V_MxA1_omsg_MyECU_Lamp_oCAN00_623c36a7_Tx: ComBitPosition=96, ComBitSize=16, ComSignalInitValue=0, ComSignalType=SINT16, ComTransferProperty=PENDING, ComSystemTemplateSystemSignalRef=MotorFoc_VbetaRef_V
        MotorFoc_VdRef_V_MxA1_omsg_MyECU_Lamp_oCAN00_f0517bd4_Tx: ComBitPosition=48, ComBitSize=16, ComSignalInitValue=0, ComSignalType=SINT16, ComTransferProperty=PENDING, ComSystemTemplateSystemSignalRef=MotorFoc_VdRef_V
        MotorFoc_VdcMax_V_MxA1_omsg_MyECU_Lamp_oCAN00_8d3d4389_Tx: ComBitPosition=176, ComBitSize=16, ComSignalInitValue=0, ComSignalType=SINT16, ComTransferProperty=PENDING, ComSystemTemplateSystemSignalRef=MotorFoc_VdcMax_V
        MotorFoc_Vdc_V_MxA0_omsg_MyECU_Lamp_oCAN00_6919810c_Tx: ComBitPosition=160, ComBitSize=16, ComSignalInitValue=0, ComSignalType=SINT16, ComTransferProperty=PENDING, ComSystemTemplateSystemSignalRef=MotorFoc_Vdc_V
        MotorFoc_Vinv_V_MxA2_omsg_MyECU_Lamp_oCAN00_bd00cc55_Tx: ComBitPosition=208, ComBitSize=16, ComSignalInitValue=0, ComSignalType=SINT16, ComTransferProperty=PENDING, ComSystemTemplateSystemSignalRef=MotorFoc_Vinv_V
        MotorFoc_VqRef_V_MxA1_omsg_MyECU_Lamp_oCAN00_636c7799_Tx: ComBitPosition=64, ComBitSize=16, ComSignalInitValue=0, ComSignalType=SINT16, ComTransferProperty=PENDING, ComSystemTemplateSystemSignalRef=MotorFoc_VqRef_V
        MotorFoc_Vro_V_MxA2_omsg_MyECU_Lamp_oCAN00_a894d119_Tx: ComBitPosition=192, ComBitSize=16, ComSignalInitValue=0, ComSignalType=SINT16, ComTransferProperty=PENDING, ComSystemTemplateSystemSignalRef=MotorFoc_Vro_V
        sig_RearInteriorLight_omsg_Transmit_oCAN00_49a633c1_Tx: ComBitPosition=0, ComBitSize=1, ComSignalInitValue=0, ComSignalType=BOOLEAN, ComTransferProperty=PENDING, ComSystemTemplateSystemSignalRef=sig_RearInteriorLight
        sig_State_RearInteriorLight_omsg_Receive_oCAN00_63323183_Rx: ComBitPosition=2, ComBitSize=1, ComSignalInitValue=0, ComSignalType=BOOLEAN, ComTimeout=0, ComSystemTemplateSystemSignalRef=sig_State_RearInteriorLight
        sig_State_RearLeftDoor_omsg_Receive_oCAN00_84ad4140_Rx: ComBitPosition=0, ComBitSize=1, ComSignalInitValue=0, ComSignalType=BOOLEAN, ComTimeout=0, ComSystemTemplateSystemSignalRef=sig_State_RearLeftDoor
        sig_State_RearRightDoor_omsg_Receive_oCAN00_a8945098_Rx: ComBitPosition=1, ComBitSize=1, ComSignalInitValue=0, ComSignalType=BOOLEAN, ComTimeout=0, ComSystemTemplateSystemSignalRef=sig_State_RearRightDoor
    ComGeneral
  module config ComM
    ComMConfigSet: ComMPncEnabled=false
      CN_CAN00_5e566ad9 (ComMChannel): ComMBusType=COMM_BUS_TYPE_CAN, ComMChannelId=0
        ComMNetworkManagement: ComMNmVariant=NONE
        CN_CAN00_cd7594b0 (ComMUserPerChannel): ComMUserChannel=CN_CAN00_06ecbb07
      CN_CAN00_06ecbb07 (ComMUser): ComMUserIdentifier=0
    ComMGeneral: ComMPncIdCounting=COMM_PNC_ID_COUNT_FROM_NM_MESSAGE, ComMPncSupport=false
  module config EcuC
    EcucPduCollection: PduIdTypeEnum=UINT8, PduLengthTypeEnum=UINT8
      10 x Pdu, all with DynamicLength=false:
        msg_MyECU_Lamp_MxA0_oCAN00_b76f77a4_Tx: PduLength=32
        msg_MyECU_Lamp_MxA1_oCAN00_7bc5773a_Tx: PduLength=32
        msg_MyECU_Lamp_MxA2_oCAN00_f54a70d9_Tx: PduLength=32
        msg_MyECU_Lamp_Mx_oCAN00_e57ca999_Tx: PduLength=32
        msg_MyECU_Lamp_oCAN00_26f3473b_Tx: PduLength=32, SysTPduToFrameMappingRef=msg_MyECU_Lamp
        msg_MyECU_Lamp_oCAN00_818e1651_Tx: PduLength=32
        msg_Receive_oCAN00_2b456e3f_Rx: PduLength=1
        msg_Receive_oCAN00_3867e0b8_Rx: PduLength=1, SysTPduToFrameMappingRef=msg_Receive
        msg_Transmit_oCAN00_0723e95e_Tx: PduLength=1
        msg_Transmit_oCAN00_9631a86b_Tx: PduLength=1, SysTPduToFrameMappingRef=msg_Transmit
  module config EcuM
    EcuMConfiguration
      EcuMCommonConfiguration
        EcuMDriverInitListOne
        EcuMDriverRestartList
        CN_CAN00_5e566ad9 (EcuMWakeupSource): EcuMWakeupSourceId=5, EcuMComMChannelRef=ComMConfigSet/CN_CAN00_5e566ad9
      EcuMFlexConfiguration: EcuMFlexModuleConfigurationRef=CanConfigSet
  module config IpduM
    IpduMConfig
      msg_MyECU_Lamp_oCAN00_818e1651_Tx (IpduMTxPathway)
        IpduMTxRequest_30b6d8a0 (IpduMTxRequest):
          IpduMByteOrder = LITTLE_ENDIAN
          IpduMIPduUnusedAreasDefault = 0
          IpduMInitialDynamicPart = msg_MyECU_Lamp_oCAN00_abcb4e0d
          IpduMOutgoingPduRef = EcucPduCollection/msg_MyECU_Lamp_oCAN00_818e1651_Tx
          IpduMSelectorFieldPosition: IpduMSelectorFieldLength=8, IpduMSelectorFieldPosition=0
          3 x IpduMTxDynamicPart:
            msg_MyECU_Lamp_oCAN00_67614e93: IpduMTxDynamicPduRef=EcucPduCollection/msg_MyECU_Lamp_MxA1_oCAN00_7bc5773a_Tx
              IpduMSegment_0 (IpduMSegment): IpduMSegmentLength=32, IpduMSegmentPosition=0
              IpduMSegment_48 (IpduMSegment): IpduMSegmentLength=208, IpduMSegmentPosition=48
            msg_MyECU_Lamp_oCAN00_abcb4e0d: IpduMTxDynamicPduRef=EcucPduCollection/msg_MyECU_Lamp_MxA0_oCAN00_b76f77a4_Tx
              IpduMSegment_0 (IpduMSegment): IpduMSegmentLength=32, IpduMSegmentPosition=0
              IpduMSegment_48 (IpduMSegment): IpduMSegmentLength=208, IpduMSegmentPosition=48
            msg_MyECU_Lamp_oCAN00_e9ee4970: IpduMTxDynamicPduRef=EcucPduCollection/msg_MyECU_Lamp_MxA2_oCAN00_f54a70d9_Tx
              IpduMSegment_0 (IpduMSegment): IpduMSegmentLength=32, IpduMSegmentPosition=0
              IpduMSegment_48 (IpduMSegment): IpduMSegmentLength=208, IpduMSegmentPosition=48
          msg_MyECU_Lamp_oCAN00_6ae678ab (IpduMTxStaticPart): IpduMTxStaticPduRef=EcucPduCollection/msg_MyECU_Lamp_Mx_oCAN00_e57ca999_Tx
            IpduMSegment_32 (IpduMSegment): IpduMSegmentLength=16, IpduMSegmentPosition=32
    IpduMGeneral: IpduMStaticPartExists=true
  module config PduR
    PduRGeneral
    PduRRoutingTables
      PduRRoutingTable
        7 x PduRRoutingPath:
          msg_MyECU_Lamp_MxA0_oCAN00_b76f77a4_Tx
            msg_MyECU_Lamp_MxA0_oCAN00_b76f77a4_Tx (PduRDestPdu): PduRDestPduRef=EcucPduCollection/msg_MyECU_Lamp_MxA0_oCAN00_b76f77a4_Tx
            PduRSrcPdu_991c8b02 (PduRSrcPdu): PduRSrcPduRef=EcucPduCollection/msg_MyECU_Lamp_MxA0_oCAN00_b76f77a4_Tx
          msg_MyECU_Lamp_MxA1_oCAN00_7bc5773a_Tx
            msg_MyECU_Lamp_MxA1_oCAN00_7bc5773a_Tx (PduRDestPdu): PduRDestPduRef=EcucPduCollection/msg_MyECU_Lamp_MxA1_oCAN00_7bc5773a_Tx
            PduRSrcPdu_f7c31f09 (PduRSrcPdu): PduRSrcPduRef=EcucPduCollection/msg_MyECU_Lamp_MxA1_oCAN00_7bc5773a_Tx
          msg_MyECU_Lamp_MxA2_oCAN00_f54a70d9_Tx
            msg_MyECU_Lamp_MxA2_oCAN00_f54a70d9_Tx (PduRDestPdu): PduRDestPduRef=EcucPduCollection/msg_MyECU_Lamp_MxA2_oCAN00_f54a70d9_Tx
            PduRSrcPdu_e44218bb (PduRSrcPdu): PduRSrcPduRef=EcucPduCollection/msg_MyECU_Lamp_MxA2_oCAN00_f54a70d9_Tx
          msg_MyECU_Lamp_Mx_oCAN00_e57ca999_Tx
            msg_MyECU_Lamp_Mx_oCAN00_e57ca999_Tx (PduRDestPdu): PduRDestPduRef=EcucPduCollection/msg_MyECU_Lamp_Mx_oCAN00_e57ca999_Tx
            PduRSrcPdu_289484a7 (PduRSrcPdu): PduRSrcPduRef=EcucPduCollection/msg_MyECU_Lamp_Mx_oCAN00_e57ca999_Tx
          msg_MyECU_Lamp_oCAN00_818e1651_Tx
            msg_MyECU_Lamp_oCAN00_26f3473b_Tx (PduRDestPdu): PduRDestPduRef=EcucPduCollection/msg_MyECU_Lamp_oCAN00_26f3473b_Tx
            PduRSrcPdu_8e8b997f (PduRSrcPdu): PduRSrcPduRef=EcucPduCollection/msg_MyECU_Lamp_oCAN00_818e1651_Tx
          msg_Receive_oCAN00_3867e0b8_Rx
            msg_Receive_oCAN00_3867e0b8_Rx_16740ed0_Rx (PduRDestPdu): PduRDestPduRef=EcucPduCollection/msg_Receive_oCAN00_2b456e3f_Rx
            PduRSrcPdu_16740ed0 (PduRSrcPdu): PduRSrcPduRef=EcucPduCollection/msg_Receive_oCAN00_3867e0b8_Rx
          msg_Transmit_oCAN00_0723e95e_Tx
            msg_Transmit_oCAN00_9631a86b_Tx (PduRDestPdu): PduRDestPduRef=EcucPduCollection/msg_Transmit_oCAN00_9631a86b_Tx
            PduRSrcPdu_087fd70d (PduRSrcPdu): PduRSrcPduRef=EcucPduCollection/msg_Transmit_oCAN00_0723e95e_Tx
