AUTOSAR XML (schema 00048)
package /InitialEcuC
  ecuc value collection InitialEcuC: ecuc-values=[Can, CanIf, CanSM, CanTp, Com, ComM, Dcm, Dem, EcuC, EcuM, PduR]
  module config Can
    CanConfigSet
      CT_CAN00_9df8a959 (CanController):  # CAN00
        CanControllerActivation = true
        CanControllerDefaultBaudrate = CanControllerBaudrateConfig
        CanControllerSystemRef = CT_CAN00
        CanWakeupSourceRef = EcuMCommonConfiguration/CN_CAN00_5e566ad9
        CanControllerBaudrateConfig: CanControllerBaudRate=500
          CanControllerFdBaudrateConfig: CanControllerFdBaudRate=500
      CN_CAN00_5e566ad9_Tx (CanHardwareObject): CanHandleType=BASIC, CanIdValue=0, CanObjectType=TRANSMIT, CanControllerRef=CanConfigSet/CT_CAN00_9df8a959
      CN_CAN00_770af0b0_Rx (CanHardwareObject): CanHandleType=BASIC, CanIdType=STANDARD, CanIdValue=0, CanObjectType=RECEIVE, CanControllerRef=CanConfigSet/CT_CAN00_9df8a959
    CanGeneral: CanIndex=0
  module config CanIf
    CanIfCtrlDrvCfg_7d254554 (CanIfCtrlDrvCfg): CanIfCtrlDrvInitHohConfigRef=CanIfInitHohCfg, CanIfCtrlDrvNameRef=CanGeneral
      CT_CAN00_9df8a959 (CanIfCtrlCfg): CanIfCtrlCanCtrlRef=CanConfigSet/CT_CAN00_9df8a959
    CanIfInitCfg
      CHNL_0fb271d2 (CanIfBufferCfg): CanIfBufferSize=0, CanIfBufferHthRef=CanIfInitHohCfg/CN_CAN00_5e566ad9_Tx
      CanIfInitHohCfg: CanIfInitRefCfgSet=CanConfigSet
        CN_CAN00_770af0b0_Rx (CanIfHrhCfg): CanIfHrhCanCtrlIdRef=CanIfCtrlDrvCfg_7d254554/CT_CAN00_9df8a959, CanIfHrhIdSymRef=CanConfigSet/CN_CAN00_770af0b0_Rx
        CN_CAN00_5e566ad9_Tx (CanIfHthCfg): CanIfHthCanCtrlIdRef=CanIfCtrlDrvCfg_7d254554/CT_CAN00_9df8a959, CanIfHthIdSymRef=CanConfigSet/CN_CAN00_5e566ad9_Tx
      3 x CanIfRxPduCfg, all with CanIfRxPduHrhIdRef=CanIfInitHohCfg/CN_CAN00_770af0b0_Rx:
        msg_Receive_oCAN00_76f25845_Rx: CanIfRxPduCanId=528, CanIfRxPduCanIdType=STANDARD_CAN, CanIfRxPduDlc=1, CanIfRxPduUserRxIndicationName=PduR_CanIfRxIndication, CanIfRxPduUserRxIndicationUL=PDUR, CanIfRxPduRef=EcucPduCollection/msg_Receive_oCAN00_3867e0b8_Rx
        msg_diag_RequestGlobal_Tp_oCAN00_5c56b065_Rx: CanIfRxPduCanId=2015, CanIfRxPduCanIdType=STANDARD_NO_FD_CAN, CanIfRxPduDlc=8, CanIfRxPduUserRxIndicationName=CanTp_RxIndication, CanIfRxPduUserRxIndicationType=PDUID_PDUINFOPTR, CanIfRxPduUserRxIndicationUL=CAN_TP, CanIfRxPduRef=msg_diag_RequestGlobal_Tp_oCAN00_7b1e9193_Rx
        msg_diag_Request_MyECU_Tp_oCAN00_2c5ccddc_Rx: CanIfRxPduCanId=1868, CanIfRxPduCanIdType=STANDARD_NO_FD_CAN, CanIfRxPduDlc=8, CanIfRxPduUserRxIndicationName=CanTp_RxIndication, CanIfRxPduUserRxIndicationType=PDUID_PDUINFOPTR, CanIfRxPduUserRxIndicationUL=CAN_TP, CanIfRxPduRef=msg_diag_Request_MyECU_Tp_oCAN00_ecbacca2_Rx
      3 x CanIfTxPduCfg, all with CanIfTxPduBufferRef=CanIfInitCfg/CHNL_0fb271d2:
        msg_MotorStatus_oCAN00_41e9a736_Tx: CanIfTxPduCanId=1297, CanIfTxPduCanIdType=STANDARD_FD_CAN, CanIfTxPduDlc=12, CanIfTxPduUserTxConfirmationName=PduR_CanIfTxConfirmation, CanIfTxPduUserTxConfirmationUL=PDUR, CanIfTxPduRef=EcucPduCollection/msg_MotorStatus_oCAN00_a6063320_Tx
        msg_Transmit_oCAN00_29db34a4_Tx: CanIfTxPduCanId=512, CanIfTxPduCanIdType=STANDARD_CAN, CanIfTxPduDlc=1, CanIfTxPduUserTxConfirmationName=PduR_CanIfTxConfirmation, CanIfTxPduUserTxConfirmationUL=PDUR, CanIfTxPduRef=EcucPduCollection/msg_Transmit_oCAN00_9631a86b_Tx
        msg_diag_Response_MyECU_Tp_oCAN00_59e48f7a_Tx: CanIfTxPduCanId=1884, CanIfTxPduCanIdType=STANDARD_CAN, CanIfTxPduDlc=8, CanIfTxPduUserTxConfirmationName=CanTp_TxConfirmation, CanIfTxPduUserTxConfirmationUL=CAN_TP, CanIfTxPduRef=msg_diag_Response_MyECU_Tp_oCAN00_0ed9d144_Tx
    CanIfPrivateCfg: CanIfPrivateSoftwareFilterType=LINEAR
    CanIfPublicCfg: CanIfPublicPnSupport=false
  module config CanSM
    CanSMConfiguration
      CHNL_0fb271d2 (CanSMManagerNetwork): CanSMComMNetworkHandleRef=ComMConfigSet/CN_CAN00_5e566ad9
        CT_CAN00_f3aba03e (CanSMController): CanSMControllerId=CanIfCtrlDrvCfg_7d254554/CT_CAN00_9df8a959
  module config CanTp
    CanTpConfig: CanTpMainFunctionPeriod=0.005
      TPCH_55d4e4b9 (CanTpChannel): CanTpChannelMode=CANTP_MODE_FULL_DUPLEX
        CanTpRxNSdu_550eef02 (CanTpRxNSdu):
          CanTpRxAddressingFormat = CANTP_STANDARD
          CanTpRxDl = 8
          CanTpRxTaType = CANTP_PHYSICAL
          CanTpRxNSduRef = EcucPduCollection/msg_diag_Request_MyECU_oCAN00_a823f7ba_Rx
          CanTpRxNPdu_07b2877d (CanTpRxNPdu): CanTpRxNPduRef=msg_diag_Request_MyECU_Tp_oCAN00_ecbacca2_Rx
          CanTpTxFcNPdu_07b2877d (CanTpTxFcNPdu): CanTpTxFcNPduRef=msg_diag_Response_MyECU_Tp_oCAN00_0ed9d144_Tx
        CanTpTxNSdu_550eef02 (CanTpTxNSdu):
          CanTpTxAddressingFormat = CANTP_STANDARD
          CanTpTxDl = 8
          CanTpTxTaType = CANTP_PHYSICAL
          CanTpTxNSduRef = EcucPduCollection/msg_diag_Response_MyECU_oCAN00_45311294_Tx
          CanTpRxFcNPdu_2548538f (CanTpRxFcNPdu): CanTpRxFcNPduRef=msg_diag_Request_MyECU_Tp_oCAN00_ecbacca2_Rx
          CanTpTxNPdu_2548538f (CanTpTxNPdu): CanTpTxNPduRef=msg_diag_Response_MyECU_Tp_oCAN00_0ed9d144_Tx
      TPCH_c1f2f0aa (CanTpChannel): CanTpChannelMode=CANTP_MODE_FULL_DUPLEX
        CanTpRxNSdu_aba1e8cc (CanTpRxNSdu):
          CanTpRxAddressingFormat = CANTP_STANDARD
          CanTpRxDl = 8
          CanTpRxTaType = CANTP_PHYSICAL
          CanTpRxNSduRef = EcucPduCollection/msg_diag_RequestGlobal_oCAN00_38f4a687_Rx
          CanTpRxNPdu_a4c851d5 (CanTpRxNPdu): CanTpRxNPduRef=msg_diag_RequestGlobal_Tp_oCAN00_7b1e9193_Rx
          CanTpTxFcNPdu_a4c851d5 (CanTpTxFcNPdu): CanTpTxFcNPduRef=msg_diag_Response_MyECU_Tp_oCAN00_0ed9d144_Tx
  module config Com
    ComConfig
      3 x ComIPdu, all with ComIPduType=NORMAL:
        msg_MotorStatus_oCAN00_71118836_Tx: ComIPduDirection=SEND, ComIPduGroupRef=MyECU_oCAN00_Tx_1ae5d671, ComIPduSignalRef=ElectricAngle_omsg_MotorStatus_oCAN00_59d7c624_Tx, ComIPduSignalRef=Id_Ref_omsg_MotorStatus_oCAN00_d6855f80_Tx, ComIPduSignalRef=Iq_Ref_omsg_MotorStatus_oCAN00_64246970_Tx, ComIPduSignalRef=MotorMode_omsg_MotorStatus_oCAN00_b2c82a54_Tx, ComIPduSignalRef=Vbus_omsg_MotorStatus_oCAN00_85810386_Tx, ComIPduSignalRef=tle9180_Ov_Fault_omsg_MotorStatus_oCAN00_fd6f0927_Tx, ComPduIdRef=EcucPduCollection/msg_MotorStatus_oCAN00_71118836_Tx
          ComTxIPdu: ComMinimumDelayTime=0, ComTxIPduUnusedAreasDefault=0
            ComTxModeFalse
              ComTxMode: ComTxModeMode=PERIODIC, ComTxModeTimeOffset=0, ComTxModeTimePeriod=0.005
            ComTxModeTrue
              ComTxMode: ComTxModeMode=PERIODIC, ComTxModeTimeOffset=0, ComTxModeTimePeriod=0.005
        msg_Receive_oCAN00_2b456e3f_Rx: ComIPduDirection=RECEIVE, ComIPduGroupRef=MyECU_oCAN00_Rx_4cbf71f7, ComIPduSignalRef=sig_State_RearInteriorLight_omsg_Receive_oCAN00_63323183_Rx, ComIPduSignalRef=sig_State_RearLeftDoor_omsg_Receive_oCAN00_84ad4140_Rx, ComIPduSignalRef=sig_State_RearRightDoor_omsg_Receive_oCAN00_a8945098_Rx, ComPduIdRef=EcucPduCollection/msg_Receive_oCAN00_2b456e3f_Rx
        msg_Transmit_oCAN00_0723e95e_Tx: ComIPduDirection=SEND, ComIPduGroupRef=MyECU_oCAN00_Tx_1ae5d671, ComIPduSignalRef=sig_RearInteriorLight_omsg_Transmit_oCAN00_49a633c1_Tx, ComPduIdRef=EcucPduCollection/msg_Transmit_oCAN00_0723e95e_Tx
          ComTxIPdu: ComMinimumDelayTime=0, ComTxIPduUnusedAreasDefault=0
            ComTxModeFalse
              ComTxMode: ComTxModeMode=PERIODIC, ComTxModeTimeOffset=0, ComTxModeTimePeriod=0.1
            ComTxModeTrue
              ComTxMode: ComTxModeMode=PERIODIC, ComTxModeTimeOffset=0, ComTxModeTimePeriod=0.1
      MyECU_oCAN00_Rx_4cbf71f7 (ComIPduGroup)
      MyECU_oCAN00_Tx_1ae5d671 (ComIPduGroup)
      10 x ComSignal, all with ComSignalEndianness=LITTLE_ENDIAN, ComSignalInitValue=0:
        ElectricAngle_omsg_MotorStatus_oCAN00_59d7c624_Tx: ComBitPosition=64, ComBitSize=16, ComSignalType=SINT16, ComTransferProperty=PENDING, ComSystemTemplateSystemSignalRef=ElectricAngle
        Id_Ref_omsg_MotorStatus_oCAN00_d6855f80_Tx: ComBitPosition=16, ComBitSize=16, ComSignalType=SINT16, ComTransferProperty=PENDING, ComSystemTemplateSystemSignalRef=Id_Ref
        Iq_Ref_omsg_MotorStatus_oCAN00_64246970_Tx: ComBitPosition=32, ComBitSize=16, ComSignalType=SINT16, ComTransferProperty=PENDING, ComSystemTemplateSystemSignalRef=Iq_Ref
        MotorMode_omsg_MotorStatus_oCAN00_b2c82a54_Tx: ComBitPosition=0, ComBitSize=8, ComSignalType=UINT8, ComTransferProperty=PENDING, ComSystemTemplateSystemSignalRef=MotorMode
        Vbus_omsg_MotorStatus_oCAN00_85810386_Tx: ComBitPosition=48, ComBitSize=16, ComSignalType=SINT16, ComTransferProperty=PENDING, ComSystemTemplateSystemSignalRef=Vbus
        sig_RearInteriorLight_omsg_Transmit_oCAN00_49a633c1_Tx: ComBitPosition=0, ComBitSize=1, ComSignalType=BOOLEAN, ComTransferProperty=PENDING, ComSystemTemplateSystemSignalRef=sig_RearInteriorLight
        sig_State_RearInteriorLight_omsg_Receive_oCAN00_63323183_Rx: ComBitPosition=2, ComBitSize=1, ComSignalType=BOOLEAN, ComTimeout=0, ComSystemTemplateSystemSignalRef=sig_State_RearInteriorLight
        sig_State_RearLeftDoor_omsg_Receive_oCAN00_84ad4140_Rx: ComBitPosition=0, ComBitSize=1, ComSignalType=BOOLEAN, ComTimeout=0, ComSystemTemplateSystemSignalRef=sig_State_RearLeftDoor
        sig_State_RearRightDoor_omsg_Receive_oCAN00_a8945098_Rx: ComBitPosition=1, ComBitSize=1, ComSignalType=BOOLEAN, ComTimeout=0, ComSystemTemplateSystemSignalRef=sig_State_RearRightDoor
        tle9180_Ov_Fault_omsg_MotorStatus_oCAN00_fd6f0927_Tx: ComBitPosition=8, ComBitSize=1, ComSignalType=BOOLEAN, ComTransferProperty=PENDING, ComSystemTemplateSystemSignalRef=tle9180_Ov_Fault
    ComGeneral
  module config ComM
    ComMConfigSet: ComMPncEnabled=false
      CN_CAN00_5e566ad9 (ComMChannel): ComMBusType=COMM_BUS_TYPE_CAN, ComMChannelId=0
        ComMNetworkManagement: ComMNmVariant=NONE
        CN_CAN00_cd7594b0 (ComMUserPerChannel): ComMUserChannel=CN_CAN00_06ecbb07
      CN_CAN00_06ecbb07 (ComMUser): ComMUserIdentifier=0
    ComMGeneral: ComMPncIdCounting=COMM_PNC_ID_COUNT_FROM_NM_MESSAGE, ComMPncSupport=false
  module config Dcm
    DcmConfigSet  # Diagnostics Data Import
      DcmDsl
        DcmDslProtocol
          DcmDslProtocolRow_29812fbf (DcmDslProtocolRow)
            DC_0xE001_oMyECU_oCAN00_da5c4252 (DcmDslConnection)
              DC_0xE001_oMyECU_oCAN00_da5c4252 (DcmDslMainConnection): DcmDslProtocolRxTesterSourceAddr=224
                msg_diag_Request_MyECU_oCAN00_956934ec_Rx_b73501b5 (DcmDslProtocolRx):
                  DcmDslProtocolRxAddrType = DCM_PHYSICAL_TYPE
                  DcmDslProtocolRxPduId = 1
                  DcmDslProtocolRxComMChannelRef = ComMConfigSet/CN_CAN00_5e566ad9
                  DcmDslProtocolRxPduRef = msg_diag_Request_MyECU_oCAN00_956934ec_Rx
                msg_diag_Response_MyECU_oCAN00_f4dcbbcd_Tx_c184e7e6 (DcmDslProtocolTx): DcmDslTxConfirmationPduId=0, DcmDslProtocolTxPduRef=EcucPduCollection/msg_diag_Response_MyECU_oCAN00_f4dcbbcd_Tx
      DcmDsp: DcmDspMaxDidToRead=5  # Diagnostics Data Import
        ComControl (DcmDspComControl)  # Diagnostics Data Import
          DspComContolAllChannel (DcmDspComControlAllChannel)  # Diagnostics Data Import
        DcmDspSession  # Diagnostics Data Import
          3 x DcmDspSessionRow, all with DcmDspSessionP2ServerMax=0.05, DcmDspSessionP2StarServerMax=5:
            Extended: DcmDspSessionLevel=3, DcmDspSessionForBoot=DCM_NO_BOOT  # Diagnostics Data Import
            Programming: DcmDspSessionLevel=2  # Diagnostics Data Import
            Default: DcmDspSessionLevel=1, DcmDspSessionForBoot=DCM_NO_BOOT  # Diagnostics Data Import
        DcmDspSecurity  # Diagnostics Data Import
          Level_3 (DcmDspSecurityRow):  # Diagnostics Data Import
            DcmDspSecurityDelayTime = 10
            DcmDspSecurityDelayTimeOnBoot = 0
            DcmDspSecurityKeySize = 2
            DcmDspSecurityLevel = 2
            DcmDspSecurityNumAttDelay = 3
            DcmDspSecuritySeedSize = 2
          UnlockedL1 (DcmDspSecurityRow):  # Diagnostics Data Import
            DcmDspSecurityDelayTime = 10
            DcmDspSecurityDelayTimeOnBoot = 0
            DcmDspSecurityKeySize = 4
            DcmDspSecurityLevel = 1
            DcmDspSecurityNumAttDelay = 3
            DcmDspSecuritySeedSize = 4
        RoutineInfo_SampleRoutineControl_StartOnly (DcmDspRoutineInfo)  # Diagnostics Data Import
          DcmDspRoutineRequestResOut  # Diagnostics Data Import
            Out_Result (DcmDspRoutineRequestResOutSignal): DcmDspRoutineSignalLength=32, DcmDspRoutineSignalType=UINT32, DcmDspRoutineSignalEndianness=BIG_ENDIAN, DcmDspRoutineSignalPos=0  # Diagnostics Data Import
          DcmDspStartRoutineIn  # Diagnostics Data Import
            In_Option1 (DcmDspStartRoutineInSignal): DcmDspRoutineSignalLength=24, DcmDspRoutineSignalType=UINT8_N, DcmDspRoutineSignalEndianness=opaque, DcmDspRoutineSignalPos=0  # Diagnostics Data Import
          DcmDspRoutineAuthorization: DcmDspRoutineSessionRef=DcmDspSession/Programming, DcmDspRoutineSessionRef=DcmDspSession/Extended  # Diagnostics Data Import
        RoutineInfo_SampleRoutineControl (DcmDspRoutineInfo)  # Diagnostics Data Import
          DcmDspRoutineRequestResOut  # Diagnostics Data Import
            Out_Result (DcmDspRoutineRequestResOutSignal): DcmDspRoutineSignalLength=16, DcmDspRoutineSignalType=UINT16, DcmDspRoutineSignalEndianness=BIG_ENDIAN, DcmDspRoutineSignalPos=0  # Diagnostics Data Import
          DcmDspRoutineStopOut  # Diagnostics Data Import
            Out_StopState (DcmDspRoutineStopOutSignal): DcmDspRoutineSignalLength=32, DcmDspRoutineSignalType=UINT32, DcmDspRoutineSignalEndianness=BIG_ENDIAN, DcmDspRoutineSignalPos=0  # Diagnostics Data Import
          DcmDspStartRoutineOut  # Diagnostics Data Import
            Out_InitState (DcmDspStartRoutineOutSignal): DcmDspRoutineSignalLength=32, DcmDspRoutineSignalType=UINT32, DcmDspRoutineSignalEndianness=BIG_ENDIAN, DcmDspRoutineSignalPos=0  # Diagnostics Data Import
          DcmDspStartRoutineIn  # Diagnostics Data Import
            In_Option0 (DcmDspStartRoutineInSignal): DcmDspRoutineSignalLength=8, DcmDspRoutineSignalType=UINT8, DcmDspRoutineSignalPos=0  # Diagnostics Data Import
          DcmDspRoutineAuthorization: DcmDspRoutineSessionRef=DcmDspSession/Programming, DcmDspRoutineSessionRef=DcmDspSession/Extended  # Diagnostics Data Import
        SampleRoutineControl_StartOnly (DcmDspRoutine):  # Diagnostics Data Import
          DcmDspRequestResultsRoutineSupported = true
          DcmDspStopRoutineSupported = false
          DcmDspRoutineIdentifier = 260
          DcmDspRoutineInfoRef = RoutineInfo_SampleRoutineControl_StartOnly
        SampleRoutineControl (DcmDspRoutine):  # Diagnostics Data Import
          DcmDspRequestResultsRoutineSupported = true
          DcmDspStopRoutineSupported = true
          DcmDspRoutineIdentifier = 256
          DcmDspRoutineInfoRef = RoutineInfo_SampleRoutineControl
        16 x DcmDspDidInfo:
          DidInfo_DID_0xF413  # Diagnostics Data Import
            DcmDspDidAccess  # Diagnostics Data Import
              DcmDspDidRead  # Diagnostics Data Import
          DidInfo_DID_0xF412  # Diagnostics Data Import
            DcmDspDidAccess  # Diagnostics Data Import
              DcmDspDidRead  # Diagnostics Data Import
          DidInfo_DID_0xF410  # Diagnostics Data Import
            DcmDspDidAccess  # Diagnostics Data Import
              DcmDspDidRead  # Diagnostics Data Import
          DidInfo_SampleDynamicallyDefinedNonPeriodicDID: DcmDspDidDynamicallyDefined=true  # Diagnostics Data Import
            DcmDspDidAccess  # Diagnostics Data Import
              DcmDspDidDefine: DcmDspDDDidMaxElements=5  # Diagnostics Data Import
              DcmDspDidRead  # Diagnostics Data Import
          DidInfo_Hardware_Version  # Diagnostics Data Import
            DcmDspDidAccess  # Diagnostics Data Import
              DcmDspDidWrite  # Diagnostics Data Import
              DcmDspDidRead  # Diagnostics Data Import
          DidInfo_Vehicle_Identification  # Diagnostics Data Import
            DcmDspDidAccess  # Diagnostics Data Import
              DcmDspDidWrite  # Diagnostics Data Import
              DcmDspDidRead  # Diagnostics Data Import
          DidInfo_SerialNumber  # Diagnostics Data Import
            DcmDspDidAccess  # Diagnostics Data Import
              DcmDspDidWrite  # Diagnostics Data Import
              DcmDspDidRead  # Diagnostics Data Import
          DidInfo_EcuIdentification  # Diagnostics Data Import
            DcmDspDidAccess  # Diagnostics Data Import
              DcmDspDidWrite  # Diagnostics Data Import
              DcmDspDidRead  # Diagnostics Data Import
          DidInfo_Spare_Part_Number  # Diagnostics Data Import
            DcmDspDidAccess  # Diagnostics Data Import
              DcmDspDidWrite  # Diagnostics Data Import
              DcmDspDidRead  # Diagnostics Data Import
          DidInfo_Boot_Software  # Diagnostics Data Import
            DcmDspDidAccess  # Diagnostics Data Import
              DcmDspDidWrite  # Diagnostics Data Import
              DcmDspDidRead  # Diagnostics Data Import
          DidInfo_DataDiagnosticIdentifier_DID  # Diagnostics Data Import
            DcmDspDidAccess  # Diagnostics Data Import
              DcmDspDidWrite  # Diagnostics Data Import
              DcmDspDidRead  # Diagnostics Data Import
          DidInfo_DevelopmentData  # Diagnostics Data Import
            DcmDspDidAccess  # Diagnostics Data Import
              DcmDspDidWrite  # Diagnostics Data Import
              DcmDspDidRead  # Diagnostics Data Import
          DidInfo_Example_WriteOnlyDID  # Diagnostics Data Import
            DcmDspDidAccess  # Diagnostics Data Import
              DcmDspDidWrite  # Diagnostics Data Import
          DidInfo_SampleIoControl  # Diagnostics Data Import
            DcmDspDidAccess  # Diagnostics Data Import
              DcmDspDidRead  # Diagnostics Data Import
              DcmDspDidControl:  # Diagnostics Data Import
                DcmDspDidFreezeCurrentState = true
                DcmDspDidResetToDefault = true
                DcmDspDidReturnControlToEcu = true
                DcmDspDidShortTermAdjustment = true
                DcmDspDidControlSessionRef = DcmDspSession/Extended
          DidInfo_Example_ReadWriteData  # Diagnostics Data Import
            DcmDspDidAccess  # Diagnostics Data Import
              DcmDspDidWrite  # Diagnostics Data Import
              DcmDspDidRead  # Diagnostics Data Import
          DidInfo_Example_ReadOnlyDID  # Diagnostics Data Import
            DcmDspDidAccess  # Diagnostics Data Import
              DcmDspDidRead  # Diagnostics Data Import
        16 x DcmDspDid:
          DID_0xF413: DcmDspDidIdentifier=62483, DcmDspDidInfoRef=DidInfo_DID_0xF413  # Diagnostics Data Import
            DID_Data (DcmDspDidSignal): DcmDspDidDataPos=0, DcmDspDidDataRef=DID_0xF413_DID_Data  # Diagnostics Data Import
          DID_0xF412: DcmDspDidIdentifier=62482, DcmDspDidInfoRef=DidInfo_DID_0xF412  # Diagnostics Data Import
            DID_Data (DcmDspDidSignal): DcmDspDidDataPos=0, DcmDspDidDataRef=DID_0xF412_DID_Data  # Diagnostics Data Import
          DID_0xF410: DcmDspDidIdentifier=62480, DcmDspDidInfoRef=DidInfo_DID_0xF410  # Diagnostics Data Import
            DID_Data (DcmDspDidSignal): DcmDspDidDataPos=0, DcmDspDidDataRef=DID_0xF410_DID_Data  # Diagnostics Data Import
          SampleDynamicallyDefinedNonPeriodicDID: DcmDspDidIdentifier=62208, DcmDspDidInfoRef=DidInfo_SampleDynamicallyDefinedNonPeriodicDID  # Diagnostics Data Import
          Hardware_Version: DcmDspDidIdentifier=61843, DcmDspDidInfoRef=DidInfo_Hardware_Version  # Diagnostics Data Import
            Hardware_Version_Number (DcmDspDidSignal): DcmDspDidDataPos=0, DcmDspDidDataRef=Hardware_Version_Hardware_Version_Number  # Diagnostics Data Import
          Vehicle_Identification: DcmDspDidIdentifier=61840, DcmDspDidInfoRef=DidInfo_Vehicle_Identification  # Diagnostics Data Import
            VIN (DcmDspDidSignal): DcmDspDidDataPos=0, DcmDspDidDataRef=Vehicle_Identification_VIN  # Diagnostics Data Import
          SerialNumber: DcmDspDidIdentifier=61836, DcmDspDidInfoRef=DidInfo_SerialNumber  # Diagnostics Data Import
            SerialNumber (DcmDspDidSignal): DcmDspDidDataPos=0, DcmDspDidDataRef=SerialNumber_SerialNumber  # Diagnostics Data Import
          EcuIdentification: DcmDspDidIdentifier=61833, DcmDspDidInfoRef=DidInfo_EcuIdentification  # Diagnostics Data Import
            Part_Number (DcmDspDidSignal): DcmDspDidDataPos=0, DcmDspDidDataRef=EcuIdentification_Part_Number  # Diagnostics Data Import
          Spare_Part_Number: DcmDspDidIdentifier=61831, DcmDspDidInfoRef=DidInfo_Spare_Part_Number  # Diagnostics Data Import
            Spare_Part_Number (DcmDspDidSignal): DcmDspDidDataPos=0, DcmDspDidDataRef=Spare_Part_Number_Spare_Part_Number  # Diagnostics Data Import
          Boot_Software: DcmDspDidIdentifier=61824, DcmDspDidInfoRef=DidInfo_Boot_Software  # Diagnostics Data Import
            Boot_Software_Identification (DcmDspDidSignal): DcmDspDidDataPos=8, DcmDspDidDataRef=Boot_Software_Boot_Software_Identification  # Diagnostics Data Import
            NumberOfModules (DcmDspDidSignal): DcmDspDidDataPos=0, DcmDspDidDataRef=Boot_Software_NumberOfModules  # Diagnostics Data Import
          DataDiagnosticIdentifier_DID: DcmDspDidIdentifier=257, DcmDspDidInfoRef=DidInfo_DataDiagnosticIdentifier_DID  # Diagnostics Data Import
            DataDiagnosticIdentifier (DcmDspDidSignal): DcmDspDidDataPos=0, DcmDspDidDataRef=DataDiagnosticIdentifier_DID_DataDiagnosticIdentifier  # Diagnostics Data Import
          DevelopmentData: DcmDspDidIdentifier=256, DcmDspDidInfoRef=DidInfo_DevelopmentData  # Diagnostics Data Import
            5 x DcmDspDidSignal:
              TransportLayerVersion: DcmDspDidDataPos=64, DcmDspDidDataRef=DevelopmentData_TransportLayerVersion  # Diagnostics Data Import
              DiagnosticModuleVersion: DcmDspDidDataPos=48, DcmDspDidDataRef=DevelopmentData_DiagnosticModuleVersion  # Diagnostics Data Import
              NmVersion: DcmDspDidDataPos=32, DcmDspDidDataRef=DevelopmentData_NmVersion  # Diagnostics Data Import
              CanDriverVersion: DcmDspDidDataPos=16, DcmDspDidDataRef=DevelopmentData_CanDriverVersion  # Diagnostics Data Import
              OperatingSystemVersion: DcmDspDidDataPos=0, DcmDspDidDataRef=DevelopmentData_OperatingSystemVersion  # Diagnostics Data Import
          Example_WriteOnlyDID: DcmDspDidIdentifier=4, DcmDspDidInfoRef=DidInfo_Example_WriteOnlyDID  # Diagnostics Data Import
            DID_DataObject (DcmDspDidSignal): DcmDspDidDataPos=0, DcmDspDidDataRef=Example_WriteOnlyDID_DID_DataObject  # Diagnostics Data Import
          SampleIoControl: DcmDspDidIdentifier=3, DcmDspDidInfoRef=DidInfo_SampleIoControl  # Diagnostics Data Import
            DID_Data (DcmDspDidSignal): DcmDspDidDataPos=0, DcmDspDidDataRef=SampleIoControl_DID_Data  # Diagnostics Data Import
          Example_ReadWriteData: DcmDspDidIdentifier=2, DcmDspDidInfoRef=DidInfo_Example_ReadWriteData  # Diagnostics Data Import
            GlobalTime (DcmDspDidSignal): DcmDspDidDataPos=0, DcmDspDidDataRef=Example_ReadWriteData_GlobalTime  # Diagnostics Data Import
          Example_ReadOnlyDID: DcmDspDidIdentifier=1, DcmDspDidInfoRef=DidInfo_Example_ReadOnlyDID  # Diagnostics Data Import
            DID_Data_GlobalTime (DcmDspDidSignal): DcmDspDidDataPos=0, DcmDspDidDataRef=Example_ReadOnlyDID_DID_Data_GlobalTime  # Diagnostics Data Import
        DataInfo_DID_0xF413_DID_Data (DcmDspDataInfo): DcmDspDataFixedLength=true  # Diagnostics Data Import
        DID_0xF413_DID_Data (DcmDspData): DcmDspDataSize=16, DcmDspDataType=UINT16, DcmDspDataInfoRef=DataInfo_DID_0xF413_DID_Data  # Diagnostics Data Import
        DataInfo_DID_0xF412_DID_Data (DcmDspDataInfo): DcmDspDataFixedLength=true  # Diagnostics Data Import
        DID_0xF412_DID_Data (DcmDspData): DcmDspDataSize=16, DcmDspDataType=UINT16, DcmDspDataInfoRef=DataInfo_DID_0xF412_DID_Data  # Diagnostics Data Import
        DataInfo_DID_0xF410_DID_Data (DcmDspDataInfo): DcmDspDataFixedLength=true  # Diagnostics Data Import
        DID_0xF410_DID_Data (DcmDspData): DcmDspDataSize=16, DcmDspDataType=UINT16, DcmDspDataInfoRef=DataInfo_DID_0xF410_DID_Data  # Diagnostics Data Import
        DataInfo_Hardware_Version_Hardware_Version_Number (DcmDspDataInfo): DcmDspDataFixedLength=true  # Diagnostics Data Import
        Hardware_Version_Hardware_Version_Number (DcmDspData): DcmDspDataSize=32, DcmDspDataType=UINT32, DcmDspDataInfoRef=DataInfo_Hardware_Version_Hardware_Version_Number  # Diagnostics Data Import
        DataInfo_Vehicle_Identification_VIN (DcmDspDataInfo): DcmDspDataFixedLength=true  # Diagnostics Data Import
        Vehicle_Identification_VIN (DcmDspData): DcmDspDataSize=136, DcmDspDataType=UINT8_N, DcmDspDataInfoRef=DataInfo_Vehicle_Identification_VIN  # Diagnostics Data Import
        DataInfo_SerialNumber_SerialNumber (DcmDspDataInfo): DcmDspDataFixedLength=true  # Diagnostics Data Import
        SerialNumber_SerialNumber (DcmDspData): DcmDspDataSize=32, DcmDspDataType=UINT32, DcmDspDataInfoRef=DataInfo_SerialNumber_SerialNumber  # Diagnostics Data Import
        DataInfo_EcuIdentification_Part_Number (DcmDspDataInfo): DcmDspDataFixedLength=true  # Diagnostics Data Import
        EcuIdentification_Part_Number (DcmDspData): DcmDspDataSize=104, DcmDspDataType=UINT8_N, DcmDspDataInfoRef=DataInfo_EcuIdentification_Part_Number  # Diagnostics Data Import
        DataInfo_Spare_Part_Number_Spare_Part_Number (DcmDspDataInfo): DcmDspDataFixedLength=true  # Diagnostics Data Import
        Spare_Part_Number_Spare_Part_Number (DcmDspData): DcmDspDataSize=32, DcmDspDataType=UINT32, DcmDspDataInfoRef=DataInfo_Spare_Part_Number_Spare_Part_Number  # Diagnostics Data Import
        DataInfo_Boot_Software_Boot_Software_Identification (DcmDspDataInfo): DcmDspDataFixedLength=true  # Diagnostics Data Import
        Boot_Software_Boot_Software_Identification (DcmDspData): DcmDspDataSize=32, DcmDspDataType=UINT32, DcmDspDataInfoRef=DataInfo_Boot_Software_Boot_Software_Identification  # Diagnostics Data Import
        DataInfo_Boot_Software_NumberOfModules (DcmDspDataInfo): DcmDspDataFixedLength=true  # Diagnostics Data Import
        Boot_Software_NumberOfModules (DcmDspData): DcmDspDataSize=8, DcmDspDataType=UINT8, DcmDspDataInfoRef=DataInfo_Boot_Software_NumberOfModules  # Diagnostics Data Import
        DataInfo_DataDiagnosticIdentifier_DID_DataDiagnosticIdentifier (DcmDspDataInfo): DcmDspDataFixedLength=true  # Diagnostics Data Import
        DataDiagnosticIdentifier_DID_DataDiagnosticIdentifier (DcmDspData): DcmDspDataSize=16, DcmDspDataType=UINT16, DcmDspDataInfoRef=DataInfo_DataDiagnosticIdentifier_DID_DataDiagnosticIdentifier  # Diagnostics Data Import
        DataInfo_DevelopmentData_TransportLayerVersion (DcmDspDataInfo): DcmDspDataFixedLength=true  # Diagnostics Data Import
        DevelopmentData_TransportLayerVersion (DcmDspData): DcmDspDataSize=16, DcmDspDataType=UINT16, DcmDspDataInfoRef=DataInfo_DevelopmentData_TransportLayerVersion  # Diagnostics Data Import
        DataInfo_DevelopmentData_DiagnosticModuleVersion (DcmDspDataInfo): DcmDspDataFixedLength=true  # Diagnostics Data Import
        DevelopmentData_DiagnosticModuleVersion (DcmDspData): DcmDspDataSize=16, DcmDspDataType=UINT16, DcmDspDataInfoRef=DataInfo_DevelopmentData_DiagnosticModuleVersion  # Diagnostics Data Import
        DataInfo_DevelopmentData_NmVersion (DcmDspDataInfo): DcmDspDataFixedLength=true  # Diagnostics Data Import
        DevelopmentData_NmVersion (DcmDspData): DcmDspDataSize=16, DcmDspDataType=UINT16, DcmDspDataInfoRef=DataInfo_DevelopmentData_NmVersion  # Diagnostics Data Import
        DataInfo_DevelopmentData_CanDriverVersion (DcmDspDataInfo): DcmDspDataFixedLength=true  # Diagnostics Data Import
        DevelopmentData_CanDriverVersion (DcmDspData): DcmDspDataSize=16, DcmDspDataType=UINT16, DcmDspDataInfoRef=DataInfo_DevelopmentData_CanDriverVersion  # Diagnostics Data Import
        DataInfo_DevelopmentData_OperatingSystemVersion (DcmDspDataInfo): DcmDspDataFixedLength=true  # Diagnostics Data Import
        DevelopmentData_OperatingSystemVersion (DcmDspData): DcmDspDataSize=16, DcmDspDataType=UINT16, DcmDspDataInfoRef=DataInfo_DevelopmentData_OperatingSystemVersion  # Diagnostics Data Import
        DataInfo_Example_WriteOnlyDID_DID_DataObject (DcmDspDataInfo): DcmDspDataFixedLength=true  # Diagnostics Data Import
        Example_WriteOnlyDID_DID_DataObject (DcmDspData): DcmDspDataSize=8, DcmDspDataType=UINT8, DcmDspDataInfoRef=DataInfo_Example_WriteOnlyDID_DID_DataObject  # Diagnostics Data Import
        DataInfo_SampleIoControl_DID_Data (DcmDspDataInfo): DcmDspDataFixedLength=true  # Diagnostics Data Import
        SampleIoControl_DID_Data (DcmDspData): DcmDspDataConditionCheckReadFncUsed=false, DcmDspDataSize=32, DcmDspDataType=UINT32, DcmDspDataInfoRef=DataInfo_SampleIoControl_DID_Data  # Diagnostics Data Import
        DataInfo_Example_ReadWriteData_GlobalTime (DcmDspDataInfo): DcmDspDataFixedLength=true  # Diagnostics Data Import
        Example_ReadWriteData_GlobalTime (DcmDspData): DcmDspDataSize=32, DcmDspDataType=UINT32, DcmDspDataInfoRef=DataInfo_Example_ReadWriteData_GlobalTime  # Diagnostics Data Import
        DataInfo_Example_ReadOnlyDID_DID_Data_GlobalTime (DcmDspDataInfo): DcmDspDataFixedLength=true  # Diagnostics Data Import
        Example_ReadOnlyDID_DID_Data_GlobalTime (DcmDspData): DcmDspDataSize=48, DcmDspDataType=UINT8_N, DcmDspDataInfoRef=DataInfo_Example_ReadOnlyDID_DID_Data_GlobalTime  # Diagnostics Data Import
      DcmDsd  # Diagnostics Data Import
        DcmDsdServiceTable  # Diagnostics Data Import
          15 x DcmDsdService:
            ControlDtcSetting: DcmDsdSidTabServiceId=133, DcmDsdSidTabSubfuncAvail=true  # Diagnostics Data Import
              Disable (DcmDsdSubService): DcmDsdSubServiceId=2  # Diagnostics Data Import
              Enable (DcmDsdSubService): DcmDsdSubServiceId=1  # Diagnostics Data Import
            TesterPresent: DcmDsdSidTabServiceId=62, DcmDsdSidTabSubfuncAvail=true  # Diagnostics Data Import
              TesterPresent (DcmDsdSubService): DcmDsdSubServiceId=0  # Diagnostics Data Import
            WriteMemoryByAddress: DcmDsdSidTabServiceId=61, DcmDsdSidTabSubfuncAvail=false  # Diagnostics Data Import
            RoutineControl: DcmDsdSidTabServiceId=49, DcmDsdSidTabSubfuncAvail=true, DcmDsdSidTabSessionLevelRef=DcmDspSession/Programming, DcmDsdSidTabSessionLevelRef=DcmDspSession/Extended  # Diagnostics Data Import
            IoControlById: DcmDsdSidTabServiceId=47, DcmDsdSidTabSubfuncAvail=false, DcmDsdSidTabSessionLevelRef=DcmDspSession/Extended  # Diagnostics Data Import
            WriteDataById: DcmDsdSidTabServiceId=46, DcmDsdSidTabSubfuncAvail=false  # Diagnostics Data Import
            DynamicallyDefineDataId: DcmDsdSidTabServiceId=44, DcmDsdSidTabSubfuncAvail=true  # Diagnostics Data Import
              3 x DcmDsdSubService:
                DynDefClr: DcmDsdSubServiceId=3  # Diagnostics Data Import
                DynDefByAddr: DcmDsdSubServiceId=2  # Diagnostics Data Import
                DynDefById: DcmDsdSubServiceId=1  # Diagnostics Data Import
            CommunicationControl: DcmDsdSidTabServiceId=40, DcmDsdSidTabSubfuncAvail=true, DcmDsdSidTabSessionLevelRef=DcmDspSession/Programming, DcmDsdSidTabSessionLevelRef=DcmDspSession/Extended  # Diagnostics Data Import
              4 x DcmDsdSubService, all with DcmDsdSubServiceSessionLevelRef=DcmDspSession/Programming, DcmDsdSubServiceSessionLevelRef=DcmDspSession/Extended:
                DisableRxAndTx: DcmDsdSubServiceId=3  # Diagnostics Data Import
                DisableRxAndEnableTx: DcmDsdSubServiceId=2  # Diagnostics Data Import
                EnableRxAndDisableTx: DcmDsdSubServiceId=1  # Diagnostics Data Import
                EnableRxAndTx: DcmDsdSubServiceId=0  # Diagnostics Data Import
            SecurityAccess: DcmDsdSidTabServiceId=39, DcmDsdSidTabSubfuncAvail=true, DcmDsdSidTabSessionLevelRef=DcmDspSession/Programming, DcmDsdSidTabSessionLevelRef=DcmDspSession/Extended  # Diagnostics Data Import
              4 x DcmDsdSubService, all with DcmDsdSubServiceSessionLevelRef=DcmDspSession/Programming, DcmDsdSubServiceSessionLevelRef=DcmDspSession/Extended:
                sendKey_Send: DcmDsdSubServiceId=4  # Diagnostics Data Import
                requestSeed_Request: DcmDsdSubServiceId=3  # Diagnostics Data Import
                KeyLevel1_Send: DcmDsdSubServiceId=2  # Diagnostics Data Import
                SeedLevel1_Request: DcmDsdSubServiceId=1  # Diagnostics Data Import
            ReadMemoryByAddress: DcmDsdSidTabServiceId=35, DcmDsdSidTabSubfuncAvail=false  # Diagnostics Data Import
            ReadDataById: DcmDsdSidTabServiceId=34, DcmDsdSidTabSubfuncAvail=false  # Diagnostics Data Import
            ReadDtcInfo: DcmDsdSidTabServiceId=25, DcmDsdSidTabSubfuncAvail=true  # Diagnostics Data Import
              12 x DcmDsdSubService:
                RDTCFDC: DcmDsdSubServiceId=20  # Diagnostics Data Import
                RMRTFDTC: DcmDsdSubServiceId=13  # Diagnostics Data Import
                RFCDTC: DcmDsdSubServiceId=12  # Diagnostics Data Import
                RSUPDTC: DcmDsdSubServiceId=10  # Diagnostics Data Import
                RSIODTC: DcmDsdSubServiceId=9  # Diagnostics Data Import
                RDTCBSMR: DcmDsdSubServiceId=8  # Diagnostics Data Import
                RNODTCBSMR: DcmDsdSubServiceId=7  # Diagnostics Data Import
                RDTCEDRBDN: DcmDsdSubServiceId=6  # Diagnostics Data Import
                RDTCSSBDTC: DcmDsdSubServiceId=4  # Diagnostics Data Import
                RDTCSSI: DcmDsdSubServiceId=3  # Diagnostics Data Import
                RDTCBSM: DcmDsdSubServiceId=2  # Diagnostics Data Import
                RNODTCBSM: DcmDsdSubServiceId=1  # Diagnostics Data Import
            ClearDiagInfo: DcmDsdSidTabServiceId=20, DcmDsdSidTabSubfuncAvail=false  # Diagnostics Data Import
            EcuReset: DcmDsdSidTabServiceId=17, DcmDsdSidTabSubfuncAvail=true  # Diagnostics Data Import
              Hard (DcmDsdSubService): DcmDsdSubServiceId=1  # Diagnostics Data Import
            DiagSessionControl: DcmDsdSidTabServiceId=16, DcmDsdSidTabSubfuncAvail=true  # Diagnostics Data Import
              3 x DcmDsdSubService:
                Extended: DcmDsdSubServiceId=3  # Diagnostics Data Import
                Programming: DcmDsdSubServiceId=2  # Diagnostics Data Import
                Default: DcmDsdSubServiceId=1  # Diagnostics Data Import
      DcmGeneral: DcmResetToFblAfterSessionFinalResponseEnabled=false  # Diagnostics Data Import
  module config Dem
    DemGeneral:  # Diagnostics Data Import
      DemAgingCycleCounterProcessing = DEM_PROCESS_AGINGCTR_INTERN
      DemDebounceCounterBasedSupport = true
      DemPTOSupport = false
      DemDtcStatusAvailabilityMask = 255
      DemGeneralOBD  # Diagnostics Data Import
      4 x DemDataClass:
        OccurrenceCounter_Occurrence_Counter: DemDataElementDataSize=1, DemDataElementInternalData=DEM_OCCCTR, DemDataElementUsePort=USE_DATA_INTERNAL  # Diagnostics Data Import
        DID_0x1_DID_Data_GlobalTime: DemDataElementDataSize=6, DemDataElementDataType=UINT8_N, DemDataElementEndianness=opaque, DemDataElementUsePort=USE_DATA_CLIENT_SERVER_PORT, DemDataElementStoreNonVolatile=true  # Diagnostics Data Import
        PID_0x13_DID_Data: DemDataElementDataSize=2, DemDataElementDataType=UINT16, DemDataElementEndianness=BIG_ENDIAN, DemDataElementUsePort=USE_DATA_CLIENT_SERVER_PORT, DemDataElementStoreNonVolatile=true  # Diagnostics Data Import
        PID_0x12_DID_Data: DemDataElementDataSize=2, DemDataElementDataType=UINT16, DemDataElementEndianness=BIG_ENDIAN, DemDataElementUsePort=USE_DATA_CLIENT_SERVER_PORT, DemDataElementStoreNonVolatile=true  # Diagnostics Data Import
      4 x DemOperationCycle:
        WarmUpCycle: DemOperationCycleType=DEM_OPCYC_WARMUP  # Diagnostics Data Import
        PowerCycle: DemOperationCycleType=DEM_OPCYC_POWER  # Diagnostics Data Import
        OBDDrivingCycle: DemOperationCycleType=DEM_OPCYC_OBD_DCY  # Diagnostics Data Import
        IgnitionCycle: DemOperationCycleType=DEM_OPCYC_IGNITION  # Diagnostics Data Import
      WarningIndicator (DemIndicator)  # Diagnostics Data Import
      FreezeFrameClass_89a2d1a5 (DemFreezeFrameClass): DemDidClassRef=DemGeneral/Example_ReadOnlyDID, DemDidClassRef=DemGeneral/DID_0xF412, DemDidClassRef=DemGeneral/DID_0xF413  # Diagnostics Data Import
      FreezeFrameClass_7d61125a (DemFreezeFrameClass): DemDidClassRef=DemGeneral/Example_ReadOnlyDID  # Diagnostics Data Import
      OccurrenceCounter (DemExtendedDataRecordClass): DemExtendedDataRecordNumber=1, DemDataClassRef=OccurrenceCounter_Occurrence_Counter  # Diagnostics Data Import
      ExtendedDataClass_83dcefb7 (DemExtendedDataClass): DemExtendedDataRecordClassRef=OccurrenceCounter  # Diagnostics Data Import
      3 x DemDidClass:
        DID_0xF413: DemDidIdentifier=62483, DemDidDataClassRef=PID_0x13_DID_Data  # Diagnostics Data Import
        DID_0xF412: DemDidIdentifier=62482, DemDidDataClassRef=PID_0x12_DID_Data  # Diagnostics Data Import
        Example_ReadOnlyDID: DemDidIdentifier=1, DemDidDataClassRef=DID_0x1_DID_Data_GlobalTime  # Diagnostics Data Import
      DemEventMemorySet  # Diagnostics Data Import
        PrimaryMemory (DemPrimaryMemory): DemTypeOfFreezeFrameRecordNumeration=DEM_FF_RECNUM_CALCULATED  # Diagnostics Data Import
    DemConfigSet  # Diagnostics Data Import
      DTC_0x000003 (DemEventParameter):  # Diagnostics Data Import
        DemEventKind = DEM_EVENT_KIND_SWC
        DemMaxNumberFreezeFrameRecords = 1
        DemDTCClassRef = DTCClass_DTC_0x000003
        DemExtendedDataClassRef = ExtendedDataClass_83dcefb7
        DemFreezeFrameClassRef = FreezeFrameClass_89a2d1a5
        DemEventClass:  # Diagnostics Data Import
          DemAgingAllowed = true
          DemAgingCycleCounterThreshold = 40
          DemEventPriority = 1
          DemEventSignificance = DEM_EVENT_SIGNIFICANCE_FAULT
          DemEventFailureCycleCounterThreshold = 2
          DemAgingCycleRef = WarmUpCycle
          DemOperationCycleRef = OBDDrivingCycle
          IndicatorAttribute_WarningIndicator (DemIndicatorAttribute): DemIndicatorFailureCycleSource=DEM_FAILURE_CYCLE_EVENT, DemIndicatorHealingCycleRef=OBDDrivingCycle, DemIndicatorRef=WarningIndicator  # Diagnostics Data Import
          DemDebounceAlgorithmClass  # Diagnostics Data Import
            DemDebounceCounterBased: DemDebounceCounterDecrementStepSize=1, DemDebounceCounterIncrementStepSize=1, DemDebounceCounterJumpDown=false, DemDebounceCounterJumpUp=true  # Diagnostics Data Import
      DTCClass_DTC_0x000003 (DemDTCClass): DemDTCSeverity=DEM_DTC_SEV_NO_SEVERITY, DemUdsDTC=3, DemDTCAttributesRef=DtcAttributes_41914fb7  # Diagnostics Data Import
      DTC_0x000002 (DemEventParameter):  # Diagnostics Data Import
        DemEventKind = DEM_EVENT_KIND_SWC
        DemMaxNumberFreezeFrameRecords = 1
        DemDTCClassRef = DTCClass_DTC_0x000002
        DemExtendedDataClassRef = ExtendedDataClass_83dcefb7
        DemFreezeFrameClassRef = FreezeFrameClass_7d61125a
        DemEventClass:  # Diagnostics Data Import
          DemAgingAllowed = false
          DemAgingCycleCounterThreshold = 100
          DemEventPriority = 2
          DemEventSignificance = DEM_EVENT_SIGNIFICANCE_FAULT
          DemEventFailureCycleCounterThreshold = 0
          DemAgingCycleRef = IgnitionCycle
          DemOperationCycleRef = PowerCycle
          IndicatorAttribute_WarningIndicator (DemIndicatorAttribute): DemIndicatorFailureCycleSource=DEM_FAILURE_CYCLE_EVENT, DemIndicatorHealingCycleRef=PowerCycle, DemIndicatorRef=WarningIndicator  # Diagnostics Data Import
          DemDebounceAlgorithmClass  # Diagnostics Data Import
            DemDebounceCounterBased: DemDebounceCounterDecrementStepSize=1, DemDebounceCounterIncrementStepSize=1, DemDebounceCounterJumpDown=false, DemDebounceCounterJumpUp=true  # Diagnostics Data Import
        DemCallbackInitMForE  # Diagnostics Data Import
      DTCClass_DTC_0x000002 (DemDTCClass): DemDTCSeverity=DEM_DTC_SEV_NO_SEVERITY, DemUdsDTC=2, DemDTCAttributesRef=DtcAttributes_41914fb7  # Diagnostics Data Import
      DtcAttributes_41914fb7 (DemDTCAttributes): DemMemoryDestinationRef=PrimaryMemory  # Diagnostics Data Import
  module config EcuC
    EcucPduCollection: PduIdTypeEnum=UINT8, PduLengthTypeEnum=UINT8
      15 x Pdu:
        msg_MotorStatus_oCAN00_71118836_Tx: DynamicLength=false, PduLength=12
        msg_MotorStatus_oCAN00_a6063320_Tx: DynamicLength=false, PduLength=12, SysTPduToFrameMappingRef=msg_MotorStatus
        msg_Receive_oCAN00_2b456e3f_Rx: DynamicLength=false, PduLength=1
        msg_Receive_oCAN00_3867e0b8_Rx: DynamicLength=false, PduLength=1, SysTPduToFrameMappingRef=msg_Receive
        msg_Transmit_oCAN00_0723e95e_Tx: DynamicLength=false, PduLength=1
        msg_Transmit_oCAN00_9631a86b_Tx: DynamicLength=false, PduLength=1, SysTPduToFrameMappingRef=msg_Transmit
        msg_diag_RequestGlobal_Tp_oCAN00_7b1e9193_Rx: DynamicLength=false, PduLength=8, SysTPduToFrameMappingRef=msg_diag_RequestGlobal_Tp
        msg_diag_RequestGlobal_oCAN00_25be229e_Rx: DynamicLength=true, PduLength=8
        msg_diag_RequestGlobal_oCAN00_38f4a687_Rx: DynamicLength=true, PduLength=8
        msg_diag_Request_MyECU_Tp_oCAN00_ecbacca2_Rx: DynamicLength=false, PduLength=8, SysTPduToFrameMappingRef=msg_diag_Request_MyECU_Tp
        msg_diag_Request_MyECU_oCAN00_956934ec_Rx: DynamicLength=true, PduLength=8
        msg_diag_Request_MyECU_oCAN00_a823f7ba_Rx: DynamicLength=true, PduLength=8
        msg_diag_Response_MyECU_Tp_oCAN00_0ed9d144_Tx: DynamicLength=false, PduLength=8, SysTPduToFrameMappingRef=msg_diag_Response_MyECU_Tp
        msg_diag_Response_MyECU_oCAN00_45311294_Tx: DynamicLength=true, PduLength=8
        msg_diag_Response_MyECU_oCAN00_f4dcbbcd_Tx: DynamicLength=true, PduLength=8
  module config EcuM
    EcuMConfiguration
      EcuMCommonConfiguration
        EcuMDriverInitListOne
        EcuMDriverRestartList
        CN_CAN00_5e566ad9 (EcuMWakeupSource): EcuMWakeupSourceId=5, EcuMComMChannelRef=ComMConfigSet/CN_CAN00_5e566ad9
      EcuMFlexConfiguration: EcuMFlexModuleConfigurationRef=CanConfigSet
  module config PduR
    PduRGeneral
    PduRRoutingTables
      PduRRoutingTable
        6 x PduRRoutingPath:
          msg_MotorStatus_oCAN00_71118836_Tx
            msg_MotorStatus_oCAN00_a6063320_Tx (PduRDestPdu): PduRDestPduRef=EcucPduCollection/msg_MotorStatus_oCAN00_a6063320_Tx
            PduRSrcPdu_96a7407f (PduRSrcPdu): PduRSrcPduRef=EcucPduCollection/msg_MotorStatus_oCAN00_71118836_Tx
          msg_Receive_oCAN00_3867e0b8_Rx
            msg_Receive_oCAN00_3867e0b8_Rx_16740ed0_Rx (PduRDestPdu): PduRDestPduRef=EcucPduCollection/msg_Receive_oCAN00_2b456e3f_Rx
            PduRSrcPdu_16740ed0 (PduRSrcPdu): PduRSrcPduRef=EcucPduCollection/msg_Receive_oCAN00_3867e0b8_Rx
          msg_Transmit_oCAN00_0723e95e_Tx
            msg_Transmit_oCAN00_9631a86b_Tx (PduRDestPdu): PduRDestPduRef=EcucPduCollection/msg_Transmit_oCAN00_9631a86b_Tx
            PduRSrcPdu_087fd70d (PduRSrcPdu): PduRSrcPduRef=EcucPduCollection/msg_Transmit_oCAN00_0723e95e_Tx
          msg_diag_RequestGlobal_oCAN00_38f4a687_Rx
            msg_diag_RequestGlobal_oCAN00_38f4a687_Rx_fdd5755a_Rx (PduRDestPdu): PduRDestPduRef=msg_diag_RequestGlobal_oCAN00_25be229e_Rx
            PduRSrcPdu_fdd5755a (PduRSrcPdu): PduRSrcPduRef=EcucPduCollection/msg_diag_RequestGlobal_oCAN00_38f4a687_Rx
          msg_diag_Request_MyECU_oCAN00_a823f7ba_Rx
            msg_diag_Request_MyECU_oCAN00_a823f7ba_Rx_11d927ad_Rx (PduRDestPdu): PduRDestPduRef=msg_diag_Request_MyECU_oCAN00_956934ec_Rx
            PduRSrcPdu_11d927ad (PduRSrcPdu): PduRSrcPduRef=EcucPduCollection/msg_diag_Request_MyECU_oCAN00_a823f7ba_Rx
          msg_diag_Response_MyECU_oCAN00_f4dcbbcd_Tx
            msg_diag_Response_MyECU_oCAN00_45311294_Tx (PduRDestPdu): PduRDestPduRef=EcucPduCollection/msg_diag_Response_MyECU_oCAN00_45311294_Tx
            PduRSrcPdu_f4835c60 (PduRSrcPdu): PduRSrcPduRef=EcucPduCollection/msg_diag_Response_MyECU_oCAN00_f4dcbbcd_Tx
