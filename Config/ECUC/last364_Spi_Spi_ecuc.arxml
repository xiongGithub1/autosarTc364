AUTOSAR XML (schema 00048)
package /ActiveEcuC
  module config Spi: implementation-config-variant=VARIANT-POST-BUILD-LOADABLE, module-description=Spi_Impl
    SpiDriver: SpiMaxChannel=3, SpiMaxJob=3, SpiMaxSequence=3, SpiSystemClock=McuClockReferencePointConfig
      SpiChannel_9183 (SpiChannel): SpiChannelId=0, SpiChannelType=EB, SpiDataWidth=24, SpiTransferStart=MSB, SpiEbMaxLength=8190, SpiIbNBuffers=10
      SpiExternalDevice_9183 (SpiExternalDevice):
        SpiBaudrate = 1000000
        SpiCsIdentifier = CHANNEL12
        SpiCsPolarity = LOW
        SpiDataShiftEdge = TRAILING
        SpiEnableCs = true
        SpiHwUnit = QSPI3
        SpiAutoCalcBaudParams = true
        SpiAutoCalcDelayParams = true
        SpiIdleTime = 1E-7
        SpiTrailingTime = 1E-7
        SpiShiftClockIdleLevel = LOW
        SpiTimeClk2Cs = 1E-7
        SpiParitySupport = UNUSED
        SpiCsSelection = CS_VIA_PERIPHERAL_ENGINE
        SpiBaudrateParams: SpiBaudParamTQ=2, SpiBaudParamQ=10, SpiBaudParamA=1, SpiBaudParamB=0, SpiBaudParamC=1
      SpiJob_9183 (SpiJob): SpiJobId=0, SpiFrameBasedCS=false, SpiJobPriority=0, SpiHwUnitSynchronous=ASYNCHRONOUS, SpiDeviceAssignment=SpiExternalDevice_9183
        SpiChannelList: SpiChannelIndex=0, SpiChannelAssignment=SpiChannel_9183
      SpiSequence_9183 (SpiSequence): SpiInterruptibleSequence=false, SpiSequenceId=0, SpiJobAssignment=SpiJob_9183
      SpiChannel_5012BD1 (SpiChannel): SpiChannelId=1, SpiChannelType=EB, SpiDataWidth=32, SpiEbMaxLength=8190, SpiIbNBuffers=10, SpiTransferStart=MSB
      SpiExternalDevice_5012BD (SpiExternalDevice):
        SpiBaudrate = 1000000
        SpiCsIdentifier = CHANNEL2
        SpiCsPolarity = LOW
        SpiDataShiftEdge = LEADING
        SpiEnableCs = true
        SpiHwUnit = QSPI2
        SpiAutoCalcBaudParams = true
        SpiAutoCalcDelayParams = true
        SpiIdleTime = 1E-7
        SpiTrailingTime = 1E-7
        SpiShiftClockIdleLevel = LOW
        SpiTimeClk2Cs = 1E-7
        SpiParitySupport = UNUSED
        SpiCsSelection = CS_VIA_PERIPHERAL_ENGINE
        SpiBaudrateParams: SpiBaudParamTQ=2, SpiBaudParamQ=10, SpiBaudParamA=1, SpiBaudParamB=0, SpiBaudParamC=1
      SpiJob_5012BD (SpiJob): SpiJobId=1, SpiFrameBasedCS=false, SpiJobPriority=0, SpiHwUnitSynchronous=ASYNCHRONOUS, SpiDeviceAssignment=SpiExternalDevice_5012BD
        SpiChannelList: SpiChannelIndex=0, SpiChannelAssignment=SpiChannel_5012BD1
      SpiSequence_5012BD (SpiSequence): SpiInterruptibleSequence=false, SpiSequenceId=1, SpiJobAssignment=SpiJob_5012BD
      SpiChannel_35584 (SpiChannel): SpiChannelId=2, SpiChannelType=EB, SpiDataWidth=32, SpiEbMaxLength=8190, SpiIbNBuffers=10, SpiTransferStart=LSB
      SpiExternalDevice_35584 (SpiExternalDevice):
        SpiBaudrate = 1000000
        SpiCsIdentifier = CHANNEL5
        SpiCsPolarity = LOW
        SpiDataShiftEdge = LEADING
        SpiEnableCs = true
        SpiHwUnit = QSPI1
        SpiAutoCalcBaudParams = true
        SpiAutoCalcDelayParams = true
        SpiIdleTime = 1E-7
        SpiTrailingTime = 1E-7
        SpiShiftClockIdleLevel = LOW
        SpiTimeClk2Cs = 1E-7
        SpiParitySupport = UNUSED
        SpiCsSelection = CS_VIA_PERIPHERAL_ENGINE
      SpiJob_35584 (SpiJob): SpiJobId=2, SpiFrameBasedCS=false, SpiJobPriority=0, SpiHwUnitSynchronous=ASYNCHRONOUS, SpiDeviceAssignment=SpiExternalDevice_35584
        SpiChannelList: SpiChannelIndex=0, SpiChannelAssignment=SpiChannel_35584
      SpiSequence_35584 (SpiSequence): SpiInterruptibleSequence=false, SpiSequenceId=2, SpiJobAssignment=SpiJob_35584
    SpiGeneral:
      SpiCancelApi = true
      SpiChannelBuffersAllowed = 1
      SpiInitDeInitApiMode = SPI_MCAL_SUPERVISOR
      SpiInitCheckApi = false
      SpiMultiCoreErrorDetect = false
      SpiRuntimeApiMode = SPI_MCAL_SUPERVISOR
      SpiDevErrorDetect = true
      SpiSafetyEnable = false
      SpiHwStatusApi = true
      SpiEnableLoopBackApi = true
      SpiInterruptibleSeqAllowed = true
      SpiLevelDelivered = 2
      SpiSupportConcurrentSyncTransmit = false
      SpiSyncTransmitTimeoutDuration = 65535
      SpiVersionInfoApi = false
      SpiMainFunctionPeriod = 0.005
    SpiHwConfiguration
      3 x SpiHwConfigurationQspi, all with SpiJobQueueLengthQspix=2, SpiSleepEnableQspix=false, SpiExternalDemux=false, SpiSLSO0StrobeDelay=2:
        SpiHwConfigurationQspi_9183: SpiHwConfigKernel=QSPI3, SpiHWPinMRSTQspix=MRST3D_PORT22_PIN1
          SpiHwDmaConfigurationQspi: SpiHwDmaChannelReceptionRef=DmaChannelConfig_9180Rx, SpiHwDmaChannelTransmissionRef=DmaChannelConfig_9180Tx
        SpiHwConfigurationQspi_5012: SpiHwConfigKernel=QSPI2, SpiHWPinMRSTQspix=MRST2B_PORT15_PIN7
          SpiHwDmaConfigurationQspi: SpiHwDmaChannelReceptionRef=DmaChannelConfig_5012Rx, SpiHwDmaChannelTransmissionRef=DmaChannelConfig_5012Tx
        SpiHwConfigurationQspi_35584: SpiHwConfigKernel=QSPI1, SpiHWPinMRSTQspix=MRST1B_PORT11_PIN3
          SpiHwDmaConfigurationQspi: SpiHwDmaChannelReceptionRef=DmaChannelConfig_35584Rx, SpiHwDmaChannelTransmissionRef=DmaChannelConfig_35584Tx
    SpiPublishedInformation: SpiMaxHwUnit=4
    CommonPublishedInformation:
      ArMajorVersion = 4
      ArMinorVersion = 2
      ArPatchVersion = 2
      SwMajorVersion = 20
      SwMinorVersion = 10
      SwPatchVersion = 0
      ModuleId = 83
      VendorId = 17
      Release = _TRICORE_TC364_TQFP
    SpiDemEventParameterRefs
