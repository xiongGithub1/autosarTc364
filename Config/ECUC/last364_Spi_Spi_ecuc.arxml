AUTOSAR XML (schema 00048)
package /ActiveEcuC
  module config Spi: implementation-config-variant=VARIANT-POST-BUILD-LOADABLE, module-description=Spi_Impl
    SpiDriver: SpiMaxChannel=1, SpiMaxJob=1, SpiMaxSequence=1, SpiSystemClock=McuClockReferencePointConfig
      SpiChannel_9183 (SpiChannel): SpiChannelId=0, SpiChannelType=EB, SpiDataWidth=24, SpiTransferStart=MSB, SpiEbMaxLength=8190, SpiIbNBuffers=10
      SpiExternalDevice_9183 (SpiExternalDevice):
        SpiBaudrate = 100000
        SpiCsIdentifier = CHANNEL12
        SpiCsPolarity = LOW
        SpiDataShiftEdge = TRAILING
        SpiEnableCs = true
        SpiHwUnit = QSPI3
        SpiAutoCalcBaudParams = true
        SpiAutoCalcDelayParams = true
        SpiIdleTime = 1E-7
        SpiTrailingTime = 1E-7
        SpiShiftClockIdleLevel = LOW
        SpiTimeClk2Cs = 1E-7
        SpiParitySupport = UNUSED
        SpiCsSelection = CS_VIA_PERIPHERAL_ENGINE
        SpiBaudrateParams: SpiBaudParamTQ=2, SpiBaudParamQ=10, SpiBaudParamA=1, SpiBaudParamB=0, SpiBaudParamC=1
        SpiDelayParams:
          SpiDelayParamTrailPre = 0
          SpiDelayParamTrailLength = 5
          SpiDelayParamIdlePre = 0
          SpiDelayParamIdleLength = 1
          SpiDelayParamLeadPre = 0
          SpiDelayParamLeadLength = 7
      SpiJob_9183 (SpiJob): SpiJobId=0, SpiFrameBasedCS=false, SpiJobPriority=0, SpiDeviceAssignment=SpiExternalDevice_9183
        SpiChannelList: SpiChannelIndex=0, SpiChannelAssignment=SpiChannel_9183
      SpiSequence: SpiInterruptibleSequence=false, SpiSequenceId=0, SpiJobAssignment=SpiJob_9183
    SpiGeneral:
      SpiCancelApi = true
      SpiChannelBuffersAllowed = 1
      SpiInitDeInitApiMode = SPI_MCAL_SUPERVISOR
      SpiInitCheckApi = false
      SpiMultiCoreErrorDetect = false
      SpiRuntimeApiMode = SPI_MCAL_SUPERVISOR
      SpiDevErrorDetect = true
      SpiSafetyEnable = false
      SpiHwStatusApi = true
      SpiEnableLoopBackApi = true
      SpiInterruptibleSeqAllowed = false
      SpiLevelDelivered = 0
      SpiSupportConcurrentSyncTransmit = false
      SpiSyncTransmitTimeoutDuration = 65535
      SpiVersionInfoApi = false
    SpiHwConfiguration
      SpiHwConfigurationQspi:
        SpiHwConfigKernel = QSPI3
        SpiJobQueueLengthQspix = 2
        SpiSleepEnableQspix = false
        SpiHWPinMRSTQspix = MRST3D_PORT22_PIN1
        SpiExternalDemux = false
        SpiSLSO0StrobeDelay = 2
    SpiPublishedInformation: SpiMaxHwUnit=4
    CommonPublishedInformation:
      ArMajorVersion = 4
      ArMinorVersion = 2
      ArPatchVersion = 2
      SwMajorVersion = 20
      SwMinorVersion = 10
      SwPatchVersion = 0
      ModuleId = 83
      VendorId = 17
      Release = _TRICORE_TC364_TQFP
