AUTOSAR XML (schema 00048)
package /ActiveEcuC
  module config Pwm: implementation-config-variant=VARIANT-POST-BUILD-LOADABLE, module-description=Pwm_Impl
    PwmChannelConfigSet
      4 x PwmChannel, all with PwmAssignedHwUnit=GTM, PwmDutycycleDefault=0, PwmIdleState=PWM_LOW, PwmPeriodDefault=10000, PwmPolarity=PWM_LOW, PwmShiftValue=0, PwmMcuClockReferencePoint=McuClockReferencePoint_Pwm, PwmReferenceChannel=PwmChannel_9180REF:
        PwmChannel_9180IH1: PwmChannelId=1, PwmChannelClass=PWM_FIXED_PERIOD_CENTER_ALIGNED, PwmCoherentUpdate=true
          GtmTimerOutputModuleConfiguration: GtmTimerClockSelect=GTM_CONFIGURABLE_CLOCK_0, GtmTimerUsed=McuGtmAtomChannelAllocationConf_1
        PwmChannel_9180IH2: PwmChannelId=2, PwmChannelClass=PWM_FIXED_PERIOD_CENTER_ALIGNED, PwmCoherentUpdate=true
          GtmTimerOutputModuleConfiguration: GtmTimerClockSelect=GTM_CONFIGURABLE_CLOCK_0, GtmTimerUsed=McuGtmAtomChannelAllocationConf_2
        PwmChannel_9180IH3: PwmChannelId=3, PwmChannelClass=PWM_FIXED_PERIOD_CENTER_ALIGNED, PwmCoherentUpdate=true
          GtmTimerOutputModuleConfiguration: GtmTimerClockSelect=GTM_CONFIGURABLE_CLOCK_0, GtmTimerUsed=McuGtmAtomChannelAllocationConf_3
        PwmChannel_9180REF: PwmChannelId=0, PwmChannelClass=PWM_FIXED_PERIOD, PwmCoherentUpdate=false
          GtmTimerOutputModuleConfiguration: GtmTimerClockSelect=GTM_CONFIGURABLE_CLOCK_0, GtmTimerUsed=McuGtmAtomChannelAllocationConf_0
    PwmConfigurationOfOptApiServices: PwmDeInitApi=true, PwmGetOutputState=true, PwmSetDutyCycle=true, PwmSetOutputToIdle=false, PwmSetPeriodAndDuty=true, PwmVersionInfoApi=false
    PwmGeneral:
      PwmDevErrorDetect = true
      PwmMultiCoreErrorDetect = false
      PwmDutycycleUpdatedEndperiod = false
      PwmIndex = 0
      PwmNotificationSupported = false
      PwmPeriodUpdatedEndperiod = false
      PwmChannelCoherentSelection = false
      PwmHandleShiftByOffset = false
      PwmDutyShiftInTicks = false
      PwmEnable0Or100DutyNotification = false
      PwmPowerStateAsynchTransitionMode = false
      PwmSafetyEnable = false
      PwmInitCheckApi = true
    CommonPublishedInformation:
      ArMajorVersion = 4
      ArMinorVersion = 2
      ArPatchVersion = 2
      SwMajorVersion = 20
      SwMinorVersion = 10
      SwPatchVersion = 0
      ModuleId = 121
      VendorId = 17
      VendorApiInfix = GtmCcu6
      Release = _TRICORE_TC364_TQFP
