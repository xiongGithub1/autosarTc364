AUTOSAR XML (schema 00048)
package /ActiveEcuC
  module config Pwm: implementation-config-variant=VARIANT-POST-BUILD-LOADABLE, module-description=Pwm_Impl
    PwmChannelConfigSet
      6 x PwmChannel, all with PwmChannelClass=PWM_FIXED_PERIOD, PwmAssignedHwUnit=GTM, PwmDutycycleDefault=20000, PwmIdleState=PWM_LOW, PwmPeriodDefault=40000, PwmPolarity=PWM_LOW, PwmShiftValue=0, PwmCoherentUpdate=false, PwmMcuClockReferencePoint=McuClockReferencePoint_Pwm:
        PwmChannel_9183IH1: PwmChannelId=0, PwmReferenceChannel=PwmChannel_9183IH1
          GtmTimerOutputModuleConfiguration: GtmTimerClockSelect=GTM_FIXED_CLOCK_0, GtmTimerUsed=McuGtmTomChannelAllocationConf_9
        PwmChannel_9183IH2: PwmChannelId=1, PwmReferenceChannel=PwmChannel_9183IH2
          GtmTimerOutputModuleConfiguration: GtmTimerClockSelect=GTM_FIXED_CLOCK_0, GtmTimerUsed=McuGtmTomChannelAllocationConf_10
        PwmChannel_9183IH3: PwmChannelId=2, PwmReferenceChannel=PwmChannel_9183IH3
          GtmTimerOutputModuleConfiguration: GtmTimerClockSelect=GTM_FIXED_CLOCK_0, GtmTimerUsed=McuGtmTomChannelAllocationConf_11
        PwmChannel_9183IL1: PwmChannelId=3, PwmReferenceChannel=PwmChannel_9183IL1
          GtmTimerOutputModuleConfiguration: GtmTimerClockSelect=GTM_FIXED_CLOCK_0, GtmTimerUsed=McuGtmTomChannelAllocationConf_12
        PwmChannel_9183IL2: PwmChannelId=4, PwmReferenceChannel=PwmChannel_9183IL2
          GtmTimerOutputModuleConfiguration: GtmTimerClockSelect=GTM_FIXED_CLOCK_0, GtmTimerUsed=McuGtmTomChannelAllocationConf_13
        PwmChannel_9183IL3: PwmChannelId=5, PwmReferenceChannel=PwmChannel_9183IL3
          GtmTimerOutputModuleConfiguration: GtmTimerClockSelect=GTM_FIXED_CLOCK_0, GtmTimerUsed=McuGtmTomChannelAllocationConf_14
    PwmConfigurationOfOptApiServices: PwmDeInitApi=true, PwmGetOutputState=true, PwmSetDutyCycle=true, PwmSetOutputToIdle=false, PwmSetPeriodAndDuty=true, PwmVersionInfoApi=false
    PwmGeneral:
      PwmDevErrorDetect = true
      PwmMultiCoreErrorDetect = false
      PwmDutycycleUpdatedEndperiod = false
      PwmIndex = 0
      PwmNotificationSupported = false
      PwmPeriodUpdatedEndperiod = false
      PwmChannelCoherentSelection = false
      PwmHandleShiftByOffset = false
      PwmDutyShiftInTicks = false
      PwmEnable0Or100DutyNotification = false
      PwmPowerStateAsynchTransitionMode = false
      PwmSafetyEnable = false
      PwmInitCheckApi = true
    CommonPublishedInformation:
      ArMajorVersion = 4
      ArMinorVersion = 2
      ArPatchVersion = 2
      SwMajorVersion = 20
      SwMinorVersion = 10
      SwPatchVersion = 0
      ModuleId = 121
      VendorId = 17
      VendorApiInfix = GtmCcu6
      Release = _TRICORE_TC364_TQFP
