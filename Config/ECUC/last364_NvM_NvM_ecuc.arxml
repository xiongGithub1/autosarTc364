AUTOSAR XML (schema 00048)
package /ActiveEcuC
  module config NvM: implementation-config-variant=VARIANT-PRE-COMPILE, module-description=NvM_Impl
    NvMConfigBlock (NvMBlockDescriptor):
      NvMBlockCrcType = NVM_CRC16
      NvMSelectBlockForWriteAll = true
      NvMBlockUseCrc = true
      NvMNvramBlockIdentifier = 1
      NvMBlockManagementType = NVM_BLOCK_REDUNDANT
      NvMNvBlockNum = 2
      NvMNvBlockLength = 2
      NvMSelectBlockForReadAll = true
      NvMResistantToChangedSw = true
      NvMUseInitCallback = false
      NvMCalcRamBlockCrc = false
      NvMRomBlockDataAddress = NULL_PTR
      NvMBlockPostReadTransformCallback = NULL_PTR
      NvMBlockPreWriteTransformCallback = NULL_PTR
      NvMBlockUseSetRamBlockStatus = true
      NvMBlockJobPriority = 127
      NvMBlockUseSyncMechanism = false
      NvMBlockWriteProt = false
      NvMBswMBlockStatusInformation = false
      NvMWriteBlockOnce = false
      NvMUseServicePorts = false
      NvMUseJobendCallback = false
      NvMBlockUseCRCCompMechanism = false
      NvMInvokeCallbacksForReadAll = true
      NvMInvokeCallbacksForWriteAll = true
      NvMCheckLossOfRedundancy = false
      NvMAutomaticBlockLength = false
      NvMTargetBlockReference
        NvMFeeRef: NvMNameOfFeeBlock=FeeBlockConfiguration
    NvMCommon:
      NvMApiConfigClass = NVM_API_CONFIG_CLASS_3
      NvMBswMMultiBlockJobStatusInformation = false
      NvMCompiledConfigId = 1
      NvMCrcNumOfBytes = 64
      NvMDatasetSelectionBits = 4
      NvMDevErrorDetect = true
      NvMDrvModeSwitch = true
      NvMDynamicConfiguration = false
      NvMJobPrioritization = false
      NvMPollingMode = true
      NvMSetRamBlockStatusApi = true
      NvMSizeStandardJobQueue = 8
      NvMVersionInfoApi = false
      NvMMaxNoOfWriteRetries = 1
      NvMMainFunctionPeriod = 0.01
      NvMUseBlockIdCheck = false
      NvMRepairRedundantBlocksApi = false
      NvMSafeBswChecks = false
      NvMDetectedLossOfRedundancyCallback = NULL_PTR
    NvMCommonVendorParams: NvMDataIntegrityIntBuffer=true, NvMKillWriteAllApi=true
    NvMBlock_MotorZeroCal (NvMBlockDescriptor):
      NvMBlockCrcType = NVM_CRC16
      NvMSelectBlockForWriteAll = false
      NvMBlockUseCrc = true
      NvMBlockJobPriority = 127
      NvMBlockManagementType = NVM_BLOCK_NATIVE
      NvMBlockUseSyncMechanism = false
      NvMBlockWriteProt = false
      NvMBswMBlockStatusInformation = false
      NvMNvBlockLength = 4
      NvMNvBlockNum = 1
      NvMNvramBlockIdentifier = 2
      NvMResistantToChangedSw = true
      NvMWriteBlockOnce = false
      NvMUseServicePorts = false
      NvMUseJobendCallback = false
      NvMUseInitCallback = false
      NvMBlockUseCRCCompMechanism = false
      NvMBlockUseSetRamBlockStatus = false
      NvMInvokeCallbacksForReadAll = true
      NvMInvokeCallbacksForWriteAll = true
      NvMCheckLossOfRedundancy = false
      NvMAutomaticBlockLength = false
      NvMSelectBlockForReadAll = false
      NvMRamBlockDataAddress = NULL_PTR
      NvMWriteRamBlockToNvCallback = NULL_PTR
      NvMReadRamBlockFromNvCallback = NULL_PTR
      NvMTargetBlockReference
        NvMFeeRef: NvMNameOfFeeBlock=FeeBlock_MotorZeroCal
