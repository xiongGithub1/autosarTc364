AUTOSAR XML (schema 00048)
package /ActiveEcuC
  module config NvM: implementation-config-variant=VARIANT-PRE-COMPILE, module-description=NvM_Impl
    NvMConfigBlock (NvMBlockDescriptor):
      NvMBlockCrcType = NVM_CRC16
      NvMSelectBlockForWriteAll = true
      NvMBlockUseCrc = true
      NvMNvramBlockIdentifier = 1
      NvMBlockManagementType = NVM_BLOCK_REDUNDANT
      NvMNvBlockNum = 2
      NvMNvBlockLength = 2
      NvMSelectBlockForReadAll = true
      NvMResistantToChangedSw = true
      NvMUseInitCallback = false
      NvMCalcRamBlockCrc = false
      NvMRomBlockDataAddress = NULL_PTR
      NvMBlockPostReadTransformCallback = NULL_PTR
      NvMBlockPreWriteTransformCallback = NULL_PTR
      NvMBlockUseSetRamBlockStatus = true
      NvMBlockJobPriority = 127
      NvMBlockUseSyncMechanism = false
      NvMBlockWriteProt = false
      NvMBswMBlockStatusInformation = false
      NvMWriteBlockOnce = false
      NvMUseServicePorts = false
      NvMUseJobendCallback = false
      NvMBlockUseCRCCompMechanism = false
      NvMInvokeCallbacksForReadAll = true
      NvMInvokeCallbacksForWriteAll = true
      NvMCheckLossOfRedundancy = false
      NvMAutomaticBlockLength = false
      NvMTargetBlockReference
        NvMFeeRef: NvMNameOfFeeBlock=FeeBlockConfiguration
    NvMCommon:
      NvMApiConfigClass = NVM_API_CONFIG_CLASS_3
      NvMBswMMultiBlockJobStatusInformation = false
      NvMCompiledConfigId = 1
      NvMCrcNumOfBytes = 64
      NvMDatasetSelectionBits = 4
      NvMDevErrorDetect = true
      NvMDrvModeSwitch = true
      NvMDynamicConfiguration = false
      NvMJobPrioritization = false
      NvMPollingMode = true
      NvMSetRamBlockStatusApi = true
      NvMSizeStandardJobQueue = 8
      NvMVersionInfoApi = false
      NvMMaxNoOfWriteRetries = 1
      NvMMainFunctionPeriod = 0.01
      NvMUseBlockIdCheck = false
      NvMRepairRedundantBlocksApi = false
      NvMSafeBswChecks = false
      NvMDetectedLossOfRedundancyCallback = NULL_PTR
    NvMCommonVendorParams: NvMDataIntegrityIntBuffer=true, NvMKillWriteAllApi=true
    NvMBlock_MotorZeroCal (NvMBlockDescriptor):
      NvMBlockCrcType = NVM_CRC16
      NvMSelectBlockForWriteAll = false
      NvMBlockUseCrc = true
      NvMBlockJobPriority = 127
      NvMBlockManagementType = NVM_BLOCK_NATIVE
      NvMBlockUseSyncMechanism = false
      NvMBlockWriteProt = false
      NvMBswMBlockStatusInformation = false
      NvMNvBlockLength = 4
      NvMNvBlockNum = 1
      NvMNvramBlockIdentifier = 2
      NvMResistantToChangedSw = true
      NvMWriteBlockOnce = false
      NvMUseServicePorts = false
      NvMUseJobendCallback = false
      NvMUseInitCallback = false
      NvMBlockUseCRCCompMechanism = false
      NvMBlockUseSetRamBlockStatus = false
      NvMInvokeCallbacksForReadAll = true
      NvMInvokeCallbacksForWriteAll = true
      NvMCheckLossOfRedundancy = false
      NvMAutomaticBlockLength = false
      NvMSelectBlockForReadAll = false
      NvMRamBlockDataAddress = NULL_PTR
      NvMWriteRamBlockToNvCallback = NULL_PTR
      NvMReadRamBlockFromNvCallback = NULL_PTR
      NvMTargetBlockReference
        NvMFeeRef: NvMNameOfFeeBlock=FeeBlock_MotorZeroCal
    NvmDemEventParameterRefs
    10 x NvMBlockDescriptor, all with NvMBlockCrcType=NVM_CRC16, NvMSelectBlockForWriteAll=false, NvMBlockUseCrc=true, NvMBlockJobPriority=127, NvMBlockWriteProt=false, NvMBswMBlockStatusInformation=false, NvMResistantToChangedSw=true, NvMWriteBlockOnce=false, NvMUseServicePorts=false, NvMUseJobendCallback=false, NvMUseInitCallback=false, NvMBlockUseCRCCompMechanism=false, NvMBlockUseSetRamBlockStatus=false, NvMInvokeCallbacksForReadAll=true, NvMInvokeCallbacksForWriteAll=true, NvMCheckLossOfRedundancy=false, NvMBlockUseSyncMechanism=false:
      NvMBlock_DemAdmin: NvMBlockManagementType=NVM_BLOCK_REDUNDANT, NvMNvBlockNum=2, NvMNvramBlockIdentifier=3, NvMAutomaticBlockLength=false, NvMNvBlockLength=32, NvMSelectBlockForReadAll=false, NvMRamBlockDataAddress=NULL_PTR
        NvMTargetBlockReference
          NvMFeeRef: NvMNameOfFeeBlock=FeeBlock_DemAdmin
      NvMBlock_DemPrimary1: NvMBlockManagementType=NVM_BLOCK_NATIVE, NvMNvBlockLength=1, NvMNvBlockNum=1, NvMNvramBlockIdentifier=4
        NvMTargetBlockReference
          NvMFeeRef: NvMNameOfFeeBlock=FeeBlockConfiguration_DemPrimary1
      NvMBlock_DemPrimary2: NvMBlockManagementType=NVM_BLOCK_NATIVE, NvMNvBlockLength=1, NvMNvBlockNum=1, NvMNvramBlockIdentifier=5
        NvMTargetBlockReference
          NvMFeeRef: NvMNameOfFeeBlock=FeeBlockConfiguration_DemPrimary2
      NvMBlock_DemPrimary3: NvMBlockManagementType=NVM_BLOCK_NATIVE, NvMNvBlockLength=1, NvMNvBlockNum=1, NvMNvramBlockIdentifier=6
        NvMTargetBlockReference
          NvMFeeRef: NvMNameOfFeeBlock=FeeBlockConfiguration_DemPrimary3
      NvMBlock_DemPrimary4: NvMBlockManagementType=NVM_BLOCK_NATIVE, NvMNvBlockLength=1, NvMNvBlockNum=1, NvMNvramBlockIdentifier=7
        NvMTargetBlockReference
          NvMFeeRef: NvMNameOfFeeBlock=FeeBlockConfiguration_DemPrimary4
      NvMBlock_DemPrimary5: NvMBlockManagementType=NVM_BLOCK_NATIVE, NvMNvBlockLength=1, NvMNvBlockNum=1, NvMNvramBlockIdentifier=8
        NvMTargetBlockReference
          NvMFeeRef: NvMNameOfFeeBlock=FeeBlockConfiguration_DemPrimary5
      NvMBlock_DemPrimary6: NvMBlockManagementType=NVM_BLOCK_NATIVE, NvMNvBlockLength=1, NvMNvBlockNum=1, NvMNvramBlockIdentifier=9
        NvMTargetBlockReference
          NvMFeeRef: NvMNameOfFeeBlock=FeeBlockConfiguration_DemPrimary6
      NvMBlock_DemPrimary7: NvMBlockManagementType=NVM_BLOCK_NATIVE, NvMNvBlockLength=1, NvMNvBlockNum=1, NvMNvramBlockIdentifier=10
        NvMTargetBlockReference
          NvMFeeRef: NvMNameOfFeeBlock=FeeBlockConfiguration_DemPrimary7
      NvMBlock_DemPrimary8: NvMBlockManagementType=NVM_BLOCK_NATIVE, NvMNvBlockLength=1, NvMNvBlockNum=1, NvMNvramBlockIdentifier=11
        NvMTargetBlockReference
          NvMFeeRef: NvMNameOfFeeBlock=FeeBlockConfiguration_DemPrimary8
      NvMBlock_DemPrimary9: NvMBlockManagementType=NVM_BLOCK_NATIVE, NvMNvBlockLength=1, NvMNvBlockNum=1, NvMNvramBlockIdentifier=12
        NvMTargetBlockReference
          NvMFeeRef: NvMNameOfFeeBlock=FeeBlockConfiguration_DemPrimary9
