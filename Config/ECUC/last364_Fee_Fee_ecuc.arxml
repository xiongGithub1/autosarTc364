AUTOSAR XML (schema 00048)
package /ActiveEcuC
  module config Fee: implementation-config-variant=VARIANT-POST-BUILD-LOADABLE, module-description=Fee_Impl
    FeeGeneral:
      FeeDevErrorDetect = true
      FeeSafetyEnable = false
      FeeInitCheckApi = false
      FeeMainFunctionPeriod = 0.01
      FeePollingMode = false
      FeeSetModeSupported = true
      FeeVersionInfoApi = false
      FeeVirtualPageSize = 8
      FeeBlockTypeConfigured = FEE_DOUBLE_SECTOR_DATA_ONLY
    FeePublishedInformation: FeeBlockOverhead=17, FeePageOverhead=1
    FeeIfxSpecificConfig:
      FeeThresholdValue = 200
      FeeMaxBlockCount = 3
      FeeBlocksScannedPerCycle = 0
      FeeUseEraseSuspend = false
      FeeStateVarStructure = Fee_StateVar
      FeeUnConfigBlock = FEE_UNCONFIG_BLOCK_IGNORE
      FeeUnConfigBlkOverflowHandle = FEE_CONTINUE
      FeeGcRestart = FEE_GC_RESTART_INIT
      FeeGetCycleCountApi = false
      FeeEccErrorInfoApi = false
      FeeEraseAllEnable = false
      FeeGetPrevDataApi = false
      FeeCancelAllApi = false
      FeeMaxBytesPerCycle = FEE_MAX_BYTES_512
      FeeNvmIllegalStateNotification = NULL_PTR
      FeeQsIllegalStateNotification = NULL_PTR
      FeeQsHardenErrorNotification = NULL_PTR
      FeeVirginFlashIllegalState = false
    CommonPublishedInformation:
      ArMajorVersion = 4
      ArMinorVersion = 2
      ArPatchVersion = 2
      SwMajorVersion = 20
      SwMinorVersion = 10
      SwPatchVersion = 0
      ModuleId = 21
      VendorId = 17
      Release = _TRICORE_TC364_TQFP
    3 x FeeBlockConfiguration, all with FeeQsBlockInstances=0, FeeQsBlockAddress=0, FeeQuasiStaticManager=false, FeeImmediateData=false, FeeNumberOfWriteCycles=0, FeeDeviceIndex=FlsGeneral:
      FeeBlockConfiguration: FeeBlockNumber=16, FeeBlockSize=4
      FeeBlock_MotorZeroCal: FeeBlockNumber=32, FeeBlockSize=6
      FeeBlockConfiguration_cons0: FeeBlockNumber=17, FeeBlockSize=4
