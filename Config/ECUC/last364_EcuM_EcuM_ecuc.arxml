AUTOSAR XML (schema 00048)
package /ActiveEcuC
  module config EcuM: implementation-config-variant=VARIANT-PRE-COMPILE, module-description=EcuM_Impl
    EcuMConfiguration
      EcuMFlexConfiguration:
        EcuMFlexModuleConfigurationRef = CanConfigSet
        EcuMNormalMcuModeRef = McuModeSettingConf_0
        EcuMPartitionRef = EcucPartition_core0
        EcuMPartitionRef = EcucPartition_core1
        ECUM_CAUSE_UNKNOWN (EcuMShutdownCause): EcuMShutdownCauseId=0
        ECUM_RESET_IO (EcuMResetMode): EcuMResetModeId=2
        ECUM_RESET_MCU (EcuMResetMode): EcuMResetModeId=0
        ECUM_CAUSE_DCM (EcuMShutdownCause): EcuMShutdownCauseId=3
        ECUM_RESET_WAKEUP (EcuMResetMode): EcuMResetModeId=3
        ECUM_CAUSE_ECU_STATE (EcuMShutdownCause): EcuMShutdownCauseId=1
        ECUM_RESET_WDG (EcuMResetMode): EcuMResetModeId=1
        ECUM_CAUSE_WDGM (EcuMShutdownCause): EcuMShutdownCauseId=2
      EcuMCommonConfiguration: EcuMConfigConsistencyHash=10795314041073790662, EcuMDefaultAppMode=OSDEFAULTAPPMODE, EcuMOSResource=OsResource_EcuM
        CN_CAN00_5e566ad9 (EcuMWakeupSource): EcuMWakeupSourceId=5, EcuMWakeupSourcePolling=false, EcuMComMChannelRef=CN_CAN00_5e566ad9
        ECUM_WKSOURCE_POWER (EcuMWakeupSource): EcuMWakeupSourceId=0, EcuMValidationTimeout=0, EcuMCheckWakeupTimeout=0, EcuMWakeupSourcePolling=false
        EcuMDriverInitListOne
          16 x EcuMDriverInitItem:
            Mcu_Init: EcuMModuleID=Mcu, EcuMModuleHeader=Mcu.h, EcuMModuleService=Mcu_Init
            Mcu_InitClock: EcuMModuleID=Code, EcuMAdditionalInitCode=Mcu_InitClock(McuConf_McuModeSettingConf_McuModeSettingConf_0)
            Mcu_GetPllStatus: EcuMModuleID=Code, EcuMAdditionalInitCode=while (Mcu_GetPllStatus() != MCU_PLL_LOCKED)
            Mcu_DistributePllClock: EcuMModuleID=Code, EcuMAdditionalInitCode=Mcu_DistributePllClock(), EcuMModuleHeader=
            Port_Init: EcuMModuleID=Port, EcuMModuleHeader=Port.h, EcuMModuleService=Port_Init
            Adc_Init: EcuMModuleID=Adc, EcuMModuleService=Adc_Init, EcuMModuleHeader=Adc.h
            Dma_Init: EcuMModuleID=Dma, EcuMModuleHeader=Dma.h, EcuMModuleService=Dma_Init
            PduR_PreInit: EcuMModuleID=PduR, EcuMModuleHeader=PduR.h, EcuMModuleService=PduR_PreInit
            Fls_17_Dmu_Init: EcuMModuleID=Fls_17_Dmu, EcuMModuleService=Fls_17_Dmu_Init, EcuMModuleHeader=Fls_17_Dmu.h
            Fee_Init: EcuMModuleID=Fee, EcuMModuleService=Fee_Init, EcuMModuleHeader=Fee.h
            IrqDma_Init: EcuMModuleID=Irq, EcuMModuleService=IrqDma_Init, EcuMModuleHeader=Irq.h
            IrqSpi_Init: EcuMModuleID=Irq, EcuMModuleService=IrqSpi_Init, EcuMModuleHeader=Irq.h
            Spi_Init: EcuMModuleID=Spi, EcuMModuleService=Spi_Init, EcuMModuleHeader=Spi.h
            CanXcp_Init: EcuMModuleID=CanXcp, EcuMModuleService=CanXcp_Init, EcuMModuleHeader=CanXcp.h
            Dem_PreInit: EcuMModuleID=Dem, EcuMModuleHeader=Dem.h, EcuMModuleService=Dem_PreInit
            BswM_PreInit: EcuMModuleID=BswM, EcuMModuleHeader=BswM.h, EcuMModuleService=BswM_PreInit
        3 x EcuMWakeupSource, all with EcuMValidationTimeout=0, EcuMCheckWakeupTimeout=0, EcuMWakeupSourcePolling=false:
          ECUM_WKSOURCE_INTERNAL_WDG: EcuMWakeupSourceId=3
          ECUM_WKSOURCE_INTERNAL_RESET: EcuMWakeupSourceId=2
          ECUM_WKSOURCE_RESET: EcuMWakeupSourceId=1
        EcuMDefaultShutdownTarget: EcuMDefaultState=EcuMStateOff
        EcuMDriverRestartList
        ECUM_WKSOURCE_EXTERNAL_WDG (EcuMWakeupSource): EcuMWakeupSourceId=4, EcuMValidationTimeout=0, EcuMCheckWakeupTimeout=0, EcuMWakeupSourcePolling=false
        EcuMDriverInitListZero
          10 x EcuMDriverInitItem:
            BswM_InitMemory: EcuMModuleID=BswM, EcuMModuleHeader=BswM.h, EcuMModuleService=BswM_InitMemory
            Can_InitMemory: EcuMModuleID=Can, EcuMModuleHeader=Can.h, EcuMModuleService=Can_InitMemory
            CanIf_InitMemory: EcuMModuleID=CanIf, EcuMModuleHeader=CanIf.h, EcuMModuleService=CanIf_InitMemory
            CanSM_InitMemory: EcuMModuleID=CanSM, EcuMModuleHeader=CanSM_EcuM.h, EcuMModuleService=CanSM_InitMemory
            Com_InitMemory: EcuMModuleID=Com, EcuMModuleHeader=Com.h, EcuMModuleService=Com_InitMemory
            ComM_InitMemory: EcuMModuleID=ComM, EcuMModuleHeader=ComM.h, EcuMModuleService=ComM_InitMemory
            Det_InitMemory: EcuMModuleID=Det, EcuMModuleHeader=Det.h, EcuMModuleService=Det_InitMemory
            PduR_InitMemory: EcuMModuleID=PduR, EcuMModuleHeader=PduR.h, EcuMModuleService=PduR_InitMemory
            Rte_InitMemory: EcuMModuleID=Rte, EcuMModuleHeader=Rte_Main.h, EcuMModuleService=Rte_InitMemory
            CanXcp_InitMemory: EcuMModuleID=CanXcp, EcuMModuleService=CanXcp_InitMemory, EcuMModuleHeader=CanXcp.h
      EcuMFixedConfiguration:
        EcuMNvramWriteallTimeout = 60
        EcuMRunMinimumDuration = 5
        EcuMNormalMcuModeRef = McuModeSettingConf_0
        EcuMComMCommunicationAllowedList = CN_CAN00_5e566ad9
        EcuMFixedUserConfig: EcuMFixedUser=0
    EcuMGeneral:
      EcuMDevErrorDetect = true
      EcuMIncludeDem = false
      EcuMIncludeDet = true
      EcuMMainFunctionPeriod = 0.01
      EcuMVersionInfoApi = true
      EcuMDeferredBswMNotification = false
      EcuMSlaveCoreHandling = true
      EcuMEnableFixBehavior = true
      EcuMNonChannelWakeupInRun = false
      EcuMSchMStartInitialization = true
      EcuMSafeBswChecks = false
      EcuMBswCoreId = 0
      EcuMGeneration: EcuMOutOfBoundsWriteSanitizer=false, EcuMOutOfBoundsReadSanitizer=false, EcuMInterfacesForDeactivatedData=false
    EcuMFlexGeneral: EcuMAlarmClockPresent=false, EcuMModeHandling=false
    EcuMFixedGeneral: EcuMIncludeComM=true, EcuMIncludeNvramMgr=false, EcuMIncludeRte=true, EcuMGenModeSwitchPort=true, EcuMModeSwitchRteAck=true, EcuMIncludeDem=false
