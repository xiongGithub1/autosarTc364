AUTOSAR XML (schema 00048)
package /ActiveEcuC
  module config CanTp: implementation-config-variant=VARIANT-PRE-COMPILE, module-description=CanTp_Impl
    CanTpGeneral:
      CanTpChangeParameterApi = false
      CanTpDevErrorDetect = true
      CanTpPaddingByte = 204
      CanTpReadParameterApi = false
      CanTpVersionInfoApi = false
      CanTpPaddingActive = true
      CanTpHavePaddingByte = false
      CanTpNumRxChannels = 0
      CanTpNumTxChannels = 0
      CanTpEnableSplitMainFunction = false
      CanTpSupportStandardAddressing = true
      CanTpSupportExtendedAddressing = true
      CanTpSupportMixed11Addressing = true
      CanTpSupportMixed29Addressing = true
      CanTpSupportNormalFixedAddressing = true
      CanTpSupportCustomAddressing = false
      CanTpOnlyNotifyInformedAppl = true
      CanTpRc = false
      CanTpTc = true
      CanTpSafeBswChecks = false
      CanTpUseOnlyFirstFc = true
    CanTpConfig: CanTpMainFunctionPeriod=0.005
      TPCH_55d4e4b9 (CanTpChannel): CanTpChannelMode=CANTP_MODE_FULL_DUPLEX
        CanTpTxNSdu_550eef02 (CanTpTxNSdu):
          CanTpTxAddressingFormat = CANTP_STANDARD
          CanTpTxDl = 8
          CanTpTxTaType = CANTP_PHYSICAL
          CanTpNas = 0.1
          CanTpNcs = 0.2
          CanTpTc = false
          CanTpTxNSduId = 0
          CanTpTxPaddingActivation = CANTP_ON
          CanTpNbs = 0.5
          CanTpTxNSduRef = msg_diag_Response_MyECU_oCAN00_45311294_Tx
          CanTpRxFcNPdu_2548538f (CanTpRxFcNPdu): CanTpRxFcNPduId=0, CanTpRxFcNPduRef=msg_diag_Request_MyECU_Tp_oCAN00_ecbacca2_Rx
          CanTpTxNPdu_2548538f (CanTpTxNPdu): CanTpTxNPduConfirmationPduId=0, CanTpTxNPduRef=msg_diag_Response_MyECU_Tp_oCAN00_0ed9d144_Tx
        CanTpRxNSdu_550eef02 (CanTpRxNSdu):
          CanTpRxAddressingFormat = CANTP_STANDARD
          CanTpRxDl = 8
          CanTpRxTaType = CANTP_PHYSICAL
          CanTpNbr = 0.1
          CanTpRxNSduId = 0
          CanTpRxPaddingActivation = CANTP_ON
          CanTpBs = 8
          CanTpNar = 0.1
          CanTpNcr = 0.5
          CanTpRxWftMax = 15
          CanTpSTmin = 0.02
          CanTpRxNSduRef = msg_diag_Request_MyECU_oCAN00_a823f7ba_Rx
          CanTpRxNPdu_07b2877d (CanTpRxNPdu): CanTpRxNPduId=0, CanTpRxNPduRef=msg_diag_Request_MyECU_Tp_oCAN00_ecbacca2_Rx
          CanTpTxFcNPdu_07b2877d (CanTpTxFcNPdu): CanTpTxFcNPduConfirmationPduId=0, CanTpTxFcNPduRef=msg_diag_Response_MyECU_Tp_oCAN00_0ed9d144_Tx
      TPCH_c1f2f0aa (CanTpChannel): CanTpChannelMode=CANTP_MODE_FULL_DUPLEX
        CanTpRxNSdu_aba1e8cc (CanTpRxNSdu):
          CanTpRxAddressingFormat = CANTP_STANDARD
          CanTpRxDl = 8
          CanTpRxTaType = CANTP_PHYSICAL
          CanTpNbr = 0.1
          CanTpRxNSduId = 1
          CanTpRxPaddingActivation = CANTP_ON
          CanTpBs = 8
          CanTpNar = 0.1
          CanTpNcr = 0.5
          CanTpRxWftMax = 15
          CanTpSTmin = 0.02
          CanTpRxNSduRef = msg_diag_RequestGlobal_oCAN00_38f4a687_Rx
          CanTpTxFcNPdu_a4c851d5 (CanTpTxFcNPdu): CanTpTxFcNPduConfirmationPduId=0, CanTpTxFcNPduRef=msg_diag_Response_MyECU_Tp_oCAN00_0ed9d144_Tx
          CanTpRxNPdu_a4c851d5 (CanTpRxNPdu): CanTpRxNPduId=1, CanTpRxNPduRef=msg_diag_RequestGlobal_Tp_oCAN00_7b1e9193_Rx
