AUTOSAR XML (schema 00048)
package /ActiveEcuC
  module config vBRS: implementation-config-variant=VARIANT-PRE-COMPILE, module-description=vBRS_Impl
    vBRSGeneral:
      vBRSEnableCoreSpecificVLinkGenConfig = true
      vBRSEnableSupportLEDs = true
      vBRSEnableSafeContextSupport = false
      vBRSEnableMultiCoreSupport = true
      vBRSEnableSupportToggleWdPin = false
      vBRSEnableSupportToggleCustomPin = false
      vBRSEnableEcuMStubGeneration = false
      vBRSDisableSetupSupport = false
      vBRSEnableSchmStubGeneration = false
      vBRSEnableSchmStubSupportDrvCanAN = true
      vBRSExecutionInstance = Application
      vBRSFirstInstance = true
      vBRSFblSupportEcuMInit = false
      vBRSFblSupportExceptionTableInRam = true
      vBRSToggleLEDDioChannel = DioChannel_led1
    vBRSHwConfig:
      vBRSOscClock = 20000000
      vBRSPeriphClock = 100000000
      vBRSTimebaseClock = 100000000
      vBRSPeriphClockDescription = Initial value for Peripheral Clock: 100MHz GPT=100MHz/8 =12.5MHz
      vBRSEnablePortHandling = false
      vBRSEnableWatchdogHandling = true
      vBRSEnablePLLClocksHandling = false
      vBRSPreferPLLWatchdogInit = false
      3 x vBRSEvalBoardInfo:
        TRIBOARD_TC3x7: vBRSEvalBoard=TRIBOARD_TC3x7, vBRSEvalBoardDescription=Toggle Port Group 33 Port 4 for LED support, vBRSEvalBoardOscClock=20000000
        TRIBOARD_TC3x9: vBRSEvalBoard=TRIBOARD_TC3x9, vBRSEvalBoardDescription=Toggle Port Group 33 Port 4 for LED support, vBRSEvalBoardOscClock=20000000
        CUSTOMER_HARDWARE: vBRSEvalBoard=CUSTOMER_HARDWARE, vBRSEvalBoardDescription=This Eval board is used for customer hardware. All pin configuration have to be specify manually in the BrsHw_Ports.h.
    vBRSMemoryInit: vBRSInitPatternBlocks=0, vBRSInitPatternHardResetBlocks=0, vBRSInitPatternAreas=0, vBRSInitPatternHardResetAreas=0
