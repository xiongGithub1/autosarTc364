AUTOSAR XML (schema 00048)
package /ActiveEcuC
  module config BswM: implementation-config-variant=VARIANT-PRE-COMPILE, module-description=BswM_Impl
    BswMGeneral:
      BswMCanSMEnabled = true
      BswMComMEnabled = true
      BswMDcmEnabled = true
      BswMDevErrorDetect = true
      BswMEcuMEnabled = true
      BswMEthIfEnabled = false
      BswMEthSMEnabled = false
      BswMFrSMEnabled = false
      BswMGenericRequestEnabled = false
      BswMJ1939DcmEnabled = false
      BswMJ1939NmEnabled = false
      BswMLinSMEnabled = false
      BswMLinTPEnabled = false
      BswMNmEnabled = false
      BswMNvMEnabled = true
      BswMPduREnabled = false
      BswMRuleControlEnabled = false
      BswMSdEnabled = false
      BswMVersionInfoApi = false
      BswMWdgMEnabled = true
      BswMModeCheck = true
      BswMActionListQueueSearchAlgorithm = LINEAR_SEARCH
      BswMSafeBswChecks = false
      BswMMainFunctionPeriod = 0.01
      BswMCommonData
      BswMGeneration:
        BswMOutOfBoundsWriteSanitizer = false
        BswMOutOfBoundsReadSanitizer = false
        BswMReduceConstantData2Define = true
        BswMBoolDataInArrayOfStructStrategy = BITMASKING
        BswMInterfacesForDeactivatedData = false
    BswMConfig
      BswMArbitration
        CC_CN_CAN00_5e566ad9_RX (BswMRule):
          BswMNestedExecutionOnly = false
          BswMRuleId = 0
          BswMRuleInitState = BSWM_FALSE
          BswMRuleExpressionRef = CC_LE_CN_CAN00_5e566ad9_RX
          BswMRuleFalseActionList = CC_AL_CN_CAN00_5e566ad9_RX_Disable
          BswMRuleTrueActionList = CC_AL_CN_CAN00_5e566ad9_RX_EnableNoinit
        CC_LE_CN_CAN00_5e566ad9_RX (BswMLogicalExpression): BswMLogicalOperator=BSWM_AND, BswMArgumentRef=CC_Cond_CanSMIndication_CN_CAN00_5e566ad9_NEQ_CANSM_BSWM_NO_COMMUNICATION
        CC_Cond_CanSMIndication_CN_CAN00_5e566ad9_NEQ_CANSM_BSWM_NO_COMMUNICATION (BswMModeCondition): BswMConditionType=BSWM_EQUALS_NOT, BswMConditionMode=CC_CanSMIndication_CN_CAN00_5e566ad9
          BswMConditionValue
            BswMBswMode: BswMBswRequestedMode=CANSM_BSWM_NO_COMMUNICATION
        CC_CanSMIndication_CN_CAN00_5e566ad9 (BswMModeRequestPort): BswMArbitrateOnInit=false, BswMRequestProcessing=BSWM_IMMEDIATE
          BswMModeRequestSource
            BswMCanSMIndication: BswMCanSMChannelRef=CN_CAN00_5e566ad9
          BswMModeInitValue
            BswMBswModeInitValue: BswMBswModeInitValueMode=CANSM_BSWM_NO_COMMUNICATION
        CC_CN_CAN00_5e566ad9_TX (BswMRule):
          BswMNestedExecutionOnly = false
          BswMRuleId = 2
          BswMRuleInitState = BSWM_FALSE
          BswMRuleExpressionRef = CC_LE_CN_CAN00_5e566ad9_TX
          BswMRuleFalseActionList = CC_AL_CN_CAN00_5e566ad9_TX_Disable
          BswMRuleTrueActionList = CC_AL_CN_CAN00_5e566ad9_TX_EnableNoinit
        CC_LE_CN_CAN00_5e566ad9_TX (BswMLogicalExpression): BswMLogicalOperator=BSWM_AND, BswMArgumentRef=CC_Cond_CanSMIndication_CN_CAN00_5e566ad9_EQ_CANSM_BSWM_FULL_COMMUNICATION
        CC_Cond_CanSMIndication_CN_CAN00_5e566ad9_EQ_CANSM_BSWM_FULL_COMMUNICATION (BswMModeCondition): BswMConditionType=BSWM_EQUALS, BswMConditionMode=CC_CanSMIndication_CN_CAN00_5e566ad9
          BswMConditionValue
            BswMBswMode: BswMBswRequestedMode=CANSM_BSWM_FULL_COMMUNICATION
        CC_CN_CAN00_5e566ad9_RX_DM (BswMRule):
          BswMNestedExecutionOnly = false
          BswMRuleId = 1
          BswMRuleInitState = BSWM_FALSE
          BswMRuleExpressionRef = CC_LE_CN_CAN00_5e566ad9_RX_DM
          BswMRuleFalseActionList = CC_AL_CN_CAN00_5e566ad9_Disable_DM
          BswMRuleTrueActionList = CC_AL_CN_CAN00_5e566ad9_Enable_DM
        CC_LE_CN_CAN00_5e566ad9_RX_DM (BswMLogicalExpression): BswMLogicalOperator=BSWM_AND, BswMArgumentRef=CC_Cond_CanSMIndication_CN_CAN00_5e566ad9_EQ_CANSM_BSWM_FULL_COMMUNICATION
      BswMModeControl: BswMInitActionListRef=INIT_AL_Initialize
        INIT_AL_Initialize (BswMActionList): BswMActionListExecution=BSWM_CONDITION
          25 x BswMActionListItem, all with BswMAbortOnFail=false:
            INIT_Action_Det_Init: BswMActionListItemIndex=0, BswMActionListItemRef=BswMModeControl/INIT_Action_Det_Init
            INIT_Action_EnableInterrupts: BswMActionListItemIndex=19, BswMActionListItemRef=BswMModeControl/INIT_Action_EnableInterrupts
            INIT_Action_ComM_PreInit: BswMActionListItemIndex=1, BswMActionListItemRef=BswMModeControl/INIT_Action_ComM_PreInit
            INIT_Action_E2EXf_Init: BswMActionListItemIndex=3, BswMActionListItemRef=BswMModeControl/INIT_Action_E2EXf_Init
            INIT_Action_Can_Init: BswMActionListItemIndex=8, BswMActionListItemRef=BswMModeControl/INIT_Action_Can_Init
            INIT_Action_CanIf_Init: BswMActionListItemIndex=9, BswMActionListItemRef=BswMModeControl/INIT_Action_CanIf_Init
            INIT_Action_Com_Init: BswMActionListItemIndex=11, BswMActionListItemRef=BswMModeControl/INIT_Action_Com_Init
            INIT_Action_PduR_Init: BswMActionListItemIndex=12, BswMActionListItemRef=BswMModeControl/INIT_Action_PduR_Init
            INIT_Action_CanSM_Init: BswMActionListItemIndex=13, BswMActionListItemRef=BswMModeControl/INIT_Action_CanSM_Init
            INIT_Action_ComM_Init: BswMActionListItemIndex=20, BswMActionListItemRef=BswMModeControl/INIT_Action_ComM_Init
            INIT_Action_ComM_PostInit: BswMActionListItemIndex=23, BswMActionListItemRef=BswMModeControl/INIT_Action_ComM_PostInit
            INIT_Action_NvM_Init: BswMActionListItemIndex=18, BswMActionListItemRef=BswMModeControl/INIT_Action_NvM_Init
            INIT_Action_CanTp_Init: BswMActionListItemIndex=16, BswMActionListItemRef=BswMModeControl/INIT_Action_CanTp_Init
            INIT_Action_Xcp_Init: BswMActionListItemIndex=17, BswMActionListItemRef=BswMModeControl/INIT_Action_Xcp_Init
            INIT_Action_Dcm_Init: BswMActionListItemIndex=21, BswMActionListItemRef=BswMModeControl/INIT_Action_Dcm_Init
            INIT_Action_Dem_Init: BswMActionListItemIndex=22, BswMActionListItemRef=BswMModeControl/INIT_Action_Dem_Init
            INIT_Action_Uart_Init: BswMActionListItemIndex=6, BswMActionListItemRef=BswMModeControl/INIT_Action_Uart_Init
            INIT_Action_Sbc_30_Tlf35584_Init: BswMActionListItemIndex=7, BswMActionListItemRef=BswMModeControl/INIT_Action_Sbc_30_Tlf35584_Init
            INIT_Action_CanNm_Init: BswMActionListItemIndex=14, BswMActionListItemRef=BswMModeControl/INIT_Action_CanNm_Init
            INIT_Action_Nm_Init: BswMActionListItemIndex=15, BswMActionListItemRef=BswMModeControl/INIT_Action_Nm_Init
            INIT_Action_Nm_PreInit: BswMActionListItemIndex=4, BswMActionListItemRef=BswMModeControl/INIT_Action_Nm_PreInit
            INIT_Action_Nm_PostInit: BswMActionListItemIndex=24, BswMActionListItemRef=BswMModeControl/INIT_Action_Nm_PostInit
            INIT_Action_Wdg_17_Scu_Init: BswMActionListItemIndex=5, BswMActionListItemRef=BswMModeControl/INIT_Action_Wdg_17_Scu_Init
            INIT_Action_WdgM_Init: BswMActionListItemIndex=10, BswMActionListItemRef=BswMModeControl/INIT_Action_WdgM_Init
            INIT_Action_Dsadc_Init: BswMActionListItemIndex=2, BswMActionListItemRef=BswMModeControl/INIT_Action_Dsadc_Init
        INIT_Action_Det_Init (BswMAction)
          BswMAvailableActions
            BswMUserCallout: BswMUserCalloutFunction=Det_Init(Det_Config_Ptr), BswMCreateCallout=false, BswMUserIncludeFile=Det.h
        INIT_Action_EnableInterrupts (BswMAction)
          BswMAvailableActions
            BswMUserCallout: BswMUserCalloutFunction=BswM_AL_SetProgrammableInterrupts(), BswMCreateCallout=true
        CC_AL_CN_CAN00_5e566ad9_RX_Disable (BswMActionList): BswMActionListExecution=BSWM_TRIGGER
          CC_DisablePDUGroup_MyECU_oCAN00_Rx_4cbf71f7 (BswMActionListItem): BswMAbortOnFail=false, BswMActionListItemIndex=0, BswMActionListItemRef=BswMModeControl/CC_DisablePDUGroup_MyECU_oCAN00_Rx_4cbf71f7
        CC_DisablePDUGroup_MyECU_oCAN00_Rx_4cbf71f7 (BswMAction)
          BswMAvailableActions
            BswMPduGroupSwitch: BswMPduGroupSwitchReinit=false, BswMDisabledPduGroupRef=MyECU_oCAN00_Rx_4cbf71f7
        CC_AL_CN_CAN00_5e566ad9_RX_EnableNoinit (BswMActionList): BswMActionListExecution=BSWM_TRIGGER
          CC_EnablePDUGroup_MyECU_oCAN00_Rx_4cbf71f7 (BswMActionListItem): BswMAbortOnFail=false, BswMActionListItemIndex=0, BswMActionListItemRef=BswMModeControl/CC_EnablePDUGroup_MyECU_oCAN00_Rx_4cbf71f7
        CC_EnablePDUGroup_MyECU_oCAN00_Rx_4cbf71f7 (BswMAction)
          BswMAvailableActions
            BswMPduGroupSwitch: BswMPduGroupSwitchReinit=false, BswMEnabledPduGroupRef=MyECU_oCAN00_Rx_4cbf71f7
        CC_AL_CN_CAN00_5e566ad9_TX_Disable (BswMActionList): BswMActionListExecution=BSWM_TRIGGER
          CC_DisablePDUGroup_MyECU_oCAN00_Tx_1ae5d671 (BswMActionListItem): BswMAbortOnFail=false, BswMActionListItemIndex=0, BswMActionListItemRef=BswMModeControl/CC_DisablePDUGroup_MyECU_oCAN00_Tx_1ae5d671
        CC_DisablePDUGroup_MyECU_oCAN00_Tx_1ae5d671 (BswMAction)
          BswMAvailableActions
            BswMPduGroupSwitch: BswMPduGroupSwitchReinit=false, BswMDisabledPduGroupRef=MyECU_oCAN00_Tx_1ae5d671
        CC_AL_CN_CAN00_5e566ad9_TX_EnableNoinit (BswMActionList): BswMActionListExecution=BSWM_TRIGGER
          CC_EnablePDUGroup_MyECU_oCAN00_Tx_1ae5d671 (BswMActionListItem): BswMAbortOnFail=false, BswMActionListItemIndex=0, BswMActionListItemRef=BswMModeControl/CC_EnablePDUGroup_MyECU_oCAN00_Tx_1ae5d671
        CC_EnablePDUGroup_MyECU_oCAN00_Tx_1ae5d671 (BswMAction)
          BswMAvailableActions
            BswMPduGroupSwitch: BswMPduGroupSwitchReinit=false, BswMEnabledPduGroupRef=MyECU_oCAN00_Tx_1ae5d671
        CC_AL_CN_CAN00_5e566ad9_Disable_DM (BswMActionList): BswMActionListExecution=BSWM_TRIGGER
          CC_DisableDM_MyECU_oCAN00_Rx_4cbf71f7 (BswMActionListItem): BswMAbortOnFail=false, BswMActionListItemIndex=0, BswMActionListItemRef=BswMModeControl/CC_DisableDM_MyECU_oCAN00_Rx_4cbf71f7
        CC_DisableDM_MyECU_oCAN00_Rx_4cbf71f7 (BswMAction)
          BswMAvailableActions
            BswMDeadlineMonitoringControl: BswMDisabledDMPduGroupRef=MyECU_oCAN00_Rx_4cbf71f7
        CC_AL_CN_CAN00_5e566ad9_Enable_DM (BswMActionList): BswMActionListExecution=BSWM_TRIGGER
          CC_EnableDM_MyECU_oCAN00_Rx_4cbf71f7 (BswMActionListItem): BswMAbortOnFail=false, BswMActionListItemIndex=0, BswMActionListItemRef=BswMModeControl/CC_EnableDM_MyECU_oCAN00_Rx_4cbf71f7
        24 x BswMAction:
          CC_EnableDM_MyECU_oCAN00_Rx_4cbf71f7
            BswMAvailableActions
              BswMDeadlineMonitoringControl: BswMEnabledDMPduGroupRef=MyECU_oCAN00_Rx_4cbf71f7
          INIT_Action_ComM_PreInit
            BswMAvailableActions
              BswMUserCallout: BswMUserCalloutFunction=ComM_PreInit(ComM_Config_Ptr), BswMCreateCallout=false, BswMUserIncludeFile=ComM.h
          INIT_Action_E2EXf_Init
            BswMAvailableActions
              BswMUserCallout: BswMUserCalloutFunction=E2EXf_Init(NULL_PTR), BswMCreateCallout=false, BswMUserIncludeFile=E2EXf.h
          INIT_Action_Can_Init
            BswMAvailableActions
              BswMUserCallout: BswMUserCalloutFunction=Can_Init(Can_Config_Ptr), BswMCreateCallout=false, BswMUserIncludeFile=Can.h
          INIT_Action_CanIf_Init
            BswMAvailableActions
              BswMUserCallout: BswMUserCalloutFunction=CanIf_Init(CanIf_Config_Ptr), BswMCreateCallout=false, BswMUserIncludeFile=CanIf.h
          INIT_Action_Com_Init
            BswMAvailableActions
              BswMUserCallout: BswMUserCalloutFunction=Com_Init(Com_Config_Ptr), BswMCreateCallout=false, BswMUserIncludeFile=Com.h
          INIT_Action_PduR_Init
            BswMAvailableActions
              BswMUserCallout: BswMUserCalloutFunction=PduR_Init(PduR_Config_Ptr), BswMCreateCallout=false, BswMUserIncludeFile=PduR.h
          INIT_Action_CanSM_Init
            BswMAvailableActions
              BswMUserCallout: BswMUserCalloutFunction=CanSM_Init(CanSM_Config_Ptr), BswMCreateCallout=false, BswMUserIncludeFile=CanSM_EcuM.h
          INIT_Action_ComM_Init
            BswMAvailableActions
              BswMUserCallout: BswMUserCalloutFunction=ComM_Init(ComM_Config_Ptr), BswMCreateCallout=false, BswMUserIncludeFile=ComM.h
          INIT_Action_ComM_PostInit
            BswMAvailableActions
              BswMUserCallout: BswMUserCalloutFunction=ComM_PostInit(), BswMCreateCallout=false, BswMUserIncludeFile=ComM.h
          INIT_Action_NvM_Init
            BswMAvailableActions
              BswMUserCallout: BswMUserCalloutFunction=NvM_Init(), BswMCreateCallout=false, BswMUserIncludeFile=NvM.h
          INIT_Action_CanTp_Init
            BswMAvailableActions
              BswMUserCallout: BswMUserCalloutFunction=CanTp_Init(CanTp_Config_Ptr), BswMCreateCallout=false, BswMUserIncludeFile=CanTp.h
          INIT_Action_Xcp_Init
            BswMAvailableActions
              BswMUserCallout: BswMUserCalloutFunction=Xcp_Init(), BswMCreateCallout=false, BswMUserIncludeFile=Xcp.h
          INIT_Action_Dcm_Init
            BswMAvailableActions
              BswMUserCallout: BswMUserCalloutFunction=Dcm_Init(NULL_PTR), BswMCreateCallout=false, BswMUserIncludeFile=Dcm.h
          INIT_Action_Dem_Init
            BswMAvailableActions
              BswMUserCallout: BswMUserCalloutFunction=Dem_Init(Dem_Config_Ptr), BswMCreateCallout=false, BswMUserIncludeFile=Dem.h
          INIT_Action_Uart_Init
            BswMAvailableActions
              BswMUserCallout: BswMUserCalloutFunction=Uart_Init(&Uart_Config), BswMCreateCallout=false, BswMUserIncludeFile=Uart.h
          INIT_Action_Sbc_30_Tlf35584_Init
            BswMAvailableActions
              BswMUserCallout: BswMUserCalloutFunction=Sbc_30_Tlf35584_Init(Sbc_30_Tlf35584_Config_Ptr), BswMCreateCallout=false, BswMUserIncludeFile=Sbc_30_Tlf35584.h
          INIT_Action_CanNm_Init
            BswMAvailableActions
              BswMUserCallout: BswMUserCalloutFunction=CanNm_Init(CanNm_Config_Ptr), BswMCreateCallout=false, BswMUserIncludeFile=CanNm.h
          INIT_Action_Nm_Init
            BswMAvailableActions
              BswMUserCallout: BswMUserCalloutFunction=Nm_Init(Nm_Config_Ptr), BswMCreateCallout=false, BswMUserIncludeFile=Nm.h
          INIT_Action_Nm_PreInit
            BswMAvailableActions
              BswMUserCallout: BswMUserCalloutFunction=Nm_PreInit(Nm_Config_Ptr), BswMCreateCallout=false, BswMUserIncludeFile=Nm.h
          INIT_Action_Nm_PostInit
            BswMAvailableActions
              BswMUserCallout: BswMUserCalloutFunction=Nm_PostInit(), BswMCreateCallout=false, BswMUserIncludeFile=Nm.h
          INIT_Action_Wdg_17_Scu_Init
            BswMAvailableActions
              BswMUserCallout: BswMUserCalloutFunction=Wdg_17_Scu_Init(&Wdg_17_Scu_Config_0), BswMCreateCallout=false, BswMUserIncludeFile=Wdg_17_Scu.h
          INIT_Action_WdgM_Init
            BswMAvailableActions
              BswMUserCallout: BswMUserCalloutFunction=WdgM_Init(&WdgMConfig_Mode0_core0), BswMCreateCallout=false, BswMUserIncludeFile=WdgM.h
          INIT_Action_Dsadc_Init
            BswMAvailableActions
              BswMUserCallout: BswMUserCalloutFunction=Dsadc_Init(&Dsadc_Config), BswMCreateCallout=false, BswMUserIncludeFile=Dsadc.h
