AUTOSAR XML (schema 00048)
package /ActiveEcuC
  module config WdgM: implementation-config-variant=VARIANT-PRE-COMPILE, module-description=WdgM_Impl
    WdgMConfigSet: WdgMInitialMode=WdgMMode
      WdgMMode:
        WdgMExpiredSupervisionCycleTol = 0
        WdgMModeId = 0
        WdgMSupervisionCycle = 0.01
        WdgMInitialTriggerModeId = 0
        WdgMModeCoreAssignment = 0
        WdgMTicksPerSecond = 100
        WdgMReportStatusViaRte = true
        WdgMGlobalMemoryAppTaskRef = SystemApplication_OsCore0
        WdgMTrigger: WdgMWatchdogMode=WDGIF_SLOW_MODE, WdgMTriggerConditionValue=10, WdgMTriggerModeId=0, WdgMTriggerWatchdogRef=WdgMWatchdog
        WdgMLocalStatusParams:
          WdgMFailedAliveSupervisionRefCycleTol = 0
          WdgMSupervisedEntityInitialMode = WDGM_LOCAL_STATUS_OK
          WdgMFailedDeadlineRefCycleTol = 0
          WdgMDeadlineReferenceCycle = 0
          WdgMFailedProgramFlowRefCycleTol = 0
          WdgMProgramFlowReferenceCycle = 0
          WdgMLocalStatusSupervisedEntityRef = WdgMSupervisedEntity
    WdgMGeneral:
      WdgMDevErrorDetect = true
      WdgMDemReport = false
      WdgMImmediateReset = true
      WdgMOffModeEnabled = false
      WdgMVersionInfoApi = false
      WdgMDefensiveBehavior = false
      WdgMUseRte = true
      WdgMDemSupervisionReport = false
      WdgMFirstCycleAliveCounterReset = false
      WdgMAutosarDebugging = false
      WdgMUseOsSuspendInterrupt = true
      WdgMTimebaseSource = WDGM_INTERNAL_SOFTWARE_TICK
      WdgMSecondResetPath = true
      WdgMTickOverrunCorrection = false
      WdgMEntityDeactivationEnabled = false
      WdgMGenerateCPIdAsPortDefinedArgument = false
      WdgMStatusReportingMechanism = WDGM_USE_MODE_SWITCH_PORTS
      WdgMCallerIds: WdgMCallerId=0
      WdgMSupervisedEntity:
        WdgMSupervisedEntityId = 0
        WdgMEnableEntityDeactivation = false
        WdgMReportStatusViaRte = true
        WdgMInternalCheckpointInitialRef = WdgMCheckpoint
        WdgMAppTaskRef = SystemApplication_OsCore0
        WdgMCheckpoint: WdgMCheckpointId=0
      WdgMWatchdog: WdgMWatchdogName=, WdgMWatchdogDeviceRef=WdgIfDevice
