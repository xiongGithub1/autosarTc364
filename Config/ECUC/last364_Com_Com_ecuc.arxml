AUTOSAR XML (schema 00048)
package /ActiveEcuC
  module config Com: implementation-config-variant=VARIANT-PRE-COMPILE, module-description=Com_Impl
    ComConfig: ComConfigurationId=0, ComRxDeferredNotificationCacheSize=0, ComRxImmediateNotificationCacheSize=0
      msg_Receive_oCAN00_2b456e3f_Rx (ComIPdu):
        ComIPduDirection = RECEIVE
        ComIPduType = NORMAL
        ComIPduHandleId = 0
        ComIPduSignalProcessing = DEFERRED
        ComIPduCancellationSupport = false
        ComIPduGroupRef = MyECU_oCAN00_Rx_4cbf71f7
        ComIPduSignalRef = sig_State_RearInteriorLight_omsg_Receive_oCAN00_63323183_Rx
        ComIPduSignalRef = sig_State_RearLeftDoor_omsg_Receive_oCAN00_84ad4140_Rx
        ComIPduSignalRef = sig_State_RearRightDoor_omsg_Receive_oCAN00_a8945098_Rx
        ComPduIdRef = msg_Receive_oCAN00_2b456e3f_Rx
        ComIPduMainFunctionRef = ComMainFunctionRx
      msg_Transmit_oCAN00_0723e95e_Tx (ComIPdu):
        ComIPduDirection = SEND
        ComIPduType = NORMAL
        ComIPduHandleId = 1
        ComIPduSignalProcessing = DEFERRED
        ComIPduCancellationSupport = false
        ComIPduGroupRef = MyECU_oCAN00_Tx_1ae5d671
        ComIPduSignalRef = sig_RearInteriorLight_omsg_Transmit_oCAN00_49a633c1_Tx
        ComPduIdRef = msg_Transmit_oCAN00_0723e95e_Tx
        ComIPduMainFunctionRef = ComMainFunctionTx
        ComTxIPdu: ComMinimumDelayTime=0, ComTxIPduUnusedAreasDefault=0
          ComTxModeFalse
            ComTxMode: ComTxModeMode=PERIODIC, ComTxModeTimeOffset=0, ComTxModeTimePeriod=0.1
          ComTxModeTrue
            ComTxMode: ComTxModeMode=PERIODIC, ComTxModeTimeOffset=0, ComTxModeTimePeriod=0.1
      MyECU_oCAN00_Rx_4cbf71f7 (ComIPduGroup): ComIPduGroupHandleId=0
      MyECU_oCAN00_Tx_1ae5d671 (ComIPduGroup): ComIPduGroupHandleId=1
      4 x ComSignal, all with ComBitSize=1, ComSignalEndianness=LITTLE_ENDIAN, ComSignalInitValue=0, ComSignalType=BOOLEAN:
        sig_RearInteriorLight_omsg_Transmit_oCAN00_49a633c1_Tx: ComBitPosition=0, ComTransferProperty=PENDING, ComSignalAccess=ACCESS_NEEDED_BY_OTHER, ComHandleId=11, ComSystemTemplateSystemSignalRef=sig_RearInteriorLight
        sig_State_RearInteriorLight_omsg_Receive_oCAN00_63323183_Rx: ComBitPosition=2, ComTimeout=0, ComSignalAccess=ACCESS_NOT_NEEDED, ComSystemTemplateSystemSignalRef=sig_State_RearInteriorLight
        sig_State_RearLeftDoor_omsg_Receive_oCAN00_84ad4140_Rx: ComBitPosition=0, ComTimeout=0, ComSignalAccess=ACCESS_UNCLEAR, ComHandleId=0, ComSystemTemplateSystemSignalRef=sig_State_RearLeftDoor
        sig_State_RearRightDoor_omsg_Receive_oCAN00_a8945098_Rx: ComBitPosition=1, ComTimeout=0, ComSignalAccess=ACCESS_NEEDED_BY_OTHER, ComHandleId=1, ComSystemTemplateSystemSignalRef=sig_State_RearRightDoor
      ComMainFunctionTx: ComMainTxTimeBase=0.005
      ComMainFunctionRx: ComMainRxTimeBase=0.01
      ElectricAngle_omsg_MotorStatus_oCAN00_59d7c624_Tx (ComSignal):
        ComBitPosition = 64
        ComBitSize = 16
        ComSignalEndianness = LITTLE_ENDIAN
        ComSignalInitValue = 0
        ComSignalType = SINT16
        ComTransferProperty = PENDING
        ComSignalAccess = ACCESS_UNCLEAR
        ComHandleId = 0
        ComSystemTemplateSystemSignalRef = ElectricAngle
      msg_MotorStatus_oCAN00_71118836_Tx (ComIPdu):
        ComIPduDirection = SEND
        ComIPduType = NORMAL
        ComIPduHandleId = 0
        ComIPduSignalProcessing = DEFERRED
        ComIPduCancellationSupport = false
        ComIPduGroupRef = MyECU_oCAN00_Tx_1ae5d671
        ComIPduSignalRef = ElectricAngle_omsg_MotorStatus_oCAN00_59d7c624_Tx
        ComIPduSignalRef = Id_Ref_omsg_MotorStatus_oCAN00_d6855f80_Tx
        ComIPduSignalRef = Iq_Ref_omsg_MotorStatus_oCAN00_64246970_Tx
        ComIPduSignalRef = MotorMode_omsg_MotorStatus_oCAN00_b2c82a54_Tx
        ComIPduSignalRef = Vbus_omsg_MotorStatus_oCAN00_85810386_Tx
        ComIPduSignalRef = tle9180_Ov_Fault_omsg_MotorStatus_oCAN00_fd6f0927_Tx
        ComPduIdRef = msg_MotorStatus_oCAN00_71118836_Tx
        ComIPduMainFunctionRef = ComMainFunctionTx
        ComTxIPdu: ComMinimumDelayTime=0, ComTxIPduUnusedAreasDefault=0
          ComTxModeTrue
            ComTxMode: ComTxModeMode=PERIODIC, ComTxModeTimeOffset=0, ComTxModeTimePeriod=0.005
          ComTxModeFalse
            ComTxMode: ComTxModeMode=PERIODIC, ComTxModeTimeOffset=0, ComTxModeTimePeriod=0.005
      5 x ComSignal, all with ComSignalEndianness=LITTLE_ENDIAN, ComSignalInitValue=0, ComTransferProperty=PENDING, ComSignalAccess=ACCESS_UNCLEAR:
        Vbus_omsg_MotorStatus_oCAN00_85810386_Tx: ComBitPosition=48, ComBitSize=16, ComSignalType=SINT16, ComHandleId=4, ComSystemTemplateSystemSignalRef=Vbus
        MotorMode_omsg_MotorStatus_oCAN00_b2c82a54_Tx: ComBitPosition=0, ComBitSize=8, ComSignalType=UINT8, ComHandleId=3, ComSystemTemplateSystemSignalRef=MotorMode
        Iq_Ref_omsg_MotorStatus_oCAN00_64246970_Tx: ComBitPosition=32, ComBitSize=16, ComSignalType=SINT16, ComHandleId=2, ComSystemTemplateSystemSignalRef=Iq_Ref
        Id_Ref_omsg_MotorStatus_oCAN00_d6855f80_Tx: ComBitPosition=16, ComBitSize=16, ComSignalType=SINT16, ComHandleId=1, ComSystemTemplateSystemSignalRef=Id_Ref
        tle9180_Ov_Fault_omsg_MotorStatus_oCAN00_fd6f0927_Tx: ComBitPosition=8, ComBitSize=1, ComSignalType=BOOLEAN, ComHandleId=12, ComSystemTemplateSystemSignalRef=tle9180_Ov_Fault
      msg_nm_MyECU_oCAN00_92bb24c1_Tx (ComIPdu):
        ComIPduDirection = SEND
        ComIPduType = NORMAL
        ComIPduHandleId = 2
        ComIPduSignalProcessing = DEFERRED
        ComIPduCancellationSupport = false
        ComIPduSignalRef = sig_NM_MyECU_UserData_0_omsg_nm_MyECU_oCAN00_acc1931e_Tx
        ComIPduSignalRef = sig_NM_MyECU_UserData_1_omsg_nm_MyECU_oCAN00_bbe9f7de_Tx
        ComIPduSignalRef = sig_NM_MyECU_UserData_2_omsg_nm_MyECU_oCAN00_82915a9e_Tx
        ComIPduSignalRef = sig_NM_MyECU_UserData_3_omsg_nm_MyECU_oCAN00_95b93e5e_Tx
        ComIPduSignalRef = sig_NM_MyECU_UserData_4_omsg_nm_MyECU_oCAN00_f060001e_Tx
        ComIPduSignalRef = sig_NM_MyECU_UserData_5_omsg_nm_MyECU_oCAN00_e74864de_Tx
        ComPduIdRef = msg_nm_MyECU_oCAN00_92bb24c1_Tx
        ComIPduMainFunctionRef = ComMainFunctionTx
        ComTxIPdu: ComTxIPduUnusedAreasDefault=0, ComMinimumDelayTime=0  # msg_nm_MyECU_oCAN00
          ComTxModeTrue
            ComTxMode: ComTxModeMode=NONE
          ComTxModeFalse
            ComTxMode: ComTxModeMode=NONE
      6 x ComSignal, all with ComBitSize=8, ComSignalEndianness=LITTLE_ENDIAN, ComSignalInitValue=0, ComSignalType=UINT8, ComTransferProperty=PENDING, ComSignalAccess=ACCESS_UNCLEAR:
        sig_NM_MyECU_UserData_1_omsg_nm_MyECU_oCAN00_bbe9f7de_Tx: ComBitPosition=16, ComHandleId=6, ComSystemTemplateSystemSignalRef=sig_NM_MyECU_UserData_1
        sig_NM_MyECU_UserData_3_omsg_nm_MyECU_oCAN00_95b93e5e_Tx: ComBitPosition=32, ComHandleId=8, ComSystemTemplateSystemSignalRef=sig_NM_MyECU_UserData_3
        sig_NM_MyECU_UserData_2_omsg_nm_MyECU_oCAN00_82915a9e_Tx: ComBitPosition=24, ComHandleId=7, ComSystemTemplateSystemSignalRef=sig_NM_MyECU_UserData_2
        sig_NM_MyECU_UserData_5_omsg_nm_MyECU_oCAN00_e74864de_Tx: ComBitPosition=48, ComHandleId=10, ComSystemTemplateSystemSignalRef=sig_NM_MyECU_UserData_5
        sig_NM_MyECU_UserData_0_omsg_nm_MyECU_oCAN00_acc1931e_Tx: ComBitPosition=8, ComHandleId=5, ComSystemTemplateSystemSignalRef=sig_NM_MyECU_UserData_0
        sig_NM_MyECU_UserData_4_omsg_nm_MyECU_oCAN00_f060001e_Tx: ComBitPosition=40, ComHandleId=9, ComSystemTemplateSystemSignalRef=sig_NM_MyECU_UserData_4
    ComGeneral:
      ComConfigurationUseDet = true
      ComSafeBswChecks = false
      ComEnableSignalGroupArrayApi = false
      ComRetryFailedTransmitRequests = true
      ComSupportedIPduGroups = 2
      ComVersionInfoApi = false
      ComMetaDataSupport = false
      ComDeferredEventCacheSupport = false
      ComDescriptionGateway = false
      ComStrictRepetitionPeriod = false
      ComMixedModePeriodicSuppression = false
      ComSignalGateway = NONE
      ComMultiPartition = false
    ComGeneration:
      ComOutOfBoundsWriteProtectionStrategy = NONE
      ComOutOfBoundsWriteSanitizer = false
      ComOutOfBoundsReadSanitizer = false
      ComReduceConstantData2Define = false
      ComBoolDataInArrayOfStructStrategy = BOOLEAN
      ComDeduplicateIndirectedData = true
      ComDataDeduplicationStrategy = WITH_CAST
      ComReduceBoolDataByNegationThreshold = 2
      ComReduceBoolDataByNumericalComparisonThreshold = 2
      ComReduceBoolDataByNumericalRelationThreshold = 2
      ComReduceBoolDataByNumericalOperandStrategy = WITH_ANY_VALUE
      ComReduceNumericalDataByOffsetThreshold = 2
      ComReduceNumericalDataByArraySubtractionThreshold = 2
      ComReduceDataByStreaming = false
      ComShortSymbols = false
      ComInterfacesForDeactivatedData = false
      ComReferringKeysInComments = false
      ComNumberOfElementsCommentThreshold = 1000
    ComOptimization:
      ComTxProcessingISRLockThreshold = 1
      ComRxProcessingISRLockThreshold = 1
      ComGatewayProcessingISRLockThreshold = 1
      ComGatewayDescriptionProcessingISRLockThreshold = 1
      ComIPduGroupISRLockThreshold = 1
