AUTOSAR XML (schema 00048)
package /ActiveEcuC
  module config Com: implementation-config-variant=VARIANT-PRE-COMPILE, module-description=Com_Impl
    ComConfig: ComConfigurationId=0, ComRxDeferredNotificationCacheSize=0, ComRxImmediateNotificationCacheSize=0
      msg_Receive_oCAN00_2b456e3f_Rx (ComIPdu):
        ComIPduDirection = RECEIVE
        ComIPduType = NORMAL
        ComIPduHandleId = 0
        ComIPduSignalProcessing = DEFERRED
        ComIPduCancellationSupport = false
        ComIPduGroupRef = MyECU_oCAN00_Rx_4cbf71f7
        ComIPduSignalRef = sig_State_RearInteriorLight_omsg_Receive_oCAN00_63323183_Rx
        ComIPduSignalRef = sig_State_RearLeftDoor_omsg_Receive_oCAN00_84ad4140_Rx
        ComIPduSignalRef = sig_State_RearRightDoor_omsg_Receive_oCAN00_a8945098_Rx
        ComPduIdRef = msg_Receive_oCAN00_2b456e3f_Rx
        ComIPduMainFunctionRef = ComMainFunctionRx
      msg_Transmit_oCAN00_0723e95e_Tx (ComIPdu):
        ComIPduDirection = SEND
        ComIPduType = NORMAL
        ComIPduHandleId = 4
        ComIPduSignalProcessing = DEFERRED
        ComIPduCancellationSupport = false
        ComIPduGroupRef = MyECU_oCAN00_Tx_1ae5d671
        ComIPduSignalRef = sig_RearInteriorLight_omsg_Transmit_oCAN00_49a633c1_Tx
        ComPduIdRef = msg_Transmit_oCAN00_0723e95e_Tx
        ComIPduMainFunctionRef = ComMainFunctionTx
        ComTxIPdu: ComMinimumDelayTime=0, ComTxIPduUnusedAreasDefault=0
          ComTxModeFalse
            ComTxMode: ComTxModeMode=PERIODIC, ComTxModeTimeOffset=0, ComTxModeTimePeriod=0.1
          ComTxModeTrue
            ComTxMode: ComTxModeMode=PERIODIC, ComTxModeTimeOffset=0, ComTxModeTimePeriod=0.1
      MyECU_oCAN00_Rx_4cbf71f7 (ComIPduGroup): ComIPduGroupHandleId=0
      MyECU_oCAN00_Tx_1ae5d671 (ComIPduGroup): ComIPduGroupHandleId=1
      4 x ComSignal, all with ComBitSize=1, ComSignalEndianness=LITTLE_ENDIAN, ComSignalInitValue=0, ComSignalType=BOOLEAN:
        sig_RearInteriorLight_omsg_Transmit_oCAN00_49a633c1_Tx: ComBitPosition=0, ComTransferProperty=PENDING, ComSignalAccess=ACCESS_NEEDED_BY_OTHER, ComHandleId=54, ComSystemTemplateSystemSignalRef=sig_RearInteriorLight
        sig_State_RearInteriorLight_omsg_Receive_oCAN00_63323183_Rx: ComBitPosition=2, ComTimeout=0, ComSignalAccess=ACCESS_NOT_NEEDED, ComSystemTemplateSystemSignalRef=sig_State_RearInteriorLight
        sig_State_RearLeftDoor_omsg_Receive_oCAN00_84ad4140_Rx: ComBitPosition=0, ComTimeout=0, ComSignalAccess=ACCESS_UNCLEAR, ComHandleId=0, ComSystemTemplateSystemSignalRef=sig_State_RearLeftDoor
        sig_State_RearRightDoor_omsg_Receive_oCAN00_a8945098_Rx: ComBitPosition=1, ComTimeout=0, ComSignalAccess=ACCESS_NEEDED_BY_OTHER, ComHandleId=1, ComSystemTemplateSystemSignalRef=sig_State_RearRightDoor
      ComMainFunctionTx: ComMainTxTimeBase=0.005
      ComMainFunctionRx: ComMainRxTimeBase=0.01
      MotorFoc_FaultIv_A_MxA1_omsg_MyECU_Lamp_oCAN00_8a89b17f_Tx (ComSignal):
        ComBitPosition = 208
        ComBitSize = 16
        ComSignalEndianness = LITTLE_ENDIAN
        ComSignalInitValue = 0
        ComSignalType = SINT16
        ComTransferProperty = PENDING
        ComSignalAccess = ACCESS_UNCLEAR
        ComHandleId = 13
        ComSystemTemplateSystemSignalRef = MotorFoc_FaultIv_A
      MotorFoc_IuRaw_A_MxA2_omsg_MyECU_Lamp_oCAN00_ca30e9cf_Tx (ComSignal):
        ComBitPosition = 48
        ComBitSize = 16
        ComSignalEndianness = LITTLE_ENDIAN
        ComSignalInitValue = 0
        ComSignalType = SINT16
        ComTransferProperty = PENDING
        ComSignalAccess = ACCESS_UNCLEAR
        ComHandleId = 27
        ComSystemTemplateSystemSignalRef = MotorFoc_IuRaw_A
      msg_MyECU_Lamp_MxA2_oCAN00_f54a70d9_Tx (ComIPdu):
        ComIPduDirection = SEND
        ComIPduType = NORMAL
        ComIPduHandleId = 2
        ComIPduSignalProcessing = DEFERRED
        ComIPduCancellationSupport = false
        ComIPduGroupRef = MyECU_oCAN00_Tx_1ae5d671
        ComIPduSignalRef = MotorFoc_AdcFilterAlpha_MxA2_omsg_MyECU_Lamp_oCAN00_4c48c598_Tx
        ComIPduSignalRef = MotorFoc_AdcFilterEnabled_MxA2_omsg_MyECU_Lamp_oCAN00_bb1a16f8_Tx
        ComIPduSignalRef = MotorFoc_AdcFilterReady_MxA2_omsg_MyECU_Lamp_oCAN00_dd22f986_Tx
        ComIPduSignalRef = MotorFoc_AdcOffsetSampleCount_MxA2_omsg_MyECU_Lamp_oCAN00_98a9a073_Tx
        ComIPduSignalRef = MotorFoc_AdcOffsetVo1_MxA2_omsg_MyECU_Lamp_oCAN00_7e4e712f_Tx
        ComIPduSignalRef = MotorFoc_AdcOffsetVo2_MxA2_omsg_MyECU_Lamp_oCAN00_db461a43_Tx
        ComIPduSignalRef = MotorFoc_AdcOffsetVo3_MxA2_omsg_MyECU_Lamp_oCAN00_b841c367_Tx
        ComIPduSignalRef = MotorFoc_AdcSyncCounter_MxA2_omsg_MyECU_Lamp_oCAN00_8264daf6_Tx
        ComIPduSignalRef = MotorFoc_IuFiltered_A_MxA2_omsg_MyECU_Lamp_oCAN00_edadce4b_Tx
        ComIPduSignalRef = MotorFoc_IuRaw_A_MxA2_omsg_MyECU_Lamp_oCAN00_ca30e9cf_Tx
        ComIPduSignalRef = MotorFoc_IvFiltered_A_MxA2_omsg_MyECU_Lamp_oCAN00_3e36d2b0_Tx
        ComIPduSignalRef = MotorFoc_IvRaw_A_MxA2_omsg_MyECU_Lamp_oCAN00_a7b61a95_Tx
        ComIPduSignalRef = MotorFoc_IwFiltered_A_MxA2_omsg_MyECU_Lamp_oCAN00_70bfd919_Tx
        ComIPduSignalRef = MotorFoc_IwRaw_A_MxA2_omsg_MyECU_Lamp_oCAN00_83344ba3_Tx
        ComIPduSignalRef = MotorFoc_Page_MxA2_omsg_MyECU_Lamp_oCAN00_4390ace5_Tx
        ComIPduSignalRef = MotorFoc_Vinv_V_MxA2_omsg_MyECU_Lamp_oCAN00_bd00cc55_Tx
        ComIPduSignalRef = MotorFoc_Vro_V_MxA2_omsg_MyECU_Lamp_oCAN00_a894d119_Tx
        ComPduIdRef = msg_MyECU_Lamp_MxA2_oCAN00_f54a70d9_Tx
        ComIPduMainFunctionRef = ComMainFunctionTx
        ComTxIPdu: ComMinimumDelayTime=0, ComTxIPduUnusedAreasDefault=0
          ComTxModeTrue
            ComTxMode: ComTxModeMode=PERIODIC, ComTxModeTimeOffset=0.01, ComTxModeTimePeriod=0.015
          ComTxModeFalse
            ComTxMode: ComTxModeMode=NONE
      msg_MyECU_Lamp_MxA1_oCAN00_7bc5773a_Tx (ComIPdu):
        ComIPduDirection = SEND
        ComIPduType = NORMAL
        ComIPduHandleId = 1
        ComIPduSignalProcessing = DEFERRED
        ComIPduCancellationSupport = false
        ComIPduGroupRef = MyECU_oCAN00_Tx_1ae5d671
        ComIPduSignalRef = MotorFoc_FaultIu_A_MxA1_omsg_MyECU_Lamp_oCAN00_99a1880c_Tx
        ComIPduSignalRef = MotorFoc_FaultIv_A_MxA1_omsg_MyECU_Lamp_oCAN00_8a89b17f_Tx
        ComIPduSignalRef = MotorFoc_FaultIw_A_MxA1_omsg_MyECU_Lamp_oCAN00_846e59ae_Tx
        ComIPduSignalRef = MotorFoc_FaultPwm_MxA1_omsg_MyECU_Lamp_oCAN00_e43e797b_Tx
        ComIPduSignalRef = MotorFoc_FaultReasonPwm_MxA1_omsg_MyECU_Lamp_oCAN00_32050898_Tx
        ComIPduSignalRef = MotorFoc_FaultVdc_V_MxA1_omsg_MyECU_Lamp_oCAN00_65447c06_Tx
        ComIPduSignalRef = MotorFoc_MotorModePwm_MxA1_omsg_MyECU_Lamp_oCAN00_d3afa653_Tx
        ComIPduSignalRef = MotorFoc_Page_MxA1_omsg_MyECU_Lamp_oCAN00_1b8e05cd_Tx
        ComIPduSignalRef = MotorFoc_PwmPeriod_MxA1_omsg_MyECU_Lamp_oCAN00_d26baca6_Tx
        ComIPduSignalRef = MotorFoc_PwmU_MxA1_omsg_MyECU_Lamp_oCAN00_c33fb364_Tx
        ComIPduSignalRef = MotorFoc_PwmV_MxA1_omsg_MyECU_Lamp_oCAN00_6637d808_Tx
        ComIPduSignalRef = MotorFoc_PwmW_MxA1_omsg_MyECU_Lamp_oCAN00_0530012c_Tx
        ComIPduSignalRef = MotorFoc_ValphaRef_V_MxA1_omsg_MyECU_Lamp_oCAN00_dafa2b94_Tx
        ComIPduSignalRef = MotorFoc_VbetaRef_V_MxA1_omsg_MyECU_Lamp_oCAN00_623c36a7_Tx
        ComIPduSignalRef = MotorFoc_VdRef_V_MxA1_omsg_MyECU_Lamp_oCAN00_f0517bd4_Tx
        ComIPduSignalRef = MotorFoc_VdcMax_V_MxA1_omsg_MyECU_Lamp_oCAN00_8d3d4389_Tx
        ComIPduSignalRef = MotorFoc_VqRef_V_MxA1_omsg_MyECU_Lamp_oCAN00_636c7799_Tx
        ComPduIdRef = msg_MyECU_Lamp_MxA1_oCAN00_7bc5773a_Tx
        ComIPduMainFunctionRef = ComMainFunctionTx
        ComTxIPdu: ComMinimumDelayTime=0, ComTxIPduUnusedAreasDefault=0
          ComTxModeTrue
            ComTxMode: ComTxModeMode=PERIODIC, ComTxModeTimeOffset=0.005, ComTxModeTimePeriod=0.015
          ComTxModeFalse
            ComTxMode: ComTxModeMode=NONE
      13 x ComSignal, all with ComSignalEndianness=LITTLE_ENDIAN, ComTransferProperty=PENDING, ComSignalAccess=ACCESS_UNCLEAR:
        MotorFoc_Iv_A_MxA0_omsg_MyECU_Lamp_oCAN00_7b390c47_Tx: ComBitPosition=128, ComBitSize=16, ComSignalInitValue=0, ComSignalType=SINT16, ComHandleId=31, ComSystemTemplateSystemSignalRef=MotorFoc_Iv_A
        MotorFoc_Page_MxA1_omsg_MyECU_Lamp_oCAN00_1b8e05cd_Tx: ComBitPosition=0, ComBitSize=8, ComSignalInitValue=161, ComSignalType=UINT8, ComHandleId=39, ComSystemTemplateSystemSignalRef=MotorFoc_Page
        MotorFoc_FaultIu_A_MxA1_omsg_MyECU_Lamp_oCAN00_99a1880c_Tx: ComBitPosition=192, ComBitSize=16, ComSignalInitValue=0, ComSignalType=SINT16, ComHandleId=12, ComSystemTemplateSystemSignalRef=MotorFoc_FaultIu_A
        MotorFoc_Page_MxA0_omsg_MyECU_Lamp_oCAN00_9aab60ea_Tx: ComBitPosition=0, ComBitSize=8, ComSignalInitValue=160, ComSignalType=UINT8, ComHandleId=38, ComSystemTemplateSystemSignalRef=MotorFoc_Page
        MotorFoc_AdcOffsetVo3_MxA2_omsg_MyECU_Lamp_oCAN00_b841c367_Tx: ComBitPosition=176, ComBitSize=16, ComSignalInitValue=0, ComSignalType=SINT16, ComHandleId=6, ComSystemTemplateSystemSignalRef=MotorFoc_AdcOffsetVo3
        MotorFoc_FaultIw_A_MxA1_omsg_MyECU_Lamp_oCAN00_846e59ae_Tx: ComBitPosition=224, ComBitSize=16, ComSignalInitValue=0, ComSignalType=SINT16, ComHandleId=14, ComSystemTemplateSystemSignalRef=MotorFoc_FaultIw_A
        MotorFoc_AdcFilterReady_MxA2_omsg_MyECU_Lamp_oCAN00_dd22f986_Tx: ComBitPosition=16, ComBitSize=8, ComSignalInitValue=0, ComSignalType=UINT8, ComHandleId=2, ComSystemTemplateSystemSignalRef=MotorFoc_AdcFilterReady
        MotorFoc_Fault_MxA0_omsg_MyECU_Lamp_oCAN00_3dd6add5_Tx: ComBitPosition=16, ComBitSize=8, ComSignalInitValue=0, ComSignalType=UINT8, ComHandleId=19, ComSystemTemplateSystemSignalRef=MotorFoc_Fault
        MotorFoc_CurrentOffsetSampleCount_MxA0_omsg_MyECU_Lamp_oCAN00_6c5c0a81_Tx: ComBitPosition=216, ComBitSize=8, ComSignalInitValue=0, ComSignalType=UINT8, ComHandleId=10, ComSystemTemplateSystemSignalRef=MotorFoc_CurrentOffsetSampleCount
        MotorFoc_PwmV_MxA1_omsg_MyECU_Lamp_oCAN00_6637d808_Tx: ComBitPosition=128, ComBitSize=16, ComSignalInitValue=0, ComSignalType=UINT16, ComHandleId=43, ComSystemTemplateSystemSignalRef=MotorFoc_PwmV
        MotorFoc_Vinv_V_MxA2_omsg_MyECU_Lamp_oCAN00_bd00cc55_Tx: ComBitPosition=208, ComBitSize=16, ComSignalInitValue=0, ComSignalType=SINT16, ComHandleId=51, ComSystemTemplateSystemSignalRef=MotorFoc_Vinv_V
        MotorFoc_VdcMax_V_MxA1_omsg_MyECU_Lamp_oCAN00_8d3d4389_Tx: ComBitPosition=176, ComBitSize=16, ComSignalInitValue=0, ComSignalType=SINT16, ComHandleId=49, ComSystemTemplateSystemSignalRef=MotorFoc_VdcMax_V
        MotorFoc_VbetaRef_V_MxA1_omsg_MyECU_Lamp_oCAN00_623c36a7_Tx: ComBitPosition=96, ComBitSize=16, ComSignalInitValue=0, ComSignalType=SINT16, ComHandleId=47, ComSystemTemplateSystemSignalRef=MotorFoc_VbetaRef_V
      msg_MyECU_Lamp_MxA0_oCAN00_b76f77a4_Tx (ComIPdu):
        ComIPduDirection = SEND
        ComIPduType = NORMAL
        ComIPduHandleId = 0
        ComIPduSignalProcessing = DEFERRED
        ComIPduCancellationSupport = false
        ComIPduGroupRef = MyECU_oCAN00_Tx_1ae5d671
        ComIPduSignalRef = MotorFoc_AngleRaw_MxA0_omsg_MyECU_Lamp_oCAN00_7aec7e78_Tx
        ComIPduSignalRef = MotorFoc_CurrentOffsetReady_MxA0_omsg_MyECU_Lamp_oCAN00_81ce1bc4_Tx
        ComIPduSignalRef = MotorFoc_CurrentOffsetSampleCount_MxA0_omsg_MyECU_Lamp_oCAN00_6c5c0a81_Tx
        ComIPduSignalRef = MotorFoc_ElectricalAngle_rad_MxA0_omsg_MyECU_Lamp_oCAN00_5447ad3f_Tx
        ComIPduSignalRef = MotorFoc_FaultReason_MxA0_omsg_MyECU_Lamp_oCAN00_0576dfc4_Tx
        ComIPduSignalRef = MotorFoc_Fault_MxA0_omsg_MyECU_Lamp_oCAN00_3dd6add5_Tx
        ComIPduSignalRef = MotorFoc_GateDriverOutputEnabled_MxA0_omsg_MyECU_Lamp_oCAN00_6012a7f7_Tx
        ComIPduSignalRef = MotorFoc_GateDriverState_MxA0_omsg_MyECU_Lamp_oCAN00_e2e4dde6_Tx
        ComIPduSignalRef = MotorFoc_IdRef_A_MxA0_omsg_MyECU_Lamp_oCAN00_832c12be_Tx
        ComIPduSignalRef = MotorFoc_Id_A_MxA0_omsg_MyECU_Lamp_oCAN00_888850f5_Tx
        ComIPduSignalRef = MotorFoc_IqRef_A_MxA0_omsg_MyECU_Lamp_oCAN00_10111ef3_Tx
        ComIPduSignalRef = MotorFoc_Iq_A_MxA0_omsg_MyECU_Lamp_oCAN00_538e9670_Tx
        ComIPduSignalRef = MotorFoc_Iu_A_MxA0_omsg_MyECU_Lamp_oCAN00_68113534_Tx
        ComIPduSignalRef = MotorFoc_Iv_A_MxA0_omsg_MyECU_Lamp_oCAN00_7b390c47_Tx
        ComIPduSignalRef = MotorFoc_Iw_A_MxA0_omsg_MyECU_Lamp_oCAN00_75dee496_Tx
        ComIPduSignalRef = MotorFoc_MechanicalSpeed_rpm_MxA0_omsg_MyECU_Lamp_oCAN00_04bd2026_Tx
        ComIPduSignalRef = MotorFoc_MotorMode_MxA0_omsg_MyECU_Lamp_oCAN00_aa7dbeca_Tx
        ComIPduSignalRef = MotorFoc_Page_MxA0_omsg_MyECU_Lamp_oCAN00_9aab60ea_Tx
        ComIPduSignalRef = MotorFoc_Vdc_V_MxA0_omsg_MyECU_Lamp_oCAN00_6919810c_Tx
        ComPduIdRef = msg_MyECU_Lamp_MxA0_oCAN00_b76f77a4_Tx
        ComIPduMainFunctionRef = ComMainFunctionTx
        ComTxIPdu: ComMinimumDelayTime=0, ComTxIPduUnusedAreasDefault=0
          ComTxModeTrue
            ComTxMode: ComTxModeMode=PERIODIC, ComTxModeTimeOffset=0, ComTxModeTimePeriod=0.015
          ComTxModeFalse
            ComTxMode: ComTxModeMode=NONE
      19 x ComSignal, all with ComSignalEndianness=LITTLE_ENDIAN, ComSignalInitValue=0, ComTransferProperty=PENDING, ComSignalAccess=ACCESS_UNCLEAR:
        MotorFoc_IqRef_A_MxA0_omsg_MyECU_Lamp_oCAN00_10111ef3_Tx: ComBitPosition=64, ComBitSize=16, ComSignalType=SINT16, ComHandleId=24, ComSystemTemplateSystemSignalRef=MotorFoc_IqRef_A
        MotorFoc_IwFiltered_A_MxA2_omsg_MyECU_Lamp_oCAN00_70bfd919_Tx: ComBitPosition=128, ComBitSize=16, ComSignalType=SINT16, ComHandleId=32, ComSystemTemplateSystemSignalRef=MotorFoc_IwFiltered_A
        MotorFoc_Vro_V_MxA2_omsg_MyECU_Lamp_oCAN00_a894d119_Tx: ComBitPosition=192, ComBitSize=16, ComSignalType=SINT16, ComHandleId=53, ComSystemTemplateSystemSignalRef=MotorFoc_Vro_V
        MotorFoc_FaultPwm_MxA1_omsg_MyECU_Lamp_oCAN00_e43e797b_Tx: ComBitPosition=16, ComBitSize=8, ComSignalType=UINT8, ComHandleId=15, ComSystemTemplateSystemSignalRef=MotorFoc_FaultPwm
        MotorFoc_MotorMode_MxA0_omsg_MyECU_Lamp_oCAN00_aa7dbeca_Tx: ComBitPosition=8, ComBitSize=8, ComSignalType=UINT8, ComHandleId=37, ComSystemTemplateSystemSignalRef=MotorFoc_MotorMode
        MotorFoc_AdcSyncCounter_MxA2_omsg_MyECU_Lamp_oCAN00_8264daf6_Tx: ComBitPosition=224, ComBitSize=16, ComSignalType=UINT16, ComHandleId=7, ComSystemTemplateSystemSignalRef=MotorFoc_AdcSyncCounter
        MotorFoc_Iq_A_MxA0_omsg_MyECU_Lamp_oCAN00_538e9670_Tx: ComBitPosition=96, ComBitSize=16, ComSignalType=SINT16, ComHandleId=25, ComSystemTemplateSystemSignalRef=MotorFoc_Iq_A
        MotorFoc_Iw_A_MxA0_omsg_MyECU_Lamp_oCAN00_75dee496_Tx: ComBitPosition=144, ComBitSize=16, ComSignalType=SINT16, ComHandleId=34, ComSystemTemplateSystemSignalRef=MotorFoc_Iw_A
        MotorFoc_Id_A_MxA0_omsg_MyECU_Lamp_oCAN00_888850f5_Tx: ComBitPosition=80, ComBitSize=16, ComSignalType=SINT16, ComHandleId=23, ComSystemTemplateSystemSignalRef=MotorFoc_Id_A
        MotorFoc_GateDriverOutputEnabled_MxA0_omsg_MyECU_Lamp_oCAN00_6012a7f7_Tx: ComBitPosition=248, ComBitSize=8, ComSignalType=UINT8, ComHandleId=20, ComSystemTemplateSystemSignalRef=MotorFoc_GateDriverOutputEnabled
        MotorFoc_ValphaRef_V_MxA1_omsg_MyECU_Lamp_oCAN00_dafa2b94_Tx: ComBitPosition=80, ComBitSize=16, ComSignalType=SINT16, ComHandleId=46, ComSystemTemplateSystemSignalRef=MotorFoc_ValphaRef_V
        MotorFoc_ElectricalAngle_rad_MxA0_omsg_MyECU_Lamp_oCAN00_5447ad3f_Tx: ComBitPosition=192, ComBitSize=16, ComSignalType=SINT16, ComHandleId=11, ComSystemTemplateSystemSignalRef=MotorFoc_ElectricalAngle_rad
        MotorFoc_GateDriverState_MxA0_omsg_MyECU_Lamp_oCAN00_e2e4dde6_Tx: ComBitPosition=240, ComBitSize=8, ComSignalType=UINT8, ComHandleId=21, ComSystemTemplateSystemSignalRef=MotorFoc_GateDriverState
        MotorFoc_AdcFilterEnabled_MxA2_omsg_MyECU_Lamp_oCAN00_bb1a16f8_Tx: ComBitPosition=8, ComBitSize=8, ComSignalType=UINT8, ComHandleId=1, ComSystemTemplateSystemSignalRef=MotorFoc_AdcFilterEnabled
        MotorFoc_IwRaw_A_MxA2_omsg_MyECU_Lamp_oCAN00_83344ba3_Tx: ComBitPosition=80, ComBitSize=16, ComSignalType=SINT16, ComHandleId=33, ComSystemTemplateSystemSignalRef=MotorFoc_IwRaw_A
        MotorFoc_FaultReason_MxA0_omsg_MyECU_Lamp_oCAN00_0576dfc4_Tx: ComBitPosition=24, ComBitSize=8, ComSignalType=UINT8, ComHandleId=17, ComSystemTemplateSystemSignalRef=MotorFoc_FaultReason
        MotorFoc_IvFiltered_A_MxA2_omsg_MyECU_Lamp_oCAN00_3e36d2b0_Tx: ComBitPosition=112, ComBitSize=16, ComSignalType=SINT16, ComHandleId=29, ComSystemTemplateSystemSignalRef=MotorFoc_IvFiltered_A
        MotorFoc_CurrentOffsetReady_MxA0_omsg_MyECU_Lamp_oCAN00_81ce1bc4_Tx: ComBitPosition=208, ComBitSize=8, ComSignalType=UINT8, ComHandleId=9, ComSystemTemplateSystemSignalRef=MotorFoc_CurrentOffsetReady
        MotorFoc_IdRef_A_MxA0_omsg_MyECU_Lamp_oCAN00_832c12be_Tx: ComBitPosition=48, ComBitSize=16, ComSignalType=SINT16, ComHandleId=22, ComSystemTemplateSystemSignalRef=MotorFoc_IdRef_A
      msg_MyECU_Lamp_Mx_oCAN00_e57ca999_Tx (ComIPdu):
        ComIPduDirection = SEND
        ComIPduType = NORMAL
        ComIPduHandleId = 3
        ComIPduSignalProcessing = DEFERRED
        ComIPduCancellationSupport = false
        ComIPduGroupRef = MyECU_oCAN00_Tx_1ae5d671
        ComIPduSignalRef = MotorFoc_Sequence_Mx_omsg_MyECU_Lamp_oCAN00_339a541d_Tx
        ComPduIdRef = msg_MyECU_Lamp_Mx_oCAN00_e57ca999_Tx
        ComIPduMainFunctionRef = ComMainFunctionTx
        ComTxIPdu: ComMinimumDelayTime=0, ComTxIPduUnusedAreasDefault=0
          ComTxModeTrue
            ComTxMode: ComTxModeMode=DIRECT, ComTxModeNumberOfRepetitions=0, ComTxModeRepetitionPeriod=0
          ComTxModeFalse
            ComTxMode: ComTxModeMode=NONE
      20 x ComSignal, all with ComSignalEndianness=LITTLE_ENDIAN, ComSignalAccess=ACCESS_UNCLEAR:
        MotorFoc_MechanicalSpeed_rpm_MxA0_omsg_MyECU_Lamp_oCAN00_04bd2026_Tx: ComBitPosition=224, ComBitSize=16, ComSignalInitValue=0, ComSignalType=SINT16, ComTransferProperty=PENDING, ComHandleId=35, ComSystemTemplateSystemSignalRef=MotorFoc_MechanicalSpeed_rpm
        MotorFoc_Vdc_V_MxA0_omsg_MyECU_Lamp_oCAN00_6919810c_Tx: ComBitPosition=160, ComBitSize=16, ComSignalInitValue=0, ComSignalType=SINT16, ComTransferProperty=PENDING, ComHandleId=50, ComSystemTemplateSystemSignalRef=MotorFoc_Vdc_V
        MotorFoc_PwmPeriod_MxA1_omsg_MyECU_Lamp_oCAN00_d26baca6_Tx: ComBitPosition=160, ComBitSize=16, ComSignalInitValue=0, ComSignalType=UINT16, ComTransferProperty=PENDING, ComHandleId=41, ComSystemTemplateSystemSignalRef=MotorFoc_PwmPeriod
        MotorFoc_FaultReasonPwm_MxA1_omsg_MyECU_Lamp_oCAN00_32050898_Tx: ComBitPosition=24, ComBitSize=8, ComSignalInitValue=0, ComSignalType=UINT8, ComTransferProperty=PENDING, ComHandleId=16, ComSystemTemplateSystemSignalRef=MotorFoc_FaultReasonPwm
        MotorFoc_IvRaw_A_MxA2_omsg_MyECU_Lamp_oCAN00_a7b61a95_Tx: ComBitPosition=64, ComBitSize=16, ComSignalInitValue=0, ComSignalType=SINT16, ComTransferProperty=PENDING, ComHandleId=30, ComSystemTemplateSystemSignalRef=MotorFoc_IvRaw_A
        MotorFoc_Page_MxA2_omsg_MyECU_Lamp_oCAN00_4390ace5_Tx: ComBitPosition=0, ComBitSize=8, ComSignalInitValue=162, ComSignalType=UINT8, ComTransferProperty=PENDING, ComHandleId=40, ComSystemTemplateSystemSignalRef=MotorFoc_Page
        MotorFoc_AdcOffsetVo2_MxA2_omsg_MyECU_Lamp_oCAN00_db461a43_Tx: ComBitPosition=160, ComBitSize=16, ComSignalInitValue=0, ComSignalType=SINT16, ComTransferProperty=PENDING, ComHandleId=5, ComSystemTemplateSystemSignalRef=MotorFoc_AdcOffsetVo2
        MotorFoc_VqRef_V_MxA1_omsg_MyECU_Lamp_oCAN00_636c7799_Tx: ComBitPosition=64, ComBitSize=16, ComSignalInitValue=0, ComSignalType=SINT16, ComTransferProperty=PENDING, ComHandleId=52, ComSystemTemplateSystemSignalRef=MotorFoc_VqRef_V
        MotorFoc_PwmU_MxA1_omsg_MyECU_Lamp_oCAN00_c33fb364_Tx: ComBitPosition=112, ComBitSize=16, ComSignalInitValue=0, ComSignalType=UINT16, ComTransferProperty=PENDING, ComHandleId=42, ComSystemTemplateSystemSignalRef=MotorFoc_PwmU
        MotorFoc_PwmW_MxA1_omsg_MyECU_Lamp_oCAN00_0530012c_Tx: ComBitPosition=144, ComBitSize=16, ComSignalInitValue=0, ComSignalType=UINT16, ComTransferProperty=PENDING, ComHandleId=44, ComSystemTemplateSystemSignalRef=MotorFoc_PwmW
        MotorFoc_MotorModePwm_MxA1_omsg_MyECU_Lamp_oCAN00_d3afa653_Tx: ComBitPosition=8, ComBitSize=8, ComSignalInitValue=0, ComSignalType=UINT8, ComTransferProperty=PENDING, ComHandleId=36, ComSystemTemplateSystemSignalRef=MotorFoc_MotorModePwm
        MotorFoc_Iu_A_MxA0_omsg_MyECU_Lamp_oCAN00_68113534_Tx: ComBitPosition=112, ComBitSize=16, ComSignalInitValue=0, ComSignalType=SINT16, ComTransferProperty=PENDING, ComHandleId=28, ComSystemTemplateSystemSignalRef=MotorFoc_Iu_A
        MotorFoc_IuFiltered_A_MxA2_omsg_MyECU_Lamp_oCAN00_edadce4b_Tx: ComBitPosition=96, ComBitSize=16, ComSignalInitValue=0, ComSignalType=SINT16, ComTransferProperty=PENDING, ComHandleId=26, ComSystemTemplateSystemSignalRef=MotorFoc_IuFiltered_A
        MotorFoc_Sequence_Mx_omsg_MyECU_Lamp_oCAN00_339a541d_Tx: ComBitPosition=32, ComBitSize=16, ComSignalInitValue=0, ComSignalType=UINT16, ComTransferProperty=TRIGGERED_WITHOUT_REPETITION, ComHandleId=45, ComSystemTemplateSystemSignalRef=MotorFoc_Sequence
        MotorFoc_AngleRaw_MxA0_omsg_MyECU_Lamp_oCAN00_7aec7e78_Tx: ComBitPosition=176, ComBitSize=16, ComSignalInitValue=0, ComSignalType=UINT16, ComTransferProperty=PENDING, ComHandleId=8, ComSystemTemplateSystemSignalRef=MotorFoc_AngleRaw
        MotorFoc_AdcFilterAlpha_MxA2_omsg_MyECU_Lamp_oCAN00_4c48c598_Tx: ComBitPosition=24, ComBitSize=8, ComSignalInitValue=0, ComSignalType=UINT8, ComTransferProperty=PENDING, ComHandleId=0, ComSystemTemplateSystemSignalRef=MotorFoc_AdcFilterAlpha
        MotorFoc_VdRef_V_MxA1_omsg_MyECU_Lamp_oCAN00_f0517bd4_Tx: ComBitPosition=48, ComBitSize=16, ComSignalInitValue=0, ComSignalType=SINT16, ComTransferProperty=PENDING, ComHandleId=48, ComSystemTemplateSystemSignalRef=MotorFoc_VdRef_V
        MotorFoc_AdcOffsetVo1_MxA2_omsg_MyECU_Lamp_oCAN00_7e4e712f_Tx: ComBitPosition=144, ComBitSize=16, ComSignalInitValue=0, ComSignalType=SINT16, ComTransferProperty=PENDING, ComHandleId=4, ComSystemTemplateSystemSignalRef=MotorFoc_AdcOffsetVo1
        MotorFoc_FaultVdc_V_MxA1_omsg_MyECU_Lamp_oCAN00_65447c06_Tx: ComBitPosition=240, ComBitSize=16, ComSignalInitValue=0, ComSignalType=SINT16, ComTransferProperty=PENDING, ComHandleId=18, ComSystemTemplateSystemSignalRef=MotorFoc_FaultVdc_V
        MotorFoc_AdcOffsetSampleCount_MxA2_omsg_MyECU_Lamp_oCAN00_98a9a073_Tx: ComBitPosition=240, ComBitSize=16, ComSignalInitValue=0, ComSignalType=UINT16, ComTransferProperty=PENDING, ComHandleId=3, ComSystemTemplateSystemSignalRef=MotorFoc_AdcOffsetSampleCount
    ComGeneral:
      ComConfigurationUseDet = true
      ComSafeBswChecks = false
      ComEnableSignalGroupArrayApi = false
      ComRetryFailedTransmitRequests = true
      ComSupportedIPduGroups = 2
      ComVersionInfoApi = false
      ComMetaDataSupport = false
      ComDeferredEventCacheSupport = false
      ComDescriptionGateway = false
      ComStrictRepetitionPeriod = false
      ComMixedModePeriodicSuppression = false
      ComSignalGateway = NONE
      ComMultiPartition = false
    ComGeneration:
      ComOutOfBoundsWriteProtectionStrategy = NONE
      ComOutOfBoundsWriteSanitizer = false
      ComOutOfBoundsReadSanitizer = false
      ComReduceConstantData2Define = false
      ComBoolDataInArrayOfStructStrategy = BOOLEAN
      ComDeduplicateIndirectedData = true
      ComDataDeduplicationStrategy = WITH_CAST
      ComReduceBoolDataByNegationThreshold = 2
      ComReduceBoolDataByNumericalComparisonThreshold = 2
      ComReduceBoolDataByNumericalRelationThreshold = 2
      ComReduceBoolDataByNumericalOperandStrategy = WITH_ANY_VALUE
      ComReduceNumericalDataByOffsetThreshold = 2
      ComReduceNumericalDataByArraySubtractionThreshold = 2
      ComReduceDataByStreaming = false
      ComShortSymbols = false
      ComInterfacesForDeactivatedData = false
      ComReferringKeysInComments = false
      ComNumberOfElementsCommentThreshold = 1000
    ComOptimization:
      ComTxProcessingISRLockThreshold = 1
      ComRxProcessingISRLockThreshold = 1
      ComGatewayProcessingISRLockThreshold = 1
      ComGatewayDescriptionProcessingISRLockThreshold = 1
      ComIPduGroupISRLockThreshold = 1
