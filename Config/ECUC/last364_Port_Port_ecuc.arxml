AUTOSAR XML (schema 00048)
package /Port
  module config Port: implementation-config-variant=VARIANT-POST-BUILD, module-description=Port_Impl
    CommonPublishedInformation:
      ArMajorVersion = 4
      ArMinorVersion = 2
      ArPatchVersion = 2
      ModuleId = 124
      Release = _TRICORE_TC364_TQFP
      SwMajorVersion = 20
      SwMinorVersion = 10
      SwPatchVersion = 0
      VendorId = 17
    PortConfigSet
      14 x PortContainer:
        PortContainer_0: PortNumber=0, PortNumberOfPortPins=11
          11 x PortPin, all with PortPinControllerSelect=DISABLE, PortPinDirectionChangeable=false, PortPinEmergencyStop=false, PortPinEnableAnalogInputOnly=PORT_PIN_ANALOG_INPUT_DISABLE, PortPinInitialMode=GPIO, PortPinInputPadLevel=PORT_INPUT_LEVEL_CMOS_AUTOMOTIVE, PortPinModeChangeable=false, PortPinOutputPadDriveStrength=PORT_PIN_DEFAULT_DRIVER, PortPinOutputPinDriveMode=PORT_PIN_OUT_PUSHPULL:
            PortPin_9183PFB1: PortPinDirection=PORT_PIN_IN, PortPinId=0, PortPinInputPullResistor=PORT_PIN_IN_NO_PULL, PortPinLevelValue=PORT_PIN_LEVEL_LOW, PortPinMode=PORT_PIN_MODE_GPIO, PortPinSymbolicName=PORT_0_PIN_0
            PortPin_9183PFB2: PortPinDirection=PORT_PIN_IN, PortPinId=1, PortPinInputPullResistor=PORT_PIN_IN_NO_PULL, PortPinLevelValue=PORT_PIN_LEVEL_LOW, PortPinMode=PORT_PIN_MODE_GPIO, PortPinSymbolicName=PORT_0_PIN_1
            PortPin_19183INH: PortPinDirection=PORT_PIN_OUT, PortPinId=12, PortPinInputPullResistor=PORT_PIN_IN_PULL_UP, PortPinLevelValue=PORT_PIN_LEVEL_LOW, PortPinMode=PORT_PIN_MODE_GPIO, PortPinSymbolicName=PORT_0_PIN_12
            PortPin_9183SOFF: PortPinDirection=PORT_PIN_OUT, PortPinId=2, PortPinInputPullResistor=PORT_PIN_IN_PULL_UP, PortPinLevelValue=PORT_PIN_LEVEL_HIGH, PortPinMode=PORT_PIN_MODE_GPIO, PortPinSymbolicName=PORT_0_PIN_2
            PortPin_9183PFB3: PortPinDirection=PORT_PIN_IN, PortPinId=3, PortPinInputPullResistor=PORT_PIN_IN_NO_PULL, PortPinLevelValue=PORT_PIN_LEVEL_LOW, PortPinMode=PORT_PIN_MODE_GPIO, PortPinSymbolicName=PORT_0_PIN_3
            PortPin_9183ERR: PortPinDirection=PORT_PIN_IN, PortPinId=4, PortPinInputPullResistor=PORT_PIN_IN_NO_PULL, PortPinLevelValue=PORT_PIN_LEVEL_LOW, PortPinMode=PORT_PIN_MODE_ALL, PortPinSymbolicName=PORT_0_PIN_4
            PortPin_{5..9}: PortPinDirection=PORT_PIN_IN, PortPinId={5..9}, PortPinInputPullResistor=PORT_PIN_IN_PULL_UP, PortPinLevelValue=PORT_PIN_LEVEL_LOW, PortPinMode=PORT_PIN_MODE_ALL, PortPinSymbolicName=PORT_0_PIN_{5..9}
        PortContainer_1: PortNumber=2, PortNumberOfPortPins=9
          9 x PortPin, all with PortPinControllerSelect=DISABLE, PortPinDirectionChangeable=false, PortPinEmergencyStop=false, PortPinEnableAnalogInputOnly=PORT_PIN_ANALOG_INPUT_DISABLE, PortPinInputPadLevel=PORT_INPUT_LEVEL_CMOS_AUTOMOTIVE, PortPinInputPullResistor=PORT_PIN_IN_PULL_UP, PortPinLevelValue=PORT_PIN_LEVEL_LOW, PortPinModeChangeable=false, PortPinOutputPadDriveStrength=PORT_PIN_DEFAULT_DRIVER, PortPinOutputPinDriveMode=PORT_PIN_OUT_PUSHPULL:
            PortPin_0: PortPinDirection=PORT_PIN_IN, PortPinId=32, PortPinInitialMode=GPIO, PortPinMode=PORT_PIN_MODE_ALL, PortPinSymbolicName=PORT_2_PIN_0
            PortPin_9183IH1: PortPinDirection=PORT_PIN_OUT, PortPinId=33, PortPinInitialMode=ALT1, PortPinMode=PORT_PIN_MODE_ALT1, PortPinSymbolicName=PORT_2_PIN_1
            PortPin_9183IH2: PortPinDirection=PORT_PIN_OUT, PortPinId=34, PortPinInitialMode=ALT1, PortPinMode=PORT_PIN_MODE_ALT1, PortPinSymbolicName=PORT_2_PIN_2
            PortPin_9183IH3: PortPinDirection=PORT_PIN_OUT, PortPinId=35, PortPinInitialMode=ALT1, PortPinMode=PORT_PIN_MODE_ALT1, PortPinSymbolicName=PORT_2_PIN_3
            PortPin_9183IL1: PortPinDirection=PORT_PIN_OUT, PortPinId=36, PortPinInitialMode=ALT1, PortPinMode=PORT_PIN_MODE_ALT1, PortPinSymbolicName=PORT_2_PIN_4
            PortPin_9183IL2: PortPinDirection=PORT_PIN_OUT, PortPinId=37, PortPinInitialMode=ALT1, PortPinMode=PORT_PIN_MODE_ALT1, PortPinSymbolicName=PORT_2_PIN_5
            PortPin_9183IL3: PortPinDirection=PORT_PIN_OUT, PortPinId=38, PortPinInitialMode=ALT1, PortPinMode=PORT_PIN_MODE_ALT1, PortPinSymbolicName=PORT_2_PIN_6
            PortPin_7: PortPinDirection=PORT_PIN_IN, PortPinId=39, PortPinInitialMode=GPIO, PortPinMode=PORT_PIN_MODE_ALL, PortPinSymbolicName=PORT_2_PIN_7
            PortPin_9183ENA: PortPinDirection=PORT_PIN_OUT, PortPinId=40, PortPinInitialMode=GPIO, PortPinMode=PORT_PIN_MODE_GPIO, PortPinSymbolicName=PORT_2_PIN_8
        PortContainer_10: PortNumber=23, PortNumberOfPortPins=1
          PortPin_0 (PortPin):
            PortPinControllerSelect = DISABLE
            PortPinDirection = PORT_PIN_IN
            PortPinDirectionChangeable = false
            PortPinEmergencyStop = false
            PortPinEnableAnalogInputOnly = PORT_PIN_ANALOG_INPUT_DISABLE
            PortPinId = 369
            PortPinInitialMode = GPIO
            PortPinInputPadLevel = PORT_INPUT_LEVEL_CMOS_AUTOMOTIVE
            PortPinInputPullResistor = PORT_PIN_IN_PULL_UP
            PortPinLevelValue = PORT_PIN_LEVEL_LOW
            PortPinMode = PORT_PIN_MODE_ALL
            PortPinModeChangeable = false
            PortPinOutputPadDriveStrength = PORT_PIN_DEFAULT_DRIVER
            PortPinOutputPinDriveMode = PORT_PIN_OUT_PUSHPULL
            PortPinSymbolicName = PORT_23_PIN_1
        PortContainer_11: PortNumber=32, PortNumberOfPortPins=2
          PortPin_0 (PortPin):
            PortPinControllerSelect = DISABLE
            PortPinDirection = PORT_PIN_IN
            PortPinDirectionChangeable = false
            PortPinEmergencyStop = false
            PortPinEnableAnalogInputOnly = PORT_PIN_ANALOG_INPUT_DISABLE
            PortPinId = 512
            PortPinInitialMode = GPIO
            PortPinInputPadLevel = PORT_INPUT_LEVEL_CMOS_AUTOMOTIVE
            PortPinInputPullResistor = PORT_PIN_IN_PULL_UP
            PortPinLevelValue = PORT_PIN_LEVEL_LOW
            PortPinMode = PORT_PIN_MODE_ALL
            PortPinModeChangeable = false
            PortPinOutputPadDriveStrength = PORT_PIN_DEFAULT_DRIVER
            PortPinOutputPinDriveMode = PORT_PIN_OUT_PUSHPULL
            PortPinSymbolicName = PORT_32_PIN_0
          PortPin_1 (PortPin):
            PortPinControllerSelect = DISABLE
            PortPinDirection = PORT_PIN_IN
            PortPinDirectionChangeable = false
            PortPinEmergencyStop = false
            PortPinEnableAnalogInputOnly = PORT_PIN_ANALOG_INPUT_DISABLE
            PortPinId = 513
            PortPinInitialMode = GPIO
            PortPinInputPadLevel = PORT_INPUT_LEVEL_CMOS_AUTOMOTIVE
            PortPinInputPullResistor = PORT_PIN_IN_PULL_UP
            PortPinLevelValue = PORT_PIN_LEVEL_LOW
            PortPinMode = PORT_PIN_MODE_ALL
            PortPinModeChangeable = false
            PortPinOutputPadDriveStrength = PORT_PIN_DEFAULT_DRIVER
            PortPinOutputPinDriveMode = PORT_PIN_OUT_PUSHPULL
            PortPinSymbolicName = PORT_32_PIN_1
        PortContainer_12: PortNumber=33, PortNumberOfPortPins=13
          13 x PortPin, all with PortPinControllerSelect=DISABLE, PortPinDirectionChangeable=false, PortPinEmergencyStop=false, PortPinEnableAnalogInputOnly=PORT_PIN_ANALOG_INPUT_DISABLE, PortPinInitialMode=GPIO, PortPinInputPadLevel=PORT_INPUT_LEVEL_CMOS_AUTOMOTIVE, PortPinInputPullResistor=PORT_PIN_IN_PULL_UP, PortPinLevelValue=PORT_PIN_LEVEL_LOW, PortPinMode=PORT_PIN_MODE_ALL, PortPinModeChangeable=false, PortPinOutputPadDriveStrength=PORT_PIN_DEFAULT_DRIVER, PortPinOutputPinDriveMode=PORT_PIN_OUT_PUSHPULL:
            PortPin_10: PortPinDirection=PORT_PIN_IN, PortPinId=538, PortPinSymbolicName=PORT_33_PIN_10
            PortPin_11: PortPinDirection=PORT_PIN_IN, PortPinId=539, PortPinSymbolicName=PORT_33_PIN_11
            PortPin_12: PortPinDirection=PORT_PIN_IN, PortPinId=540, PortPinSymbolicName=PORT_33_PIN_12
            PortPin_2: PortPinDirection=PORT_PIN_IN, PortPinId=530, PortPinSymbolicName=PORT_33_PIN_2
            PortPin_3: PortPinDirection=PORT_PIN_IN, PortPinId=531, PortPinSymbolicName=PORT_33_PIN_3
            PortPin_4: PortPinDirection=PORT_PIN_IN, PortPinId=532, PortPinSymbolicName=PORT_33_PIN_4
            PortPin_5: PortPinDirection=PORT_PIN_IN, PortPinId=533, PortPinSymbolicName=PORT_33_PIN_5
            PortPin_6: PortPinDirection=PORT_PIN_IN, PortPinId=534, PortPinSymbolicName=PORT_33_PIN_6
            PortPin_7: PortPinDirection=PORT_PIN_IN, PortPinId=535, PortPinSymbolicName=PORT_33_PIN_7
            PortPin_8: PortPinDirection=PORT_PIN_IN, PortPinId=536, PortPinSymbolicName=PORT_33_PIN_8
            PortPin_9: PortPinDirection=PORT_PIN_IN, PortPinId=537, PortPinSymbolicName=PORT_33_PIN_9
            PortPin_Led2: PortPinDirection=PORT_PIN_OUT, PortPinId=529, PortPinSymbolicName=PORT_33_PIN_1
            PortPin_led1: PortPinDirection=PORT_PIN_OUT, PortPinId=528, PortPinSymbolicName=PORT_33_PIN_0
        PortContainer_13: PortNumber=40, PortNumberOfPortPins=10
          10 x PortPin, all with PortPinControllerSelect=DISABLE, PortPinDirection=PORT_PIN_IN, PortPinDirectionChangeable=false, PortPinEmergencyStop=false, PortPinInitialMode=GPIO, PortPinInputPadLevel=PORT_INPUT_LEVEL_CMOS_AUTOMOTIVE, PortPinLevelValue=PORT_PIN_LEVEL_LOW, PortPinMode=PORT_PIN_MODE_ALL, PortPinModeChangeable=false, PortPinOutputPadDriveStrength=PORT_PIN_DEFAULT_DRIVER, PortPinOutputPinDriveMode=PORT_PIN_OUT_PUSHPULL:
            PortPin_0: PortPinEnableAnalogInputOnly=PORT_PIN_ANALOG_INPUT_DISABLE, PortPinId=640, PortPinInputPullResistor=PORT_PIN_IN_PULL_UP, PortPinSymbolicName=PORT_40_PIN_0
            PortPin_1: PortPinEnableAnalogInputOnly=PORT_PIN_ANALOG_INPUT_DISABLE, PortPinId=641, PortPinInputPullResistor=PORT_PIN_IN_PULL_UP, PortPinSymbolicName=PORT_40_PIN_1
            PortPin_2: PortPinEnableAnalogInputOnly=PORT_PIN_ANALOG_INPUT_DISABLE, PortPinId=642, PortPinInputPullResistor=PORT_PIN_IN_PULL_UP, PortPinSymbolicName=PORT_40_PIN_2
            PortPin_3: PortPinEnableAnalogInputOnly=PORT_PIN_ANALOG_INPUT_DISABLE, PortPinId=643, PortPinInputPullResistor=PORT_PIN_IN_PULL_UP, PortPinSymbolicName=PORT_40_PIN_3
            PortPin_4: PortPinEnableAnalogInputOnly=PORT_PIN_ANALOG_INPUT_DISABLE, PortPinId=644, PortPinInputPullResistor=PORT_PIN_IN_PULL_UP, PortPinSymbolicName=PORT_40_PIN_4
            PortPin_5: PortPinEnableAnalogInputOnly=PORT_PIN_ANALOG_INPUT_DISABLE, PortPinId=645, PortPinInputPullResistor=PORT_PIN_IN_PULL_UP, PortPinSymbolicName=PORT_40_PIN_5
            PortPin_6: PortPinEnableAnalogInputOnly=PORT_PIN_ANALOG_INPUT_ENABLE, PortPinId=646, PortPinInputPullResistor=PORT_PIN_IN_NO_PULL, PortPinSymbolicName=PORT_40_PIN_6
            PortPin_7: PortPinEnableAnalogInputOnly=PORT_PIN_ANALOG_INPUT_ENABLE, PortPinId=647, PortPinInputPullResistor=PORT_PIN_IN_NO_PULL, PortPinSymbolicName=PORT_40_PIN_7
            PortPin_8: PortPinEnableAnalogInputOnly=PORT_PIN_ANALOG_INPUT_DISABLE, PortPinId=648, PortPinInputPullResistor=PORT_PIN_IN_PULL_UP, PortPinSymbolicName=PORT_40_PIN_8
            PortPin_9: PortPinEnableAnalogInputOnly=PORT_PIN_ANALOG_INPUT_DISABLE, PortPinId=649, PortPinInputPullResistor=PORT_PIN_IN_PULL_UP, PortPinSymbolicName=PORT_40_PIN_9
        PortContainer_2: PortNumber=10, PortNumberOfPortPins=5
          5 x PortPin, all with PortPinControllerSelect=DISABLE, PortPinDirection=PORT_PIN_IN, PortPinDirectionChangeable=false, PortPinEmergencyStop=false, PortPinEnableAnalogInputOnly=PORT_PIN_ANALOG_INPUT_DISABLE, PortPinInitialMode=GPIO, PortPinInputPadLevel=PORT_INPUT_LEVEL_CMOS_AUTOMOTIVE, PortPinInputPullResistor=PORT_PIN_IN_PULL_UP, PortPinLevelValue=PORT_PIN_LEVEL_LOW, PortPinMode=PORT_PIN_MODE_ALL, PortPinModeChangeable=false, PortPinOutputPadDriveStrength=PORT_PIN_DEFAULT_DRIVER, PortPinOutputPinDriveMode=PORT_PIN_OUT_PUSHPULL:
            PortPin_0: PortPinId=161, PortPinSymbolicName=PORT_10_PIN_1
            PortPin_1: PortPinId=162, PortPinSymbolicName=PORT_10_PIN_2
            PortPin_2: PortPinId=163, PortPinSymbolicName=PORT_10_PIN_3
            PortPin_3: PortPinId=165, PortPinSymbolicName=PORT_10_PIN_5
            PortPin_4: PortPinId=166, PortPinSymbolicName=PORT_10_PIN_6
        PortContainer_3: PortNumber=11, PortNumberOfPortPins=8
          8 x PortPin, all with PortPinControllerSelect=DISABLE, PortPinDirectionChangeable=false, PortPinEmergencyStop=false, PortPinEnableAnalogInputOnly=PORT_PIN_ANALOG_INPUT_DISABLE, PortPinInputPadLevel=PORT_INPUT_LEVEL_CMOS_AUTOMOTIVE, PortPinInputPullResistor=PORT_PIN_IN_PULL_UP, PortPinLevelValue=PORT_PIN_LEVEL_LOW, PortPinModeChangeable=false, PortPinOutputPadDriveStrength=PORT_PIN_DEFAULT_DRIVER, PortPinOutputPinDriveMode=PORT_PIN_OUT_PUSHPULL:
            PortPin_tle35584_CSN: PortPinDirection=PORT_PIN_OUT, PortPinId=178, PortPinInitialMode=ALT4, PortPinMode=PORT_PIN_MODE_ALT4, PortPinSymbolicName=PORT_11_PIN_2
            PortPin_tle35584_MRST: PortPinDirection=PORT_PIN_IN, PortPinId=179, PortPinInitialMode=GPIO, PortPinMode=PORT_PIN_MODE_ALL, PortPinSymbolicName=PORT_11_PIN_3
            PortPin_tle35584_Clk: PortPinDirection=PORT_PIN_OUT, PortPinId=182, PortPinInitialMode=ALT3, PortPinMode=PORT_PIN_MODE_ALT3, PortPinSymbolicName=PORT_11_PIN_6
            PortPin_3: PortPinDirection=PORT_PIN_IN, PortPinId=184, PortPinInitialMode=GPIO, PortPinMode=PORT_PIN_MODE_ALL, PortPinSymbolicName=PORT_11_PIN_8
            PortPin_tle35584_MTSR: PortPinDirection=PORT_PIN_OUT, PortPinId=185, PortPinInitialMode=ALT3, PortPinMode=PORT_PIN_MODE_ALT3, PortPinSymbolicName=PORT_11_PIN_9
            PortPin_5: PortPinDirection=PORT_PIN_IN, PortPinId=186, PortPinInitialMode=GPIO, PortPinMode=PORT_PIN_MODE_ALL, PortPinSymbolicName=PORT_11_PIN_10
            PortPin_6: PortPinDirection=PORT_PIN_IN, PortPinId=187, PortPinInitialMode=GPIO, PortPinMode=PORT_PIN_MODE_ALL, PortPinSymbolicName=PORT_11_PIN_11
            PortPin_7: PortPinDirection=PORT_PIN_IN, PortPinId=188, PortPinInitialMode=GPIO, PortPinMode=PORT_PIN_MODE_ALL, PortPinSymbolicName=PORT_11_PIN_12
        PortContainer_4: PortNumber=13, PortNumberOfPortPins=4
          PortLVDS_0 (PortLVDS):
            PortLVDSMode = LVDSH
            PortLVDSPadSupply = V3_3
            PortLVDSPinPair = Pin_0_Pin_1
            PortLVDSRxEnController = PORT_CONTROLLED
            PortLVDSRxPathEnable = false
            PortLVDSRxTerminationMode = INTERNAL_TERMINATION
            PortLVDSTxEnController = PORT_CONTROLLED
            PortLVDSTxPathEnable = false
            PortLVDSTxPowerDownPullDown = DISABLE
          PortLVDS_1 (PortLVDS):
            PortLVDSMode = LVDSH
            PortLVDSPadSupply = V3_3
            PortLVDSPinPair = Pin_2_Pin_3
            PortLVDSRxEnController = PORT_CONTROLLED
            PortLVDSRxPathEnable = false
            PortLVDSRxTerminationMode = INTERNAL_TERMINATION
            PortLVDSTxEnController = PORT_CONTROLLED
            PortLVDSTxPathEnable = false
            PortLVDSTxPowerDownPullDown = DISABLE
          4 x PortPin, all with PortPinControllerSelect=DISABLE, PortPinDirection=PORT_PIN_IN, PortPinDirectionChangeable=false, PortPinEmergencyStop=false, PortPinEnableAnalogInputOnly=PORT_PIN_ANALOG_INPUT_DISABLE, PortPinInitialMode=GPIO, PortPinInputPadLevel=PORT_INPUT_LEVEL_CMOS_AUTOMOTIVE, PortPinInputPullResistor=PORT_PIN_IN_PULL_UP, PortPinLevelValue=PORT_PIN_LEVEL_LOW, PortPinMode=PORT_PIN_MODE_ALL, PortPinModeChangeable=false, PortPinOutputPadDriveStrength=PORT_PIN_DEFAULT_DRIVER, PortPinOutputPinDriveMode=PORT_PIN_OUT_PUSHPULL:
            PortPin_0: PortPinId=208, PortPinSymbolicName=PORT_13_PIN_0
            PortPin_1: PortPinId=209, PortPinSymbolicName=PORT_13_PIN_1
            PortPin_2: PortPinId=210, PortPinSymbolicName=PORT_13_PIN_2
            PortPin_3: PortPinId=211, PortPinSymbolicName=PORT_13_PIN_3
        PortContainer_5: PortNumber=14, PortNumberOfPortPins=7
          7 x PortPin, all with PortPinControllerSelect=DISABLE, PortPinDirectionChangeable=false, PortPinEmergencyStop=false, PortPinEnableAnalogInputOnly=PORT_PIN_ANALOG_INPUT_DISABLE, PortPinInputPadLevel=PORT_INPUT_LEVEL_CMOS_AUTOMOTIVE, PortPinModeChangeable=false, PortPinOutputPadDriveStrength=PORT_PIN_DEFAULT_DRIVER, PortPinOutputPinDriveMode=PORT_PIN_OUT_PUSHPULL:
            PortPin_2: PortPinDirection=PORT_PIN_IN, PortPinId=226, PortPinInitialMode=GPIO, PortPinInputPullResistor=PORT_PIN_IN_PULL_UP, PortPinLevelValue=PORT_PIN_LEVEL_LOW, PortPinMode=PORT_PIN_MODE_ALL, PortPinSymbolicName=PORT_14_PIN_2
            PortPin_3: PortPinDirection=PORT_PIN_IN, PortPinId=227, PortPinInitialMode=GPIO, PortPinInputPullResistor=PORT_PIN_IN_PULL_UP, PortPinLevelValue=PORT_PIN_LEVEL_LOW, PortPinMode=PORT_PIN_MODE_ALL, PortPinSymbolicName=PORT_14_PIN_3
            PortPin_4: PortPinDirection=PORT_PIN_IN, PortPinId=228, PortPinInitialMode=GPIO, PortPinInputPullResistor=PORT_PIN_IN_PULL_UP, PortPinLevelValue=PORT_PIN_LEVEL_LOW, PortPinMode=PORT_PIN_MODE_ALL, PortPinSymbolicName=PORT_14_PIN_4
            PortPin_5: PortPinDirection=PORT_PIN_IN, PortPinId=229, PortPinInitialMode=GPIO, PortPinInputPullResistor=PORT_PIN_IN_PULL_UP, PortPinLevelValue=PORT_PIN_LEVEL_LOW, PortPinMode=PORT_PIN_MODE_ALL, PortPinSymbolicName=PORT_14_PIN_5
            PortPin_5012CSN: PortPinDirection=PORT_PIN_OUT, PortPinId=230, PortPinInitialMode=ALT3, PortPinInputPullResistor=PORT_PIN_IN_PULL_UP, PortPinLevelValue=PORT_PIN_LEVEL_HIGH, PortPinMode=PORT_PIN_MODE_ALT3, PortPinSymbolicName=PORT_14_PIN_6
            PortPin_CAN2Rx: PortPinDirection=PORT_PIN_IN, PortPinId=225, PortPinInitialMode=GPIO, PortPinInputPullResistor=PORT_PIN_IN_NO_PULL, PortPinLevelValue=PORT_PIN_LEVEL_LOW, PortPinMode=PORT_PIN_MODE_ALL, PortPinSymbolicName=PORT_14_PIN_1
            PortPin_CAN2Tx: PortPinDirection=PORT_PIN_OUT, PortPinId=224, PortPinInitialMode=ALT5, PortPinInputPullResistor=PORT_PIN_IN_PULL_UP, PortPinLevelValue=PORT_PIN_LEVEL_LOW, PortPinMode=PORT_PIN_MODE_ALL, PortPinSymbolicName=PORT_14_PIN_0
        PortContainer_6: PortNumber=15, PortNumberOfPortPins=9
          9 x PortPin, all with PortPinControllerSelect=DISABLE, PortPinDirectionChangeable=false, PortPinEmergencyStop=false, PortPinEnableAnalogInputOnly=PORT_PIN_ANALOG_INPUT_DISABLE, PortPinInputPadLevel=PORT_INPUT_LEVEL_CMOS_AUTOMOTIVE, PortPinLevelValue=PORT_PIN_LEVEL_LOW, PortPinModeChangeable=false, PortPinOutputPadDriveStrength=PORT_PIN_DEFAULT_DRIVER, PortPinOutputPinDriveMode=PORT_PIN_OUT_PUSHPULL:
            PortPin_0: PortPinDirection=PORT_PIN_IN, PortPinId=240, PortPinInitialMode=GPIO, PortPinInputPullResistor=PORT_PIN_IN_PULL_UP, PortPinMode=PORT_PIN_MODE_ALL, PortPinSymbolicName=PORT_15_PIN_0
            PortPin_1: PortPinDirection=PORT_PIN_IN, PortPinId=241, PortPinInitialMode=GPIO, PortPinInputPullResistor=PORT_PIN_IN_PULL_UP, PortPinMode=PORT_PIN_MODE_ALL, PortPinSymbolicName=PORT_15_PIN_1
            PortPin_UartTx: PortPinDirection=PORT_PIN_OUT, PortPinId=242, PortPinInitialMode=ALT2, PortPinInputPullResistor=PORT_PIN_IN_PULL_UP, PortPinMode=PORT_PIN_MODE_ALT2, PortPinSymbolicName=PORT_15_PIN_2
            PortPin_UartRx: PortPinDirection=PORT_PIN_IN, PortPinId=243, PortPinInitialMode=GPIO, PortPinInputPullResistor=PORT_PIN_IN_PULL_UP, PortPinMode=PORT_PIN_MODE_GPIO, PortPinSymbolicName=PORT_15_PIN_3
            PortPin_4: PortPinDirection=PORT_PIN_IN, PortPinId=244, PortPinInitialMode=GPIO, PortPinInputPullResistor=PORT_PIN_IN_PULL_UP, PortPinMode=PORT_PIN_MODE_ALL, PortPinSymbolicName=PORT_15_PIN_4
            PortPin_5012MTSR: PortPinDirection=PORT_PIN_OUT, PortPinId=245, PortPinInitialMode=ALT3, PortPinInputPullResistor=PORT_PIN_IN_PULL_UP, PortPinMode=PORT_PIN_MODE_ALT3, PortPinSymbolicName=PORT_15_PIN_5
            PortPin_5012CLK: PortPinDirection=PORT_PIN_OUT, PortPinId=246, PortPinInitialMode=ALT5, PortPinInputPullResistor=PORT_PIN_IN_PULL_UP, PortPinMode=PORT_PIN_MODE_ALT5, PortPinSymbolicName=PORT_15_PIN_6
            PortPin_5012MRST: PortPinDirection=PORT_PIN_IN, PortPinId=247, PortPinInitialMode=GPIO, PortPinInputPullResistor=PORT_PIN_IN_NO_PULL, PortPinMode=PORT_PIN_MODE_GPIO, PortPinSymbolicName=PORT_15_PIN_7
            PortPin_88: PortPinDirection=PORT_PIN_IN, PortPinId=248, PortPinInitialMode=GPIO, PortPinInputPullResistor=PORT_PIN_IN_PULL_UP, PortPinMode=PORT_PIN_MODE_ALL, PortPinSymbolicName=PORT_15_PIN_8
        PortContainer_7: PortNumber=20, PortNumberOfPortPins=12
          12 x PortPin, all with PortPinControllerSelect=DISABLE, PortPinDirectionChangeable=false, PortPinEmergencyStop=false, PortPinEnableAnalogInputOnly=PORT_PIN_ANALOG_INPUT_DISABLE, PortPinInputPadLevel=PORT_INPUT_LEVEL_CMOS_AUTOMOTIVE, PortPinInputPullResistor=PORT_PIN_IN_PULL_UP, PortPinMode=PORT_PIN_MODE_ALL, PortPinModeChangeable=false, PortPinOutputPadDriveStrength=PORT_PIN_DEFAULT_DRIVER, PortPinOutputPinDriveMode=PORT_PIN_OUT_PUSHPULL:
            PortPin_0: PortPinDirection=PORT_PIN_IN, PortPinId=320, PortPinInitialMode=GPIO, PortPinLevelValue=PORT_PIN_LEVEL_LOW, PortPinSymbolicName=PORT_20_PIN_0
            PortPin_1: PortPinDirection=PORT_PIN_IN, PortPinId=322, PortPinInitialMode=GPIO, PortPinLevelValue=PORT_PIN_LEVEL_LOW, PortPinSymbolicName=PORT_20_PIN_2
            PortPin_10: PortPinDirection=PORT_PIN_IN, PortPinId=333, PortPinInitialMode=GPIO, PortPinLevelValue=PORT_PIN_LEVEL_LOW, PortPinSymbolicName=PORT_20_PIN_13
            PortPin_11: PortPinDirection=PORT_PIN_IN, PortPinId=334, PortPinInitialMode=GPIO, PortPinLevelValue=PORT_PIN_LEVEL_LOW, PortPinSymbolicName=PORT_20_PIN_14
            PortPin_2: PortPinDirection=PORT_PIN_IN, PortPinId=323, PortPinInitialMode=GPIO, PortPinLevelValue=PORT_PIN_LEVEL_LOW, PortPinSymbolicName=PORT_20_PIN_3
            PortPin_8: PortPinDirection=PORT_PIN_IN, PortPinId=331, PortPinInitialMode=GPIO, PortPinLevelValue=PORT_PIN_LEVEL_LOW, PortPinSymbolicName=PORT_20_PIN_11
            PortPin_9: PortPinDirection=PORT_PIN_IN, PortPinId=332, PortPinInitialMode=GPIO, PortPinLevelValue=PORT_PIN_LEVEL_LOW, PortPinSymbolicName=PORT_20_PIN_12
            PortPin_CAN1EN: PortPinDirection=PORT_PIN_OUT, PortPinId=329, PortPinInitialMode=GPIO, PortPinLevelValue=PORT_PIN_LEVEL_HIGH, PortPinSymbolicName=PORT_20_PIN_9
            PortPin_CAN1NERR: PortPinDirection=PORT_PIN_IN, PortPinId=330, PortPinInitialMode=GPIO, PortPinLevelValue=PORT_PIN_LEVEL_LOW, PortPinSymbolicName=PORT_20_PIN_10
            PortPin_CAN1Nstb: PortPinDirection=PORT_PIN_OUT, PortPinId=326, PortPinInitialMode=GPIO, PortPinLevelValue=PORT_PIN_LEVEL_HIGH, PortPinSymbolicName=PORT_20_PIN_6
            PortPin_CAN1Rx: PortPinDirection=PORT_PIN_IN, PortPinId=327, PortPinInitialMode=GPIO, PortPinLevelValue=PORT_PIN_LEVEL_LOW, PortPinSymbolicName=PORT_20_PIN_7
            PortPin_CAN1Tx: PortPinDirection=PORT_PIN_OUT, PortPinId=328, PortPinInitialMode=ALT5, PortPinLevelValue=PORT_PIN_LEVEL_LOW, PortPinSymbolicName=PORT_20_PIN_8
        PortContainer_8: PortNumber=21, PortNumberOfPortPins=6
          PortLVDS_0 (PortLVDS):
            PortLVDSMode = LVDSH
            PortLVDSPadSupply = V3_3
            PortLVDSPinPair = Pin_2_Pin_3
            PortLVDSRxEnController = PORT_CONTROLLED
            PortLVDSRxPathEnable = false
            PortLVDSRxTerminationMode = INTERNAL_TERMINATION
            PortLVDSTxEnController = PORT_CONTROLLED
            PortLVDSTxPathEnable = false
            PortLVDSTxPowerDownPullDown = DISABLE
          PortLVDS_1 (PortLVDS):
            PortLVDSMode = LVDSH
            PortLVDSPadSupply = V3_3
            PortLVDSPinPair = Pin_4_Pin_5
            PortLVDSRxEnController = PORT_CONTROLLED
            PortLVDSRxPathEnable = false
            PortLVDSRxTerminationMode = INTERNAL_TERMINATION
            PortLVDSTxEnController = PORT_CONTROLLED
            PortLVDSTxPathEnable = false
            PortLVDSTxPowerDownPullDown = DISABLE
          6 x PortPin, all with PortPinControllerSelect=DISABLE, PortPinDirection=PORT_PIN_IN, PortPinDirectionChangeable=false, PortPinEmergencyStop=false, PortPinEnableAnalogInputOnly=PORT_PIN_ANALOG_INPUT_DISABLE, PortPinInitialMode=GPIO, PortPinInputPadLevel=PORT_INPUT_LEVEL_CMOS_AUTOMOTIVE, PortPinInputPullResistor=PORT_PIN_IN_PULL_UP, PortPinLevelValue=PORT_PIN_LEVEL_LOW, PortPinMode=PORT_PIN_MODE_ALL, PortPinModeChangeable=false, PortPinOutputPadDriveStrength=PORT_PIN_DEFAULT_DRIVER, PortPinOutputPinDriveMode=PORT_PIN_OUT_PUSHPULL:
            PortPin_0: PortPinId=338, PortPinSymbolicName=PORT_21_PIN_2
            PortPin_1: PortPinId=339, PortPinSymbolicName=PORT_21_PIN_3
            PortPin_2: PortPinId=340, PortPinSymbolicName=PORT_21_PIN_4
            PortPin_3: PortPinId=341, PortPinSymbolicName=PORT_21_PIN_5
            PortPin_4: PortPinId=342, PortPinSymbolicName=PORT_21_PIN_6
            PortPin_5: PortPinId=343, PortPinSymbolicName=PORT_21_PIN_7
        PortContainer_9: PortNumber=22, PortNumberOfPortPins=4
          4 x PortPin, all with PortPinControllerSelect=DISABLE, PortPinDirectionChangeable=false, PortPinEmergencyStop=false, PortPinEnableAnalogInputOnly=PORT_PIN_ANALOG_INPUT_DISABLE, PortPinInputPadLevel=PORT_INPUT_LEVEL_CMOS_AUTOMOTIVE, PortPinInputPullResistor=PORT_PIN_IN_PULL_UP, PortPinLevelValue=PORT_PIN_LEVEL_LOW, PortPinModeChangeable=false, PortPinOutputPadDriveStrength=PORT_PIN_DEFAULT_DRIVER, PortPinOutputPinDriveMode=PORT_PIN_OUT_PUSHPULL:
            PortPin_9183Qspi3MTSR: PortPinDirection=PORT_PIN_OUT, PortPinId=352, PortPinInitialMode=ALT3, PortPinMode=PORT_PIN_MODE_ALT3, PortPinSymbolicName=PORT_22_PIN_0
            PortPin_9183Qspi3MRST: PortPinDirection=PORT_PIN_IN, PortPinId=353, PortPinInitialMode=GPIO, PortPinMode=PORT_PIN_MODE_ALL, PortPinSymbolicName=PORT_22_PIN_1
            PortPin_9183QspiCSN: PortPinDirection=PORT_PIN_OUT, PortPinId=354, PortPinInitialMode=ALT3, PortPinMode=PORT_PIN_MODE_ALT3, PortPinSymbolicName=PORT_22_PIN_2
            PortPin_9183Qspi3CLK: PortPinDirection=PORT_PIN_OUT, PortPinId=355, PortPinInitialMode=ALT3, PortPinMode=PORT_PIN_MODE_ALT3, PortPinSymbolicName=PORT_22_PIN_3
    PortGeneral:
      PortDevErrorDetect = false
      PortInitApiMode = PORT_MCAL_SUPERVISOR
      PortInitCheckApi = false
      PortSafetyEnable = false
      PortSetPinDirectionApi = false
      PortSetPinModeApi = false
      PortVersionInfoApi = false
