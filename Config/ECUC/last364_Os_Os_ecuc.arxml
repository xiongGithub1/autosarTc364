AUTOSAR XML (schema 00048)
package /ActiveEcuC
  module config Os: implementation-config-variant=VARIANT-PRE-COMPILE, module-description=Os_Impl
    SystemTimer (OsCounter):
      OsCounterMaxAllowedValue = 2147483647
      OsCounterMinCycle = 1
      OsCounterType = HARDWARE
      OsSecondsPerTick = 0.001
      OsCounterTicksPerBase = 100000
      OsCounterAccessingApplication = SystemApplication_OsCore0
      OsDriver: OsDriverHighResolution=false, OsDriverHardwareTimerChannelRef=STM0_Ch0, OsDriverIsrRef=CounterIsr_SystemTimer
    OsMemoryProtection
    OsOS:
      OsStackMonitoring = true
      OsStatus = EXTENDED
      OsUseArti = false
      OsUseGetServiceId = false
      OsUseParameterAccess = false
      OsUseResScheduler = false
      OsForcibleTermination = false
      OsGenerateCalloutStubs = true
      OsGenerateMemMap = COMPLETE
      OsGenerateMemMapForNearAddressing = true
      OsGenerateMemMapForThreads = false
      OsServiceProtection = false
      OsStackUsageMeasurement = false
      OsUseXSignalAsyncApiCalls = false
      OsFpuUsage = NONE
      OsUseCase = STANDARD
      OsScalabilityClass = SC1
      OsNumberOfCores = 1
      OsMasterCore = OsCore0
      OsSystemTimer = SystemTimer
      OsHooks: OsErrorHook=true, OsPostTaskHook=false, OsPreTaskHook=false, OsShutdownHook=true, OsStartupHook=true, OsPanicHook=true
      OsStackSummary
        13 x OsStack, all with OsStackCore=OsCore0:
          OsCore0_Kernel: OsStackSize=1024, OsStackType=CORE_KERNEL_STACK, OsStackUser=OsCore0
          OsCore0_Init: OsStackSize=1024, OsStackType=CORE_INIT_STACK, OsStackUser=OsCore0
          OsCore0_Error: OsStackSize=1024, OsStackType=CORE_ERROR_STACK, OsStackUser=OsCore0
          OsCore0_Isr_Core: OsStackSize=2048, OsStackType=ISR_SHARED_CORE_STACK, OsStackUser=CounterIsr_SystemTimer, OsStackUser=AdcIsr_G0, OsStackUser=AdcIsr_G8, OsStackUser=CanIsr_0, OsStackUser=Qspi2PtIsr, OsStackUser=Qspi2ErrIsr, OsStackUser=DmaErrIsr, OsStackUser=DMACH4SR_ISR, OsStackUser=DMACH5SR_ISR
          OsCore0_Task_Prio4294967295: OsStackSize=1024, OsStackType=TASK_SHARED_PRIORITY_STACK, OsStackUser=IdleTask_OsCore0
          OsCore0_Task_Prio50: OsStackSize=1024, OsStackType=TASK_SHARED_PRIORITY_STACK, OsStackUser=Default_Init_Task
          OsCore0_Task_Prio49: OsStackSize=1024, OsStackType=TASK_SHARED_PRIORITY_STACK, OsStackUser=Default_Init_Task_Trusted
          OsCore0_Task_Prio45: OsStackSize=1024, OsStackType=TASK_SHARED_PRIORITY_STACK, OsStackUser=Default_Appl_Init_Task
          Default_Appl_Task: OsStackSize=4096, OsStackType=TASK_EXTENDED_STACK, OsStackUser=Os/Default_Appl_Task
          Default_BSW_ASync_Task: OsStackSize=4096, OsStackType=TASK_EXTENDED_STACK, OsStackUser=Os/Default_BSW_ASync_Task
          MotorTask: OsStackSize=1024, OsStackType=TASK_EXTENDED_STACK, OsStackUser=Os/MotorTask
          OsCore0_Startup: OsStackSize=1024, OsStackType=CORE_STARTUP_STACK, OsStackUser=OsCore0
          OsCore0_Shutdown: OsStackSize=1024, OsStackType=CORE_SHUTDOWN_STACK, OsStackUser=OsCore0
    OsPublishedInformation: OsKernelVersion=7, OsPlatformName=TriCoreAurix
      TC36x (OsDerivativeInformation):
        OsMpuAlignment = 8
        OsMpuMemoryGapSize = 16
        OsMpuEndAddressAccessible = false
        OsStackAlignment = 8
        OsExceptionVectorTableAlignment = 256
        OsInterruptVectorTableAlignment = 8192
        OsHardwareManuals = User Manual: TC36X_um_appx_V1.0.0.pdf 2018.08
        OsMpuPrivilegedRegionsConfigurable = false
        Core0 (OsPhysicalCore):
          OsPhysicalCoreId = 0
          OsPhysicalCoreDefaultEntrySymbol = _start_tc0
          OsPhysicalCoreType = TC1.6.2P
          OsPhysicalCoreExceptionSources = 8
          OsPhysicalCoreMasterStartAllowed = true
          OsPhysicalCorePrivelegedHwAccess = true
          OsPhysicalCoreIsAutostart = true
          OsPhysicalCoreStackProtectionUnit = OsPhysicalCore0DataMpu
          OsPhysicalCore0DataMpu (OsPhysicalCoreMpu): OsPhysicalCoreMpuId=0, OsPhysicalCoreMpuMaxRegions=18, OsPhysicalCoreMpuType=DATA
          OsPhysicalCore0CodeMpu (OsPhysicalCoreMpu): OsPhysicalCoreMpuId=1, OsPhysicalCoreMpuMaxRegions=10, OsPhysicalCoreMpuType=CODE
        Core1 (OsPhysicalCore):
          OsPhysicalCoreId = 1
          OsPhysicalCoreDefaultEntrySymbol = _start_tc1
          OsPhysicalCoreType = TC1.6.2P
          OsPhysicalCoreExceptionSources = 8
          OsPhysicalCoreMasterStartAllowed = false
          OsPhysicalCorePrivelegedHwAccess = true
          OsPhysicalCoreIsAutostart = false
          OsPhysicalCoreStackProtectionUnit = OsPhysicalCore1DataMpu
          OsPhysicalCore1DataMpu (OsPhysicalCoreMpu): OsPhysicalCoreMpuId=0, OsPhysicalCoreMpuMaxRegions=18, OsPhysicalCoreMpuType=DATA
          OsPhysicalCore1CodeMpu (OsPhysicalCoreMpu): OsPhysicalCoreMpuId=1, OsPhysicalCoreMpuMaxRegions=10, OsPhysicalCoreMpuType=CODE
        STM0 (OsHardwareTimer): OsHardwareTimerSize=32, OsHardwareTimerUnit=FRT, OsHardwareTimerBaseAddress=4026535936, OsHardwareTimerId=0, OsHardwareTimerType=STM
          STM0_Ch0 (OsHardwareTimerChannel): OsHardwareTimerChannelIntSource=768, OsHardwareTimerChannelOffset=0, OsHardwareTimerChannelId=0
          STM0_Ch1 (OsHardwareTimerChannel): OsHardwareTimerChannelIntSource=772, OsHardwareTimerChannelOffset=1, OsHardwareTimerChannelId=1
        STM1 (OsHardwareTimer): OsHardwareTimerSize=32, OsHardwareTimerUnit=FRT, OsHardwareTimerBaseAddress=4026536192, OsHardwareTimerId=1, OsHardwareTimerType=STM
          STM1_Ch0 (OsHardwareTimerChannel): OsHardwareTimerChannelIntSource=776, OsHardwareTimerChannelOffset=0, OsHardwareTimerChannelId=0
          STM1_Ch1 (OsHardwareTimerChannel): OsHardwareTimerChannelIntSource=780, OsHardwareTimerChannelOffset=1, OsHardwareTimerChannelId=1
        AURIXTC3XX_IR (OsSystemIntCtrl): OsSystemIntCtrlMaxPrios=255, OsSystemIntCtrlPrioOrder=ASC, OsSystemIntCtrlMaxSources=8192, OsSystemIntCtrlBaseAddress=4026757120
        GPT (OsHardwareTimer): OsHardwareTimerSize=16, OsHardwareTimerUnit=PIT, OsHardwareTimerBaseAddress=4026537984, OsHardwareTimerId=0, OsHardwareTimerType=PIT
          GPT_Ch0 (OsHardwareTimerChannel): OsHardwareTimerChannelIntSource=744, OsHardwareTimerChannelOffset=0, OsHardwareTimerChannelId=0
          GPT_Ch1 (OsHardwareTimerChannel): OsHardwareTimerChannelIntSource=756, OsHardwareTimerChannelOffset=1, OsHardwareTimerChannelId=1
        OsMemoryRegionSpecifics
          18 x OsMemoryRegionAccess:
            PS0_R: OsMemoryRegionAccessRights=R, OsMemoryRegionAccessType=PROTECTION_SET0
            PS0_W: OsMemoryRegionAccessRights=W, OsMemoryRegionAccessType=PROTECTION_SET0
            PS0_X: OsMemoryRegionAccessRights=X, OsMemoryRegionAccessType=PROTECTION_SET0
            PS1_R: OsMemoryRegionAccessRights=R, OsMemoryRegionAccessType=PROTECTION_SET1
            PS1_W: OsMemoryRegionAccessRights=W, OsMemoryRegionAccessType=PROTECTION_SET1
            PS1_X: OsMemoryRegionAccessRights=X, OsMemoryRegionAccessType=PROTECTION_SET1
            PS2_R: OsMemoryRegionAccessRights=R, OsMemoryRegionAccessType=PROTECTION_SET2
            PS2_W: OsMemoryRegionAccessRights=W, OsMemoryRegionAccessType=PROTECTION_SET2
            PS2_X: OsMemoryRegionAccessRights=X, OsMemoryRegionAccessType=PROTECTION_SET2
            PS3_R: OsMemoryRegionAccessRights=R, OsMemoryRegionAccessType=PROTECTION_SET3
            PS3_W: OsMemoryRegionAccessRights=W, OsMemoryRegionAccessType=PROTECTION_SET3
            PS3_X: OsMemoryRegionAccessRights=X, OsMemoryRegionAccessType=PROTECTION_SET3
            PS4_R: OsMemoryRegionAccessRights=R, OsMemoryRegionAccessType=PROTECTION_SET4
            PS4_W: OsMemoryRegionAccessRights=W, OsMemoryRegionAccessType=PROTECTION_SET4
            PS4_X: OsMemoryRegionAccessRights=X, OsMemoryRegionAccessType=PROTECTION_SET4
            PS5_R: OsMemoryRegionAccessRights=R, OsMemoryRegionAccessType=PROTECTION_SET5
            PS5_W: OsMemoryRegionAccessRights=W, OsMemoryRegionAccessType=PROTECTION_SET5
            PS5_X: OsMemoryRegionAccessRights=X, OsMemoryRegionAccessType=PROTECTION_SET5
        DMA (OsInterruptSupportedType):
          OsInterruptSupportedTypeSeparateSources = false
          OsInterruptSupportedTypeSeparatePriority = true
          OsInterruptSupportedTypeIsMapped = false
          OsInterruptSupportedTypePostActionRequired = false
    OSDEFAULTAPPMODE (OsAppMode)
    OS_APPMODE_ANY (OsAppMode)
    OsCore0 (OsCore):
      OsCoreIsAutostart = true
      OsCoreIsAutosar = true
      OsCoreEntrySymbol = _start_tc0
      OsCorePhysicalCoreRef = Core0
      OsCoreIdleTask = IdleTask_OsCore0
      OsCoreSystemApplication = SystemApplication_OsCore0
      OsCoreEcucCoreRef = EcucCoreDefinition
      OsCoreStacks:
        OsCoreKernelStackSize = 1024
        OsCoreStartupStackSize = 1024
        OsCoreShutdownStackSize = 1024
        OsCoreErrorStackSize = 1024
        OsCoreProtectionStackSize = 1024
        OsCoreInitStackSize = 1024
    IdleTask_OsCore0 (OsTask):
      OsTaskActivation = 1
      OsTaskPriority = 4294967295
      OsTaskSchedule = FULL
      OsTaskStackSharing = false
      OsTaskStackSize = 1024
      OsTaskType = AUTO
      OsTaskUsesFpu = false
      OsTaskAccessingApplication = SystemApplication_OsCore0
      OsTaskAutostart: OsTaskAppModeRef=OS_APPMODE_ANY
    SystemApplication_OsCore0 (OsApplication):
      OsTrusted = true
      OsTrustedApplicationDelayTimingViolationCall = false
      OsTrustedApplicationWithProtection = false
      OsApplicationIsPrivileged = true
      OsAppUseTrustedFunctionStubs = false
      OsAppCounterRef = SystemTimer
      OsAppIsrRef = CounterIsr_SystemTimer
      OsAppTaskRef = IdleTask_OsCore0
      OsAppTaskRef = Default_Init_Task
      OsAppTaskRef = Default_Init_Task_Trusted
      OsAppTaskRef = Os/Default_BSW_ASync_Task
      OsAppTaskRef = Default_Appl_Init_Task
      OsAppTaskRef = Os/Default_Appl_Task
      OsAppAlarmRef = Rte_Al_TE2_Default_BSW_ASync_Task_0_10ms
      OsAppAlarmRef = Rte_Al_TE_Default_Appl_Task_0_10ms
      OsAppAlarmRef = Rte_Al_TE_StartApp_StartApp_Cyclic1000ms
      OsAppAlarmRef = Rte_Al_TE_Default_Appl_Task_0_1ms
      OsAppAlarmRef = Rte_Al_TE_StartApp_StartApp_Cyclic250ms
      OsApplicationCoreRef = EcucCoreDefinition
      OsAppAlarmRef = Rte_Al_TE2_Default_BSW_ASync_Task_0_20ms
      OsAppIsrRef = AdcIsr_G0
      OsAppIsrRef = AdcIsr_G8
      OsAppIsrRef = CanIsr_0
      OsAppTaskRef = Os/MotorTask
      OsAppAlarmRef = Rte_Al_TE_Com_Com_MainFunctionTx_ComMainFunctionTx
      OsAppIsrRef = Qspi2PtIsr
      OsAppIsrRef = Qspi2ErrIsr
      OsAppIsrRef = DmaErrIsr
      OsAppIsrRef = DMACH4SR_ISR
      OsAppIsrRef = DMACH5SR_ISR
      OsApplicationHooks: OsAppErrorHook=false, OsAppShutdownHook=false, OsAppStartupHook=false
    CounterIsr_SystemTimer (OsIsr):
      OsIsrInterruptPriority = 80
      OsIsrCategory = CATEGORY_2
      OsIsrInterruptType = EXTERNAL
      OsIsrInterruptSource = 768
      OsIsrStackSize = 1024
      OsIsrEnableNesting = false
      OsIsrUsesFpu = false
      OsIsrInitialEnableInterruptSource = false
      OsIsrSpecialFunctionName = Os_TimerPfrtIsr
    3 x OsTask, all with OsTaskActivation=1, OsTaskSchedule=NON, OsTaskStackSharing=false, OsTaskUsesFpu=false, OsTaskAccessingApplication=SystemApplication_OsCore0:
      Default_Init_Task: OsTaskPriority=50, OsTaskStackSize=1024, OsTaskType=BASIC
        OsTaskAutostart: OsTaskAppModeRef=OSDEFAULTAPPMODE
      Default_Init_Task_Trusted: OsTaskPriority=49, OsTaskStackSize=1024, OsTaskType=BASIC
        OsTaskAutostart: OsTaskAppModeRef=OSDEFAULTAPPMODE
      Default_BSW_ASync_Task: OsTaskPriority=30, OsTaskStackSize=4096, OsTaskType=AUTO, OsTaskResourceRef=OsResource_EcuM, OsTaskEventRef=Rte_Ev_Cyclic2_Default_BSW_ASync_Task_0_10ms, OsTaskEventRef=Rte_Ev_Cyclic2_Default_BSW_ASync_Task_0_20ms, OsTaskEventRef=Rte_Ev_Run_Com_Com_MainFunctionTx_ComMainFunctionTx
    OsResource_EcuM (OsResource): OsResourceProperty=STANDARD, OsResourceAccessingApplication=SystemApplication_OsCore0
    Default_Appl_Init_Task (OsTask):
      OsTaskActivation = 1
      OsTaskPriority = 45
      OsTaskSchedule = NON
      OsTaskStackSharing = false
      OsTaskStackSize = 1024
      OsTaskType = AUTO
      OsTaskUsesFpu = false
      OsTaskAccessingApplication = SystemApplication_OsCore0
    Default_Appl_Task (OsTask):
      OsTaskActivation = 1
      OsTaskPriority = 5
      OsTaskSchedule = NON
      OsTaskStackSharing = false
      OsTaskStackSize = 4096
      OsTaskType = AUTO
      OsTaskUsesFpu = false
      OsTaskAccessingApplication = SystemApplication_OsCore0
      OsTaskEventRef = Rte_Ev_Run_StartApp_StartApp_Cyclic1000ms
      OsTaskEventRef = Rte_Ev_Run_StartApp_StartApp_Cyclic250ms
      OsTaskEventRef = Rte_Ev_Cyclic_Default_Appl_Task_0_10ms
      OsTaskEventRef = Rte_Ev_Cyclic_Default_Appl_Task_0_1ms
    3 x OsAlarm, all with OsAlarmCounterRef=SystemTimer, OsAlarmAccessingApplication=SystemApplication_OsCore0:
      Rte_Al_TE2_Default_BSW_ASync_Task_0_10ms
        OsAlarmAction
          OsAlarmSetEvent: OsAlarmSetEventRef=Rte_Ev_Cyclic2_Default_BSW_ASync_Task_0_10ms, OsAlarmSetEventTaskRef=Os/Default_BSW_ASync_Task
      Rte_Al_TE_StartApp_StartApp_Cyclic1000ms
        OsAlarmAction
          OsAlarmSetEvent: OsAlarmSetEventRef=Rte_Ev_Run_StartApp_StartApp_Cyclic1000ms, OsAlarmSetEventTaskRef=Os/Default_Appl_Task
      Rte_Al_TE_StartApp_StartApp_Cyclic250ms
        OsAlarmAction
          OsAlarmSetEvent: OsAlarmSetEventRef=Rte_Ev_Run_StartApp_StartApp_Cyclic250ms, OsAlarmSetEventTaskRef=Os/Default_Appl_Task
    Rte_Ev_Run_StartApp_StartApp_Cyclic1000ms (OsEvent)
    Rte_Ev_Run_StartApp_StartApp_Cyclic250ms (OsEvent)
    Rte_Al_TE2_Default_BSW_ASync_Task_0_20ms (OsAlarm): OsAlarmCounterRef=SystemTimer, OsAlarmAccessingApplication=SystemApplication_OsCore0
      OsAlarmAction
        OsAlarmSetEvent: OsAlarmSetEventRef=Rte_Ev_Cyclic2_Default_BSW_ASync_Task_0_20ms, OsAlarmSetEventTaskRef=Os/Default_BSW_ASync_Task
    Rte_Ev_Cyclic2_Default_BSW_ASync_Task_0_10ms (OsEvent)
    Rte_Ev_Cyclic2_Default_BSW_ASync_Task_0_20ms (OsEvent)
    3 x OsIsr, all with OsIsrCategory=CATEGORY_2, OsIsrInterruptType=EXTERNAL, OsIsrEnableNesting=false, OsIsrInitialEnableInterruptSource=true:
      AdcIsr_G0: OsIsrInterruptPriority=83, OsIsrInterruptSource=1648, OsIsrStackSize=2048, OsIsrUsesFpu=true, OsIsrSpecialFunctionName=ADC0SR0_ISR
      AdcIsr_G8: OsIsrInterruptPriority=78, OsIsrInterruptSource=1776, OsIsrStackSize=1024, OsIsrUsesFpu=false, OsIsrSpecialFunctionName=ADC8SR0_ISR
      CanIsr_0: OsIsrInterruptPriority=60, OsIsrInterruptSource=1456, OsIsrStackSize=1024, OsIsrUsesFpu=false  # /ActiveEcuC/Can PLAIN_TEXT Can messages event (for a specific controllers)
    MotorTask (OsTask):
      OsTaskActivation = 1
      OsTaskPriority = 200
      OsTaskSchedule = NON
      OsTaskStackSharing = false
      OsTaskStackSize = 1024
      OsTaskType = EXTENDED
      OsTaskUsesFpu = false
      OsTaskAccessingApplication = SystemApplication_OsCore0
      OsTaskEventRef = Rte_Ev_Run_MotorCdd_MotorCdd_AdcOnSampleReady_Rp_AdcSampleReady_AdcSampleReady
      OsTaskEventRef = Rte_Ev_Run_MotorCdd_Pp_MotorCdd_EnableInverter_EnableInverter
    Rte_Ev_Run_MotorCdd_MotorCdd_AdcOnSampleReady_Rp_AdcSampleReady_AdcSampleReady (OsEvent)
    Rte_Al_TE_Com_Com_MainFunctionTx_ComMainFunctionTx (OsAlarm): OsAlarmCounterRef=SystemTimer, OsAlarmAccessingApplication=SystemApplication_OsCore0
      OsAlarmAction
        OsAlarmSetEvent: OsAlarmSetEventRef=Rte_Ev_Run_Com_Com_MainFunctionTx_ComMainFunctionTx, OsAlarmSetEventTaskRef=Os/Default_BSW_ASync_Task
    Rte_Ev_Run_Com_Com_MainFunctionTx_ComMainFunctionTx (OsEvent)
    5 x OsIsr, all with OsIsrCategory=CATEGORY_2, OsIsrInterruptType=EXTERNAL, OsIsrStackSize=1024, OsIsrEnableNesting=false, OsIsrUsesFpu=false, OsIsrInitialEnableInterruptSource=true:
      Qspi2PtIsr: OsIsrInterruptPriority=20, OsIsrInterruptSource=292, OsIsrSpecialFunctionName=QSPI2PT_ISR
      Qspi2ErrIsr: OsIsrInterruptPriority=27, OsIsrInterruptSource=288, OsIsrSpecialFunctionName=QSPI2ERR_ISR
      DmaErrIsr: OsIsrInterruptPriority=75, OsIsrInterruptSource=832, OsIsrSpecialFunctionName=DMAERR0SR_ISR
      DMACH4SR_ISR: OsIsrInterruptPriority=85, OsIsrInterruptSource=896
      DMACH5SR_ISR: OsIsrInterruptPriority=86, OsIsrInterruptSource=900
    Rte_Al_TE_Default_Appl_Task_0_10ms (OsAlarm): OsAlarmCounterRef=SystemTimer, OsAlarmAccessingApplication=SystemApplication_OsCore0
      OsAlarmAction
        OsAlarmSetEvent: OsAlarmSetEventRef=Rte_Ev_Cyclic_Default_Appl_Task_0_10ms, OsAlarmSetEventTaskRef=Os/Default_Appl_Task
    Rte_Al_TE_Default_Appl_Task_0_1ms (OsAlarm): OsAlarmCounterRef=SystemTimer, OsAlarmAccessingApplication=SystemApplication_OsCore0
      OsAlarmAction
        OsAlarmSetEvent: OsAlarmSetEventRef=Rte_Ev_Cyclic_Default_Appl_Task_0_1ms, OsAlarmSetEventTaskRef=Os/Default_Appl_Task
    3 x OsEvent:
      Rte_Ev_Cyclic_Default_Appl_Task_0_10ms
      Rte_Ev_Cyclic_Default_Appl_Task_0_1ms
      Rte_Ev_Run_MotorCdd_Pp_MotorCdd_EnableInverter_EnableInverter
