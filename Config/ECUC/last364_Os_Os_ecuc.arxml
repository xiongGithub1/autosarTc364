AUTOSAR XML (schema 00048)
package /ActiveEcuC
  module config Os: implementation-config-variant=VARIANT-PRE-COMPILE, module-description=Os_Impl
    SystemTimer (OsCounter):
      OsCounterMaxAllowedValue = 2147483647
      OsCounterMinCycle = 1
      OsCounterType = HARDWARE
      OsSecondsPerTick = 0.001
      OsCounterTicksPerBase = 100000
      OsCounterAccessingApplication = SystemApplication_OsCore0
      OsCounterAccessingApplication = OsApplication_OsCore1
      OsDriver: OsDriverHighResolution=false, OsDriverHardwareTimerChannelRef=STM0_Ch0, OsDriverIsrRef=CounterIsr_SystemTimer
    OsMemoryProtection
    OsOS:
      OsStackMonitoring = true
      OsStatus = EXTENDED
      OsUseArti = false
      OsUseGetServiceId = false
      OsUseParameterAccess = false
      OsUseResScheduler = false
      OsForcibleTermination = false
      OsGenerateCalloutStubs = true
      OsGenerateMemMap = COMPLETE
      OsGenerateMemMapForNearAddressing = true
      OsGenerateMemMapForThreads = false
      OsServiceProtection = false
      OsStackUsageMeasurement = false
      OsUseXSignalAsyncApiCalls = false
      OsFpuUsage = NONE
      OsUseCase = STANDARD
      OsScalabilityClass = SC1
      OsNumberOfCores = 2
      OsMasterCore = OsCore0
      OsSystemTimer = SystemTimer
      OsHooks: OsErrorHook=true, OsPostTaskHook=false, OsPreTaskHook=false, OsShutdownHook=true, OsStartupHook=true, OsPanicHook=true
      OsStackSummary
        26 x OsStack:
          OsCore0_Kernel: OsStackSize=1024, OsStackType=CORE_KERNEL_STACK, OsStackCore=OsCore0, OsStackUser=OsCore0
          OsCore0_Init: OsStackSize=1024, OsStackType=CORE_INIT_STACK, OsStackCore=OsCore0, OsStackUser=OsCore0
          OsCore0_Error: OsStackSize=1024, OsStackType=CORE_ERROR_STACK, OsStackCore=OsCore0, OsStackUser=OsCore0
          OsCore0_Isr_Core: OsStackSize=1024, OsStackType=ISR_SHARED_CORE_STACK, OsStackCore=OsCore0, OsStackUser=CounterIsr_SystemTimer, OsStackUser=AdcIsr_G8, OsStackUser=CanIsr_0, OsStackUser=XSignalIsr_OsCore0, OsStackUser=Uart_ASCLIN0RX_ISR, OsStackUser=Uart_ASCLIN0TX_ISR, OsStackUser=Uart_ASCLIN0ERR_ISR
          OsCore0_Task_Prio4294967295: OsStackSize=1024, OsStackType=TASK_SHARED_PRIORITY_STACK, OsStackCore=OsCore0, OsStackUser=IdleTask_OsCore0
          OsCore0_Task_Prio50: OsStackSize=1024, OsStackType=TASK_SHARED_PRIORITY_STACK, OsStackCore=OsCore0, OsStackUser=Default_Init_Task
          OsCore0_Task_Prio49: OsStackSize=1024, OsStackType=TASK_SHARED_PRIORITY_STACK, OsStackCore=OsCore0, OsStackUser=Default_Init_Task_Trusted
          OsCore0_Task_Prio45: OsStackSize=1024, OsStackType=TASK_SHARED_PRIORITY_STACK, OsStackCore=OsCore0, OsStackUser=Default_Appl_Init_Task
          Default_Appl_Task: OsStackSize=4096, OsStackType=TASK_EXTENDED_STACK, OsStackCore=OsCore0, OsStackUser=Os/Default_Appl_Task
          Default_BSW_ASync_Task_10ms: OsStackSize=4096, OsStackType=TASK_EXTENDED_STACK, OsStackCore=OsCore0, OsStackUser=Os/Default_BSW_ASync_Task_10ms
          OsCore0_Startup: OsStackSize=1024, OsStackType=CORE_STARTUP_STACK, OsStackCore=OsCore0, OsStackUser=OsCore0
          OsCore0_Shutdown: OsStackSize=1024, OsStackType=CORE_SHUTDOWN_STACK, OsStackCore=OsCore0, OsStackUser=OsCore0
          OsCore1_Kernel: OsStackSize=1024, OsStackType=CORE_KERNEL_STACK, OsStackCore=OsCore1, OsStackUser=OsCore1
          OsCore1_Init: OsStackSize=1024, OsStackType=CORE_INIT_STACK, OsStackCore=OsCore1, OsStackUser=OsCore1
          OsCore1_Error: OsStackSize=1024, OsStackType=CORE_ERROR_STACK, OsStackCore=OsCore1, OsStackUser=OsCore1
          OsCore1_Shutdown: OsStackSize=1024, OsStackType=CORE_SHUTDOWN_STACK, OsStackCore=OsCore1, OsStackUser=OsCore1
          OsCore1_Startup: OsStackSize=1024, OsStackType=CORE_STARTUP_STACK, OsStackCore=OsCore1, OsStackUser=OsCore1
          OsCore1_Task_Prio4294967295: OsStackSize=1024, OsStackType=TASK_SHARED_PRIORITY_STACK, OsStackCore=OsCore1, OsStackUser=IdleTask_OsCore_1
          OsCore1_Isr_Core: OsStackSize=1024, OsStackType=ISR_SHARED_CORE_STACK, OsStackCore=OsCore1, OsStackUser=CounterIsr_SystemTimer1, OsStackUser=XSignalIsr_OsCore1
          OsCore1_Task_Prio0: OsStackSize=1024, OsStackType=TASK_SHARED_PRIORITY_STACK, OsStackCore=OsCore1, OsStackUser=Default_MotorInitTask
          OsCore1_Task_Prio50: OsStackSize=1024, OsStackType=TASK_SHARED_PRIORITY_STACK, OsStackCore=OsCore1, OsStackUser=Default_Init_Task_Core1
          OsCore1_Task_Prio49: OsStackSize=1024, OsStackType=TASK_SHARED_PRIORITY_STACK, OsStackCore=OsCore1, OsStackUser=Default_Init_Task_Core1_Trusted
          MotorTask: OsStackSize=4096, OsStackType=TASK_EXTENDED_STACK, OsStackCore=OsCore1, OsStackUser=Os/MotorTask
          OsCore1_Task_Prio20: OsStackSize=1024, OsStackType=TASK_SHARED_PRIORITY_STACK, OsStackCore=OsCore1, OsStackUser=BswCore1Task
          OsCore0_Task_Prio2: OsStackSize=1024, OsStackType=TASK_SHARED_PRIORITY_STACK, OsStackCore=OsCore0, OsStackUser=BrsMainBackgroundTask
          BrsMainTask: OsStackSize=1024, OsStackType=TASK_EXTENDED_STACK, OsStackCore=OsCore0, OsStackUser=Os/BrsMainTask
    OsPublishedInformation: OsKernelVersion=7, OsPlatformName=TriCoreAurix
      TC36x (OsDerivativeInformation):
        OsMpuAlignment = 8
        OsMpuMemoryGapSize = 16
        OsMpuEndAddressAccessible = false
        OsStackAlignment = 8
        OsExceptionVectorTableAlignment = 256
        OsInterruptVectorTableAlignment = 8192
        OsHardwareManuals = User Manual: TC36X_um_appx_V1.0.0.pdf 2018.08
        OsMpuPrivilegedRegionsConfigurable = false
        Core0 (OsPhysicalCore):
          OsPhysicalCoreId = 0
          OsPhysicalCoreDefaultEntrySymbol = _start_tc0
          OsPhysicalCoreType = TC1.6.2P
          OsPhysicalCoreExceptionSources = 8
          OsPhysicalCoreMasterStartAllowed = true
          OsPhysicalCorePrivelegedHwAccess = true
          OsPhysicalCoreIsAutostart = true
          OsPhysicalCoreStackProtectionUnit = OsPhysicalCore0DataMpu
          OsPhysicalCore0DataMpu (OsPhysicalCoreMpu): OsPhysicalCoreMpuId=0, OsPhysicalCoreMpuMaxRegions=18, OsPhysicalCoreMpuType=DATA
          OsPhysicalCore0CodeMpu (OsPhysicalCoreMpu): OsPhysicalCoreMpuId=1, OsPhysicalCoreMpuMaxRegions=10, OsPhysicalCoreMpuType=CODE
        Core1 (OsPhysicalCore):
          OsPhysicalCoreId = 1
          OsPhysicalCoreDefaultEntrySymbol = _start_tc1
          OsPhysicalCoreType = TC1.6.2P
          OsPhysicalCoreExceptionSources = 8
          OsPhysicalCoreMasterStartAllowed = false
          OsPhysicalCorePrivelegedHwAccess = true
          OsPhysicalCoreIsAutostart = false
          OsPhysicalCoreStackProtectionUnit = OsPhysicalCore1DataMpu
          OsPhysicalCore1DataMpu (OsPhysicalCoreMpu): OsPhysicalCoreMpuId=0, OsPhysicalCoreMpuMaxRegions=18, OsPhysicalCoreMpuType=DATA
          OsPhysicalCore1CodeMpu (OsPhysicalCoreMpu): OsPhysicalCoreMpuId=1, OsPhysicalCoreMpuMaxRegions=10, OsPhysicalCoreMpuType=CODE
        STM0 (OsHardwareTimer): OsHardwareTimerSize=32, OsHardwareTimerUnit=FRT, OsHardwareTimerBaseAddress=4026535936, OsHardwareTimerId=0, OsHardwareTimerType=STM
          STM0_Ch0 (OsHardwareTimerChannel): OsHardwareTimerChannelIntSource=768, OsHardwareTimerChannelOffset=0, OsHardwareTimerChannelId=0
          STM0_Ch1 (OsHardwareTimerChannel): OsHardwareTimerChannelIntSource=772, OsHardwareTimerChannelOffset=1, OsHardwareTimerChannelId=1
        STM1 (OsHardwareTimer): OsHardwareTimerSize=32, OsHardwareTimerUnit=FRT, OsHardwareTimerBaseAddress=4026536192, OsHardwareTimerId=1, OsHardwareTimerType=STM
          STM1_Ch0 (OsHardwareTimerChannel): OsHardwareTimerChannelIntSource=776, OsHardwareTimerChannelOffset=0, OsHardwareTimerChannelId=0
          STM1_Ch1 (OsHardwareTimerChannel): OsHardwareTimerChannelIntSource=780, OsHardwareTimerChannelOffset=1, OsHardwareTimerChannelId=1
        AURIXTC3XX_IR (OsSystemIntCtrl): OsSystemIntCtrlMaxPrios=255, OsSystemIntCtrlPrioOrder=ASC, OsSystemIntCtrlMaxSources=8192, OsSystemIntCtrlBaseAddress=4026757120
        GPT (OsHardwareTimer): OsHardwareTimerSize=16, OsHardwareTimerUnit=PIT, OsHardwareTimerBaseAddress=4026537984, OsHardwareTimerId=0, OsHardwareTimerType=PIT
          GPT_Ch0 (OsHardwareTimerChannel): OsHardwareTimerChannelIntSource=744, OsHardwareTimerChannelOffset=0, OsHardwareTimerChannelId=0
          GPT_Ch1 (OsHardwareTimerChannel): OsHardwareTimerChannelIntSource=756, OsHardwareTimerChannelOffset=1, OsHardwareTimerChannelId=1
        OsMemoryRegionSpecifics
          18 x OsMemoryRegionAccess:
            PS0_R: OsMemoryRegionAccessRights=R, OsMemoryRegionAccessType=PROTECTION_SET0
            PS0_W: OsMemoryRegionAccessRights=W, OsMemoryRegionAccessType=PROTECTION_SET0
            PS0_X: OsMemoryRegionAccessRights=X, OsMemoryRegionAccessType=PROTECTION_SET0
            PS1_R: OsMemoryRegionAccessRights=R, OsMemoryRegionAccessType=PROTECTION_SET1
            PS1_W: OsMemoryRegionAccessRights=W, OsMemoryRegionAccessType=PROTECTION_SET1
            PS1_X: OsMemoryRegionAccessRights=X, OsMemoryRegionAccessType=PROTECTION_SET1
            PS2_R: OsMemoryRegionAccessRights=R, OsMemoryRegionAccessType=PROTECTION_SET2
            PS2_W: OsMemoryRegionAccessRights=W, OsMemoryRegionAccessType=PROTECTION_SET2
            PS2_X: OsMemoryRegionAccessRights=X, OsMemoryRegionAccessType=PROTECTION_SET2
            PS3_R: OsMemoryRegionAccessRights=R, OsMemoryRegionAccessType=PROTECTION_SET3
            PS3_W: OsMemoryRegionAccessRights=W, OsMemoryRegionAccessType=PROTECTION_SET3
            PS3_X: OsMemoryRegionAccessRights=X, OsMemoryRegionAccessType=PROTECTION_SET3
            PS4_R: OsMemoryRegionAccessRights=R, OsMemoryRegionAccessType=PROTECTION_SET4
            PS4_W: OsMemoryRegionAccessRights=W, OsMemoryRegionAccessType=PROTECTION_SET4
            PS4_X: OsMemoryRegionAccessRights=X, OsMemoryRegionAccessType=PROTECTION_SET4
            PS5_R: OsMemoryRegionAccessRights=R, OsMemoryRegionAccessType=PROTECTION_SET5
            PS5_W: OsMemoryRegionAccessRights=W, OsMemoryRegionAccessType=PROTECTION_SET5
            PS5_X: OsMemoryRegionAccessRights=X, OsMemoryRegionAccessType=PROTECTION_SET5
        DMA (OsInterruptSupportedType):
          OsInterruptSupportedTypeSeparateSources = false
          OsInterruptSupportedTypeSeparatePriority = true
          OsInterruptSupportedTypeIsMapped = false
          OsInterruptSupportedTypePostActionRequired = false
    OSDEFAULTAPPMODE (OsAppMode)
    OS_APPMODE_ANY (OsAppMode)
    OsCore0 (OsCore):
      OsCoreIsAutostart = true
      OsCoreIsAutosar = true
      OsCoreEntrySymbol = _start_tc0
      OsCorePhysicalCoreRef = Core0
      OsCoreIdleTask = IdleTask_OsCore0
      OsCoreSystemApplication = SystemApplication_OsCore0
      OsCoreEcucCoreRef = EcucCoreDefinition
      OsCoreStacks:
        OsCoreKernelStackSize = 1024
        OsCoreStartupStackSize = 1024
        OsCoreShutdownStackSize = 1024
        OsCoreErrorStackSize = 1024
        OsCoreProtectionStackSize = 1024
        OsCoreInitStackSize = 1024
      XSignalChl_OsCore1 (OsCoreXSignalChannel): OsCoreXSignalChannelSize=1, OsCoreXSignalChannelReceiverIsr=XSignalIsr_OsCore1
    IdleTask_OsCore0 (OsTask):
      OsTaskActivation = 1
      OsTaskPriority = 4294967295
      OsTaskSchedule = FULL
      OsTaskStackSharing = false
      OsTaskStackSize = 1024
      OsTaskType = AUTO
      OsTaskUsesFpu = false
      OsTaskAccessingApplication = SystemApplication_OsCore0
      OsTaskAccessingApplication = OsApplication_OsCore1
      OsTaskAutostart: OsTaskAppModeRef=OS_APPMODE_ANY
    SystemApplication_OsCore0 (OsApplication):
      OsTrusted = true
      OsTrustedApplicationDelayTimingViolationCall = false
      OsTrustedApplicationWithProtection = false
      OsApplicationIsPrivileged = true
      OsAppUseTrustedFunctionStubs = false
      OsAppCounterRef = SystemTimer
      OsAppIsrRef = CounterIsr_SystemTimer
      OsAppTaskRef = IdleTask_OsCore0
      OsAppTaskRef = Default_Init_Task
      OsAppTaskRef = Default_Init_Task_Trusted
      OsAppTaskRef = Os/Default_BSW_ASync_Task_10ms
      OsAppTaskRef = Default_Appl_Init_Task
      OsAppTaskRef = Os/Default_Appl_Task
      OsAppAlarmRef = Rte_Al_TE_StartApp_StartApp_Cyclic1000ms
      OsAppAlarmRef = Rte_Al_TE_StartApp_StartApp_Cyclic250ms
      OsApplicationCoreRef = EcucCoreDefinition
      OsAppIsrRef = AdcIsr_G8
      OsAppIsrRef = CanIsr_0
      OsAppAlarmRef = Rte_Al_TE_StartApp_StartApp_Cyclic10ms
      OsAppAlarmRef = Rte_Al_TE_StartApp_StartApp_Cyclic1ms
      OsAppAlarmRef = Rte_Al_TE2_Default_BSW_ASync_Task_10ms_0_10ms
      OsAppAlarmRef = Rte_Al_TE2_Default_BSW_ASync_Task_10ms_0_20ms
      OsAppEcucPartitionRef = EcucPartition_core0
      OsAppIsrRef = XSignalIsr_OsCore0
      OsAppAlarmRef = Rte_Al_TE2_Default_BSW_ASync_Task_10ms_0_5ms
      OsAppIsrRef = Uart_ASCLIN0RX_ISR
      OsAppIsrRef = Uart_ASCLIN0TX_ISR
      OsAppIsrRef = Uart_ASCLIN0ERR_ISR
      OsAppTaskRef = BrsMainBackgroundTask
      OsAppTaskRef = Os/BrsMainTask
      OsAppAlarmRef = BrsCyclicAlarm_1ms
      OsApplicationHooks: OsAppErrorHook=false, OsAppShutdownHook=false, OsAppStartupHook=false
    CounterIsr_SystemTimer (OsIsr):
      OsIsrInterruptPriority = 80
      OsIsrCategory = CATEGORY_2
      OsIsrInterruptType = EXTERNAL
      OsIsrInterruptSource = 768
      OsIsrStackSize = 1024
      OsIsrEnableNesting = false
      OsIsrUsesFpu = false
      OsIsrInitialEnableInterruptSource = false
      OsIsrSpecialFunctionName = Os_TimerPfrtIsr
    3 x OsTask, all with OsTaskActivation=1, OsTaskStackSharing=false, OsTaskUsesFpu=false, OsTaskAccessingApplication=SystemApplication_OsCore0, OsTaskAccessingApplication=OsApplication_OsCore1:
      Default_Init_Task: OsTaskPriority=50, OsTaskSchedule=FULL, OsTaskStackSize=1024, OsTaskType=BASIC
        OsTaskAutostart: OsTaskAppModeRef=OSDEFAULTAPPMODE
      Default_Init_Task_Trusted: OsTaskPriority=49, OsTaskSchedule=NON, OsTaskStackSize=1024, OsTaskType=BASIC
        OsTaskAutostart: OsTaskAppModeRef=OSDEFAULTAPPMODE
      Default_BSW_ASync_Task_10ms: OsTaskPriority=30, OsTaskSchedule=NON, OsTaskStackSize=4096, OsTaskType=AUTO, OsTaskResourceRef=OsResource_EcuM, OsTaskEventRef=Rte_Ev_Cyclic2_Default_BSW_ASync_Task_10ms_0_10ms, OsTaskEventRef=Rte_Ev_Cyclic2_Default_BSW_ASync_Task_10ms_0_20ms, OsTaskEventRef=Rte_Ev_Cyclic2_Default_BSW_ASync_Task_10ms_0_5ms
    OsResource_EcuM (OsResource): OsResourceProperty=STANDARD, OsResourceAccessingApplication=SystemApplication_OsCore0
    Default_Appl_Init_Task (OsTask):
      OsTaskActivation = 1
      OsTaskPriority = 45
      OsTaskSchedule = NON
      OsTaskStackSharing = false
      OsTaskStackSize = 1024
      OsTaskType = AUTO
      OsTaskUsesFpu = false
      OsTaskAccessingApplication = SystemApplication_OsCore0
      OsTaskAccessingApplication = OsApplication_OsCore1
    Default_Appl_Task (OsTask):
      OsTaskActivation = 1
      OsTaskPriority = 5
      OsTaskSchedule = NON
      OsTaskStackSharing = false
      OsTaskStackSize = 4096
      OsTaskType = AUTO
      OsTaskUsesFpu = false
      OsTaskAccessingApplication = SystemApplication_OsCore0
      OsTaskEventRef = Rte_Ev_Run_StartApp_StartApp_Cyclic1000ms
      OsTaskEventRef = Rte_Ev_Run_StartApp_StartApp_Cyclic250ms
      OsTaskEventRef = Rte_Ev_Run_StartApp_StartApp_Cyclic10ms
      OsTaskEventRef = Rte_Ev_Run_StartApp_StartApp_Cyclic1ms
      OsTaskAccessingApplication = OsApplication_OsCore1
      OsTaskEventRef = Rte_Ev_Run_DigApp_DcmEcuReset_ModeSwitch
    Rte_Al_TE_StartApp_StartApp_Cyclic1000ms (OsAlarm): OsAlarmCounterRef=SystemTimer, OsAlarmAccessingApplication=SystemApplication_OsCore0, OsAlarmAccessingApplication=OsApplication_OsCore1
      OsAlarmAction
        OsAlarmSetEvent: OsAlarmSetEventRef=Rte_Ev_Run_StartApp_StartApp_Cyclic1000ms, OsAlarmSetEventTaskRef=Os/Default_Appl_Task
    Rte_Al_TE_StartApp_StartApp_Cyclic250ms (OsAlarm): OsAlarmCounterRef=SystemTimer, OsAlarmAccessingApplication=SystemApplication_OsCore0, OsAlarmAccessingApplication=OsApplication_OsCore1
      OsAlarmAction
        OsAlarmSetEvent: OsAlarmSetEventRef=Rte_Ev_Run_StartApp_StartApp_Cyclic250ms, OsAlarmSetEventTaskRef=Os/Default_Appl_Task
    Rte_Ev_Run_StartApp_StartApp_Cyclic1000ms (OsEvent)
    Rte_Ev_Run_StartApp_StartApp_Cyclic250ms (OsEvent)
    AdcIsr_G8 (OsIsr):
      OsIsrInterruptPriority = 78
      OsIsrCategory = CATEGORY_2
      OsIsrInterruptType = EXTERNAL
      OsIsrInterruptSource = 1776
      OsIsrStackSize = 1024
      OsIsrEnableNesting = false
      OsIsrUsesFpu = false
      OsIsrInitialEnableInterruptSource = true
      OsIsrSpecialFunctionName = ADC8SR0_ISR
    CanIsr_0 (OsIsr):  # /ActiveEcuC/Can PLAIN_TEXT Can messages event (for a specific controllers)
      OsIsrInterruptPriority = 60
      OsIsrCategory = CATEGORY_2
      OsIsrInterruptType = EXTERNAL
      OsIsrInterruptSource = 1456
      OsIsrStackSize = 1024
      OsIsrEnableNesting = false
      OsIsrUsesFpu = false
      OsIsrInitialEnableInterruptSource = true
    Rte_Al_TE_StartApp_StartApp_Cyclic10ms (OsAlarm): OsAlarmCounterRef=SystemTimer, OsAlarmAccessingApplication=SystemApplication_OsCore0, OsAlarmAccessingApplication=OsApplication_OsCore1
      OsAlarmAction
        OsAlarmSetEvent: OsAlarmSetEventRef=Rte_Ev_Run_StartApp_StartApp_Cyclic10ms, OsAlarmSetEventTaskRef=Os/Default_Appl_Task
    Rte_Ev_Run_StartApp_StartApp_Cyclic10ms (OsEvent)
    Rte_Al_TE_StartApp_StartApp_Cyclic1ms (OsAlarm): OsAlarmCounterRef=SystemTimer, OsAlarmAccessingApplication=SystemApplication_OsCore0, OsAlarmAccessingApplication=OsApplication_OsCore1
      OsAlarmAction
        OsAlarmSetEvent: OsAlarmSetEventRef=Rte_Ev_Run_StartApp_StartApp_Cyclic1ms, OsAlarmSetEventTaskRef=Os/Default_Appl_Task
    Rte_Ev_Run_StartApp_StartApp_Cyclic1ms (OsEvent)
    OsApplication_OsCore1 (OsApplication):
      OsTrusted = true
      OsTrustedApplicationDelayTimingViolationCall = false
      OsTrustedApplicationWithProtection = false
      OsApplicationIsPrivileged = true
      OsAppUseTrustedFunctionStubs = false
      OsApplicationCoreRef = EcucCoreDefinition_1
      OsAppTaskRef = IdleTask_OsCore_1
      OsAppCounterRef = SystemTimer1
      OsAppIsrRef = CounterIsr_SystemTimer1
      OsAppTaskRef = Default_MotorInitTask
      OsAppEcucPartitionRef = EcucPartition_core1
      OsAppIsrRef = AdcIsr_G0
      OsAppTaskRef = Default_Init_Task_Core1
      OsAppTaskRef = Default_Init_Task_Core1_Trusted
      OsAppTaskRef = BswCore1Task
      OsAppAlarmRef = Rte_Al_TE2_EcuM_EcuM_MainFunction
      OsAppTaskRef = Os/MotorTask
      OsAppAlarmRef = Rte_Al_TE_MotorTask_0_1ms
      OsAppIsrRef = XSignalIsr_OsCore1
      OsApplicationHooks: OsAppErrorHook=false, OsAppShutdownHook=false, OsAppStartupHook=false
    OsCore1 (OsCore):
      OsCoreIsAutostart = false
      OsCoreIsAutosar = true
      OsCoreEntrySymbol = brsStartupEntry
      OsCorePhysicalCoreRef = Core1
      OsCoreEcucCoreRef = EcucCoreDefinition_1
      OsCoreSystemApplication = OsApplication_OsCore1
      OsCoreIdleTask = IdleTask_OsCore_1
      OsCoreStacks:
        OsCoreKernelStackSize = 1024
        OsCoreStartupStackSize = 1024
        OsCoreShutdownStackSize = 1024
        OsCoreErrorStackSize = 1024
        OsCoreProtectionStackSize = 1024
        OsCoreInitStackSize = 1024
      XSignalChl_OsCore0 (OsCoreXSignalChannel): OsCoreXSignalChannelSize=1, OsCoreXSignalChannelReceiverIsr=XSignalIsr_OsCore0
    Rte_Al_TE2_Default_BSW_ASync_Task_10ms_0_10ms (OsAlarm): OsAlarmCounterRef=SystemTimer, OsAlarmAccessingApplication=SystemApplication_OsCore0, OsAlarmAccessingApplication=OsApplication_OsCore1
      OsAlarmAction
        OsAlarmSetEvent: OsAlarmSetEventRef=Rte_Ev_Cyclic2_Default_BSW_ASync_Task_10ms_0_10ms, OsAlarmSetEventTaskRef=Os/Default_BSW_ASync_Task_10ms
    Rte_Al_TE2_Default_BSW_ASync_Task_10ms_0_20ms (OsAlarm): OsAlarmCounterRef=SystemTimer, OsAlarmAccessingApplication=SystemApplication_OsCore0, OsAlarmAccessingApplication=OsApplication_OsCore1
      OsAlarmAction
        OsAlarmSetEvent: OsAlarmSetEventRef=Rte_Ev_Cyclic2_Default_BSW_ASync_Task_10ms_0_20ms, OsAlarmSetEventTaskRef=Os/Default_BSW_ASync_Task_10ms
    Rte_Ev_Cyclic2_Default_BSW_ASync_Task_10ms_0_10ms (OsEvent)
    Rte_Ev_Cyclic2_Default_BSW_ASync_Task_10ms_0_20ms (OsEvent)
    IdleTask_OsCore_1 (OsTask):
      OsTaskActivation = 1
      OsTaskPriority = 4294967295
      OsTaskSchedule = FULL
      OsTaskStackSharing = false
      OsTaskStackSize = 1024
      OsTaskType = AUTO
      OsTaskUsesFpu = false
      OsTaskAccessingApplication = OsApplication_OsCore1
      OsTaskAccessingApplication = SystemApplication_OsCore0
      OsTaskAutostart: OsTaskAppModeRef=OS_APPMODE_ANY
    SystemTimer1 (OsCounter):
      OsCounterMaxAllowedValue = 2147483647
      OsCounterMinCycle = 1
      OsCounterTicksPerBase = 100000
      OsCounterType = HARDWARE
      OsSecondsPerTick = 0.001
      OsCounterAccessingApplication = OsApplication_OsCore1
      OsCounterAccessingApplication = SystemApplication_OsCore0
      OsDriver: OsDriverHighResolution=false, OsDriverHardwareTimerChannelRef=STM1_Ch0, OsDriverIsrRef=CounterIsr_SystemTimer1
    CounterIsr_SystemTimer1 (OsIsr):
      OsIsrInterruptPriority = 1
      OsIsrCategory = CATEGORY_2
      OsIsrInterruptType = EXTERNAL
      OsIsrInterruptSource = 776
      OsIsrStackSize = 1024
      OsIsrEnableNesting = false
      OsIsrUsesFpu = false
      OsIsrInitialEnableInterruptSource = false
      OsIsrSpecialFunctionName = Os_TimerPfrtIsr
    Default_MotorInitTask (OsTask):
      OsTaskActivation = 1
      OsTaskPriority = 0
      OsTaskSchedule = FULL
      OsTaskStackSharing = false
      OsTaskStackSize = 1024
      OsTaskType = AUTO
      OsTaskUsesFpu = false
      OsTaskAccessingApplication = OsApplication_OsCore1
      OsTaskAccessingApplication = SystemApplication_OsCore0
    Rte_Ev_Run_MotorCdd_AdcSampleReady_Rp_AdcSampleReady_AdcSampleReady (OsEvent)
    AdcIsr_G0 (OsIsr):
      OsIsrInterruptPriority = 83
      OsIsrCategory = CATEGORY_1
      OsIsrInterruptType = EXTERNAL
      OsIsrInterruptSource = 1648
      OsIsrStackSize = 1024
      OsIsrEnableNesting = false
      OsIsrUsesFpu = false
      OsIsrInitialEnableInterruptSource = false
      OsIsrSpecialFunctionName = ADC0SR0_ISR
    3 x OsTask, all with OsTaskActivation=1, OsTaskStackSharing=false, OsTaskStackSize=1024, OsTaskUsesFpu=false, OsTaskAccessingApplication=OsApplication_OsCore1, OsTaskAccessingApplication=SystemApplication_OsCore0:
      Default_Init_Task_Core1: OsTaskPriority=50, OsTaskSchedule=FULL, OsTaskType=BASIC
        OsTaskAutostart: OsTaskAppModeRef=OSDEFAULTAPPMODE
      Default_Init_Task_Core1_Trusted: OsTaskPriority=49, OsTaskSchedule=FULL, OsTaskType=BASIC
        OsTaskAutostart: OsTaskAppModeRef=OSDEFAULTAPPMODE
      BswCore1Task: OsTaskPriority=20, OsTaskSchedule=NON, OsTaskType=AUTO
    Rte_Al_TE2_EcuM_EcuM_MainFunction (OsAlarm): OsAlarmCounterRef=SystemTimer1, OsAlarmAccessingApplication=OsApplication_OsCore1, OsAlarmAccessingApplication=SystemApplication_OsCore0
      OsAlarmAction
        OsAlarmActivateTask: OsAlarmActivateTaskRef=BswCore1Task
    MotorTask (OsTask):
      OsTaskActivation = 1
      OsTaskPriority = 100
      OsTaskSchedule = FULL
      OsTaskStackSharing = false
      OsTaskStackSize = 4096
      OsTaskType = AUTO
      OsTaskUsesFpu = false
      OsTaskAccessingApplication = OsApplication_OsCore1
      OsTaskAccessingApplication = SystemApplication_OsCore0
      OsTaskEventRef = Rte_Ev_Cyclic_MotorTask_0_1ms
      OsTaskEventRef = Rte_Ev_Run_MotorCdd_AdcSampleReady_Rp_AdcSampleReady_AdcSampleReady
    Rte_Al_TE_MotorTask_0_1ms (OsAlarm): OsAlarmCounterRef=SystemTimer1, OsAlarmAccessingApplication=SystemApplication_OsCore0, OsAlarmAccessingApplication=OsApplication_OsCore1
      OsAlarmAction
        OsAlarmSetEvent: OsAlarmSetEventRef=Rte_Ev_Cyclic_MotorTask_0_1ms, OsAlarmSetEventTaskRef=Os/MotorTask
    Rte_Ev_Cyclic_MotorTask_0_1ms (OsEvent)
    XSignalIsr_OsCore1 (OsIsr):
      OsIsrInterruptPriority = 70
      OsIsrCategory = CATEGORY_2
      OsIsrInterruptType = EXTERNAL
      OsIsrStackSize = 1024
      OsIsrEnableNesting = false
      OsIsrUsesFpu = false
      OsIsrInitialEnableInterruptSource = false
      OsIsrSpecialFunctionName = Os_XSigRecvIsrHandler
      OsIsrInterruptSource = 2448
      OsIsrXSignalReceiver:
        OsIsrXSignalReceiverProvidedApis = ShutdownAllCores
        OsIsrXSignalReceiverProvidedApis = ActivateTask
        OsIsrXSignalReceiverProvidedApis = CancelAlarm
        OsIsrXSignalReceiverProvidedApis = ChainTask
        OsIsrXSignalReceiverProvidedApis = ControlIdle
        OsIsrXSignalReceiverProvidedApis = GetAlarm
        OsIsrXSignalReceiverProvidedApis = GetApplicationState
        OsIsrXSignalReceiverProvidedApis = GetCounterValue
        OsIsrXSignalReceiverProvidedApis = GetElapsedValue
        OsIsrXSignalReceiverProvidedApis = GetErrorHookStackUsage
        OsIsrXSignalReceiverProvidedApis = GetEvent
        OsIsrXSignalReceiverProvidedApis = GetISRStackUsage
        OsIsrXSignalReceiverProvidedApis = GetKernelStackUsage
        OsIsrXSignalReceiverProvidedApis = GetNonTrustedFunctionStackUsage
        OsIsrXSignalReceiverProvidedApis = GetProtectionHookStackUsage
        OsIsrXSignalReceiverProvidedApis = GetScheduleTableStatus
        OsIsrXSignalReceiverProvidedApis = GetShutdownHookStackUsage
        OsIsrXSignalReceiverProvidedApis = GetStartupHookStackUsage
        OsIsrXSignalReceiverProvidedApis = GetTaskStackUsage
        OsIsrXSignalReceiverProvidedApis = GetTaskState
        OsIsrXSignalReceiverProvidedApis = HookCallCallback
        OsIsrXSignalReceiverProvidedApis = NextScheduleTable
        OsIsrXSignalReceiverProvidedApis = SetAbsAlarm
        OsIsrXSignalReceiverProvidedApis = SetEvent
        OsIsrXSignalReceiverProvidedApis = SetRelAlarm
        OsIsrXSignalReceiverProvidedApis = StartScheduleTableAbs
        OsIsrXSignalReceiverProvidedApis = StartScheduleTableRel
        OsIsrXSignalReceiverProvidedApis = StopScheduleTable
        OsIsrXSignalReceiverProvidedApis = TerminateApplication
    XSignalIsr_OsCore0 (OsIsr):
      OsIsrInterruptPriority = 70
      OsIsrCategory = CATEGORY_2
      OsIsrInterruptType = EXTERNAL
      OsIsrInterruptSource = 2480
      OsIsrStackSize = 1024
      OsIsrEnableNesting = false
      OsIsrUsesFpu = false
      OsIsrInitialEnableInterruptSource = false
      OsIsrSpecialFunctionName = Os_XSigRecvIsrHandler
      OsIsrXSignalReceiver:
        OsIsrXSignalReceiverProvidedApis = ShutdownAllCores
        OsIsrXSignalReceiverProvidedApis = ActivateTask
        OsIsrXSignalReceiverProvidedApis = CancelAlarm
        OsIsrXSignalReceiverProvidedApis = ChainTask
        OsIsrXSignalReceiverProvidedApis = ControlIdle
        OsIsrXSignalReceiverProvidedApis = GetAlarm
        OsIsrXSignalReceiverProvidedApis = GetApplicationState
        OsIsrXSignalReceiverProvidedApis = GetCounterValue
        OsIsrXSignalReceiverProvidedApis = GetElapsedValue
        OsIsrXSignalReceiverProvidedApis = GetErrorHookStackUsage
        OsIsrXSignalReceiverProvidedApis = GetEvent
        OsIsrXSignalReceiverProvidedApis = GetISRStackUsage
        OsIsrXSignalReceiverProvidedApis = GetKernelStackUsage
        OsIsrXSignalReceiverProvidedApis = GetNonTrustedFunctionStackUsage
        OsIsrXSignalReceiverProvidedApis = GetProtectionHookStackUsage
        OsIsrXSignalReceiverProvidedApis = GetScheduleTableStatus
        OsIsrXSignalReceiverProvidedApis = GetShutdownHookStackUsage
        OsIsrXSignalReceiverProvidedApis = GetStartupHookStackUsage
        OsIsrXSignalReceiverProvidedApis = GetTaskStackUsage
        OsIsrXSignalReceiverProvidedApis = GetTaskState
        OsIsrXSignalReceiverProvidedApis = HookCallCallback
        OsIsrXSignalReceiverProvidedApis = NextScheduleTable
        OsIsrXSignalReceiverProvidedApis = SetAbsAlarm
        OsIsrXSignalReceiverProvidedApis = SetEvent
        OsIsrXSignalReceiverProvidedApis = SetRelAlarm
        OsIsrXSignalReceiverProvidedApis = StartScheduleTableAbs
        OsIsrXSignalReceiverProvidedApis = StartScheduleTableRel
        OsIsrXSignalReceiverProvidedApis = StopScheduleTable
        OsIsrXSignalReceiverProvidedApis = TerminateApplication
    Rte_Al_TE2_Default_BSW_ASync_Task_10ms_0_5ms (OsAlarm): OsAlarmCounterRef=SystemTimer, OsAlarmAccessingApplication=OsApplication_OsCore1, OsAlarmAccessingApplication=SystemApplication_OsCore0
      OsAlarmAction
        OsAlarmSetEvent: OsAlarmSetEventRef=Rte_Ev_Cyclic2_Default_BSW_ASync_Task_10ms_0_5ms, OsAlarmSetEventTaskRef=Os/Default_BSW_ASync_Task_10ms
    Rte_Ev_Cyclic2_Default_BSW_ASync_Task_10ms_0_5ms (OsEvent)
    3 x OsIsr, all with OsIsrCategory=CATEGORY_2, OsIsrInterruptType=EXTERNAL, OsIsrStackSize=1024, OsIsrEnableNesting=false, OsIsrUsesFpu=false, OsIsrInitialEnableInterruptSource=true:
      Uart_ASCLIN0TX_ISR: OsIsrInterruptPriority=15, OsIsrInterruptSource=80, OsIsrSpecialFunctionName=ASCLIN0TX_ISR
      Uart_ASCLIN0RX_ISR: OsIsrInterruptPriority=14, OsIsrInterruptSource=84, OsIsrSpecialFunctionName=ASCLIN0RX_ISR
      Uart_ASCLIN0ERR_ISR: OsIsrInterruptPriority=13, OsIsrInterruptSource=88, OsIsrSpecialFunctionName=ASCLIN0ERR_ISR
    Rte_Ev_Run_DigApp_DcmEcuReset_ModeSwitch (OsEvent)
    BrsMainTask (OsTask):
      OsTaskActivation = 1
      OsTaskPriority = 39
      OsTaskSchedule = FULL
      OsTaskStackSharing = false
      OsTaskStackSize = 1024
      OsTaskType = EXTENDED
      OsTaskUsesFpu = false
      OsTaskAccessingApplication = OsApplication_OsCore1
      OsTaskAccessingApplication = SystemApplication_OsCore0
      OsTaskEventRef = BrsEvCyclicAlarm_1ms
      OsTaskAutostart: OsTaskAppModeRef=OSDEFAULTAPPMODE
    BrsMainBackgroundTask (OsTask):
      OsTaskActivation = 1
      OsTaskPriority = 2
      OsTaskSchedule = FULL
      OsTaskStackSharing = false
      OsTaskStackSize = 1024
      OsTaskType = AUTO
      OsTaskUsesFpu = false
      OsTaskAccessingApplication = OsApplication_OsCore1
      OsTaskAccessingApplication = SystemApplication_OsCore0
      OsTaskAutostart: OsTaskAppModeRef=OSDEFAULTAPPMODE
    BrsEvCyclicAlarm_1ms (OsEvent)
    BrsCyclicAlarm_1ms (OsAlarm): OsAlarmCounterRef=SystemTimer, OsAlarmAccessingApplication=OsApplication_OsCore1, OsAlarmAccessingApplication=SystemApplication_OsCore0
      OsAlarmAction
        OsAlarmSetEvent: OsAlarmSetEventRef=BrsEvCyclicAlarm_1ms, OsAlarmSetEventTaskRef=Os/BrsMainTask
