AUTOSAR XML (schema 00048)
package /ActiveEcuC
  module config Os: implementation-config-variant=VARIANT-PRE-COMPILE, module-description=Os_Impl
    SystemTimer (OsCounter):
      OsCounterMaxAllowedValue = 2147483647
      OsCounterMinCycle = 1
      OsCounterType = HARDWARE
      OsSecondsPerTick = 0.0001
      OsCounterTicksPerBase = 10000
      OsCounterAccessingApplication = SystemApplication_OsCore0
      OsDriver: OsDriverHighResolution=false, OsDriverHardwareTimerChannelRef=STM0_Ch0, OsDriverIsrRef=CounterIsr_SystemTimer
    OsMemoryProtection
    OsOS:
      OsStackMonitoring = true
      OsStatus = EXTENDED
      OsUseArti = false
      OsUseGetServiceId = false
      OsUseParameterAccess = false
      OsUseResScheduler = false
      OsForcibleTermination = false
      OsGenerateCalloutStubs = true
      OsGenerateMemMap = COMPLETE
      OsGenerateMemMapForNearAddressing = true
      OsGenerateMemMapForThreads = false
      OsServiceProtection = false
      OsStackUsageMeasurement = false
      OsUseXSignalAsyncApiCalls = false
      OsFpuUsage = NONE
      OsUseCase = STANDARD
      OsScalabilityClass = SC1
      OsNumberOfCores = 1
      OsMasterCore = OsCore0
      OsSystemTimer = SystemTimer
      OsHooks: OsErrorHook=true, OsPostTaskHook=false, OsPreTaskHook=false, OsShutdownHook=false, OsStartupHook=false
      OsStackSummary
        11 x OsStack, all with OsStackSize=1024, OsStackCore=OsCore0:
          OsCore0_Kernel: OsStackType=CORE_KERNEL_STACK, OsStackUser=OsCore0
          OsCore0_Init: OsStackType=CORE_INIT_STACK, OsStackUser=OsCore0
          OsCore0_Error: OsStackType=CORE_ERROR_STACK, OsStackUser=OsCore0
          OsCore0_Isr_Core: OsStackType=ISR_SHARED_CORE_STACK, OsStackUser=CounterIsr_SystemTimer, OsStackUser=AdcIsr_G0, OsStackUser=AdcIsr_G8, OsStackUser=CanIsr_0, OsStackUser=OsIsr_QSPI2_PT, OsStackUser=OsIsr_DMA_ERR, OsStackUser=OsIsr_QSPI2_ERR, OsStackUser=OsIsr_QSPI3_PT, OsStackUser=OsIsr_QSPI3_ERR, OsStackUser=OsIsr_QSPI1_PT, OsStackUser=OsIsr_QSPI1_ERR
          OsCore0_Task_Prio4294967295: OsStackType=TASK_SHARED_PRIORITY_STACK, OsStackUser=IdleTask_OsCore0
          OsCore0_Task_Prio50: OsStackType=TASK_SHARED_PRIORITY_STACK, OsStackUser=Default_Init_Task
          OsCore0_Task_Prio49: OsStackType=TASK_SHARED_PRIORITY_STACK, OsStackUser=Default_Init_Task_Trusted
          OsCore0_Task_Prio45: OsStackType=TASK_SHARED_PRIORITY_STACK, OsStackUser=Default_Appl_Init_Task
          Default_Appl_Task: OsStackType=TASK_EXTENDED_STACK, OsStackUser=Os/Default_Appl_Task
          Default_BSW_ASync_Task: OsStackType=TASK_EXTENDED_STACK, OsStackUser=Os/Default_BSW_ASync_Task
          MotorTask: OsStackType=TASK_EXTENDED_STACK, OsStackUser=Os/MotorTask
    OsPublishedInformation: OsKernelVersion=7, OsPlatformName=TriCoreAurix
      TC36x (OsDerivativeInformation):
        OsMpuAlignment = 8
        OsMpuMemoryGapSize = 16
        OsMpuEndAddressAccessible = false
        OsStackAlignment = 8
        OsExceptionVectorTableAlignment = 256
        OsInterruptVectorTableAlignment = 8192
        OsHardwareManuals = User Manual: TC36X_um_appx_V1.0.0.pdf 2018.08
        OsMpuPrivilegedRegionsConfigurable = false
        Core0 (OsPhysicalCore):
          OsPhysicalCoreId = 0
          OsPhysicalCoreDefaultEntrySymbol = _start_tc0
          OsPhysicalCoreType = TC1.6.2P
          OsPhysicalCoreExceptionSources = 8
          OsPhysicalCoreMasterStartAllowed = true
          OsPhysicalCorePrivelegedHwAccess = true
          OsPhysicalCoreIsAutostart = true
          OsPhysicalCoreStackProtectionUnit = OsPhysicalCore0DataMpu
          OsPhysicalCore0DataMpu (OsPhysicalCoreMpu): OsPhysicalCoreMpuId=0, OsPhysicalCoreMpuMaxRegions=18, OsPhysicalCoreMpuType=DATA
          OsPhysicalCore0CodeMpu (OsPhysicalCoreMpu): OsPhysicalCoreMpuId=1, OsPhysicalCoreMpuMaxRegions=10, OsPhysicalCoreMpuType=CODE
        Core1 (OsPhysicalCore):
          OsPhysicalCoreId = 1
          OsPhysicalCoreDefaultEntrySymbol = _start_tc1
          OsPhysicalCoreType = TC1.6.2P
          OsPhysicalCoreExceptionSources = 8
          OsPhysicalCoreMasterStartAllowed = false
          OsPhysicalCorePrivelegedHwAccess = true
          OsPhysicalCoreIsAutostart = false
          OsPhysicalCoreStackProtectionUnit = OsPhysicalCore1DataMpu
          OsPhysicalCore1DataMpu (OsPhysicalCoreMpu): OsPhysicalCoreMpuId=0, OsPhysicalCoreMpuMaxRegions=18, OsPhysicalCoreMpuType=DATA
          OsPhysicalCore1CodeMpu (OsPhysicalCoreMpu): OsPhysicalCoreMpuId=1, OsPhysicalCoreMpuMaxRegions=10, OsPhysicalCoreMpuType=CODE
        STM0 (OsHardwareTimer): OsHardwareTimerSize=32, OsHardwareTimerUnit=FRT, OsHardwareTimerBaseAddress=4026535936, OsHardwareTimerId=0, OsHardwareTimerType=STM
          STM0_Ch0 (OsHardwareTimerChannel): OsHardwareTimerChannelIntSource=768, OsHardwareTimerChannelOffset=0, OsHardwareTimerChannelId=0
          STM0_Ch1 (OsHardwareTimerChannel): OsHardwareTimerChannelIntSource=772, OsHardwareTimerChannelOffset=1, OsHardwareTimerChannelId=1
        STM1 (OsHardwareTimer): OsHardwareTimerSize=32, OsHardwareTimerUnit=FRT, OsHardwareTimerBaseAddress=4026536192, OsHardwareTimerId=1, OsHardwareTimerType=STM
          STM1_Ch0 (OsHardwareTimerChannel): OsHardwareTimerChannelIntSource=776, OsHardwareTimerChannelOffset=0, OsHardwareTimerChannelId=0
          STM1_Ch1 (OsHardwareTimerChannel): OsHardwareTimerChannelIntSource=780, OsHardwareTimerChannelOffset=1, OsHardwareTimerChannelId=1
        AURIXTC3XX_IR (OsSystemIntCtrl): OsSystemIntCtrlMaxPrios=255, OsSystemIntCtrlPrioOrder=ASC, OsSystemIntCtrlMaxSources=8192, OsSystemIntCtrlBaseAddress=4026757120
        GPT (OsHardwareTimer): OsHardwareTimerSize=16, OsHardwareTimerUnit=PIT, OsHardwareTimerBaseAddress=4026537984, OsHardwareTimerId=0, OsHardwareTimerType=PIT
          GPT_Ch0 (OsHardwareTimerChannel): OsHardwareTimerChannelIntSource=744, OsHardwareTimerChannelOffset=0, OsHardwareTimerChannelId=0
          GPT_Ch1 (OsHardwareTimerChannel): OsHardwareTimerChannelIntSource=756, OsHardwareTimerChannelOffset=1, OsHardwareTimerChannelId=1
        OsMemoryRegionSpecifics
          18 x OsMemoryRegionAccess:
            PS0_R: OsMemoryRegionAccessRights=R, OsMemoryRegionAccessType=PROTECTION_SET0
            PS0_W: OsMemoryRegionAccessRights=W, OsMemoryRegionAccessType=PROTECTION_SET0
            PS0_X: OsMemoryRegionAccessRights=X, OsMemoryRegionAccessType=PROTECTION_SET0
            PS1_R: OsMemoryRegionAccessRights=R, OsMemoryRegionAccessType=PROTECTION_SET1
            PS1_W: OsMemoryRegionAccessRights=W, OsMemoryRegionAccessType=PROTECTION_SET1
            PS1_X: OsMemoryRegionAccessRights=X, OsMemoryRegionAccessType=PROTECTION_SET1
            PS2_R: OsMemoryRegionAccessRights=R, OsMemoryRegionAccessType=PROTECTION_SET2
            PS2_W: OsMemoryRegionAccessRights=W, OsMemoryRegionAccessType=PROTECTION_SET2
            PS2_X: OsMemoryRegionAccessRights=X, OsMemoryRegionAccessType=PROTECTION_SET2
            PS3_R: OsMemoryRegionAccessRights=R, OsMemoryRegionAccessType=PROTECTION_SET3
            PS3_W: OsMemoryRegionAccessRights=W, OsMemoryRegionAccessType=PROTECTION_SET3
            PS3_X: OsMemoryRegionAccessRights=X, OsMemoryRegionAccessType=PROTECTION_SET3
            PS4_R: OsMemoryRegionAccessRights=R, OsMemoryRegionAccessType=PROTECTION_SET4
            PS4_W: OsMemoryRegionAccessRights=W, OsMemoryRegionAccessType=PROTECTION_SET4
            PS4_X: OsMemoryRegionAccessRights=X, OsMemoryRegionAccessType=PROTECTION_SET4
            PS5_R: OsMemoryRegionAccessRights=R, OsMemoryRegionAccessType=PROTECTION_SET5
            PS5_W: OsMemoryRegionAccessRights=W, OsMemoryRegionAccessType=PROTECTION_SET5
            PS5_X: OsMemoryRegionAccessRights=X, OsMemoryRegionAccessType=PROTECTION_SET5
        DMA (OsInterruptSupportedType):
          OsInterruptSupportedTypeSeparateSources = false
          OsInterruptSupportedTypeSeparatePriority = true
          OsInterruptSupportedTypeIsMapped = false
          OsInterruptSupportedTypePostActionRequired = false
    OSDEFAULTAPPMODE (OsAppMode)
    OS_APPMODE_ANY (OsAppMode)
    OsCore0 (OsCore):
      OsCoreIsAutostart = true
      OsCoreIsAutosar = true
      OsCoreEntrySymbol = _start_tc0
      OsCorePhysicalCoreRef = Core0
      OsCoreIdleTask = IdleTask_OsCore0
      OsCoreSystemApplication = SystemApplication_OsCore0
      OsCoreEcucCoreRef = EcucCoreDefinition
      OsCoreStacks:
        OsCoreKernelStackSize = 1024
        OsCoreStartupStackSize = 1024
        OsCoreShutdownStackSize = 1024
        OsCoreErrorStackSize = 1024
        OsCoreProtectionStackSize = 1024
        OsCoreInitStackSize = 1024
    IdleTask_OsCore0 (OsTask):
      OsTaskActivation = 1
      OsTaskPriority = 4294967295
      OsTaskSchedule = FULL
      OsTaskStackSharing = false
      OsTaskStackSize = 1024
      OsTaskType = AUTO
      OsTaskUsesFpu = false
      OsTaskAccessingApplication = SystemApplication_OsCore0
      OsTaskAutostart: OsTaskAppModeRef=OS_APPMODE_ANY
    SystemApplication_OsCore0 (OsApplication):
      OsTrusted = true
      OsTrustedApplicationDelayTimingViolationCall = false
      OsTrustedApplicationWithProtection = false
      OsApplicationIsPrivileged = true
      OsAppUseTrustedFunctionStubs = false
      OsAppCounterRef = SystemTimer
      OsAppIsrRef = CounterIsr_SystemTimer
      OsAppTaskRef = IdleTask_OsCore0
      OsAppTaskRef = Default_Init_Task
      OsAppTaskRef = Default_Init_Task_Trusted
      OsAppTaskRef = Os/Default_BSW_ASync_Task
      OsAppTaskRef = Default_Appl_Init_Task
      OsAppTaskRef = Os/Default_Appl_Task
      OsAppAlarmRef = Rte_Al_TE2_Default_BSW_ASync_Task_0_10ms
      OsAppAlarmRef = Rte_Al_TE_MotorCdd_MotorCDDMainFunction
      OsAppAlarmRef = Rte_Al_TE_StartApp_StartApp_Cyclic1000ms
      OsAppAlarmRef = Rte_Al_TE_MotorControll_MotorControll_MainFunction
      OsAppAlarmRef = Rte_Al_TE_StartApp_StartApp_Cyclic250ms
      OsApplicationCoreRef = EcucCoreDefinition
      OsAppAlarmRef = Rte_Al_TE2_Default_BSW_ASync_Task_0_20ms
      OsAppIsrRef = AdcIsr_G0
      OsAppIsrRef = AdcIsr_G8
      OsAppIsrRef = CanIsr_0
      OsAppTaskRef = Os/MotorTask
      OsAppAlarmRef = Rte_Al_TE_StartApp_StartApp_Cyclic10ms
      OsAppAlarmRef = Rte_Al_TE_StartApp_StartApp_Cyclic1ms
      OsAppAlarmRef = Rte_Al_TE_Spi_Spi_MainFunction_Handling
      OsAppIsrRef = OsIsr_QSPI2_PT
      OsAppIsrRef = OsIsr_DMA_ERR
      OsAppIsrRef = OsIsr_QSPI2_ERR
      OsAppIsrRef = OsIsr_QSPI3_PT
      OsAppIsrRef = OsIsr_QSPI3_ERR
      OsAppIsrRef = OsIsr_QSPI1_PT
      OsAppIsrRef = OsIsr_QSPI1_ERR
      OsApplicationHooks: OsAppErrorHook=false, OsAppShutdownHook=false, OsAppStartupHook=false
    CounterIsr_SystemTimer (OsIsr):
      OsIsrInterruptPriority = 80
      OsIsrCategory = CATEGORY_2
      OsIsrInterruptType = EXTERNAL
      OsIsrInterruptSource = 768
      OsIsrStackSize = 1024
      OsIsrEnableNesting = false
      OsIsrUsesFpu = false
      OsIsrInitialEnableInterruptSource = false
      OsIsrSpecialFunctionName = Os_TimerPfrtIsr
    3 x OsTask, all with OsTaskActivation=1, OsTaskSchedule=NON, OsTaskStackSharing=false, OsTaskStackSize=1024, OsTaskUsesFpu=false, OsTaskAccessingApplication=SystemApplication_OsCore0:
      Default_Init_Task: OsTaskPriority=50, OsTaskType=BASIC
        OsTaskAutostart: OsTaskAppModeRef=OSDEFAULTAPPMODE
      Default_Init_Task_Trusted: OsTaskPriority=49, OsTaskType=BASIC
        OsTaskAutostart: OsTaskAppModeRef=OSDEFAULTAPPMODE
      Default_BSW_ASync_Task: OsTaskPriority=30, OsTaskType=AUTO, OsTaskResourceRef=OsResource_EcuM, OsTaskEventRef=Rte_Ev_Cyclic2_Default_BSW_ASync_Task_0_10ms, OsTaskEventRef=Rte_Ev_Cyclic2_Default_BSW_ASync_Task_0_20ms, OsTaskEventRef=Rte_Ev_Run_Spi_Spi_MainFunction_Handling
    OsResource_EcuM (OsResource): OsResourceProperty=STANDARD, OsResourceAccessingApplication=SystemApplication_OsCore0
    Default_Appl_Init_Task (OsTask):
      OsTaskActivation = 1
      OsTaskPriority = 45
      OsTaskSchedule = NON
      OsTaskStackSharing = false
      OsTaskStackSize = 1024
      OsTaskType = AUTO
      OsTaskUsesFpu = false
      OsTaskAccessingApplication = SystemApplication_OsCore0
    Default_Appl_Task (OsTask):
      OsTaskActivation = 1
      OsTaskPriority = 5
      OsTaskSchedule = NON
      OsTaskStackSharing = false
      OsTaskStackSize = 1024
      OsTaskType = AUTO
      OsTaskUsesFpu = false
      OsTaskAccessingApplication = SystemApplication_OsCore0
      OsTaskEventRef = Rte_Ev_Run_StartApp_StartApp_Cyclic1000ms
      OsTaskEventRef = Rte_Ev_Run_StartApp_StartApp_Cyclic250ms
      OsTaskEventRef = Rte_Ev_Run_StartApp_StartApp_Cyclic10ms
      OsTaskEventRef = Rte_Ev_Run_StartApp_StartApp_Cyclic1ms
    3 x OsAlarm, all with OsAlarmCounterRef=SystemTimer, OsAlarmAccessingApplication=SystemApplication_OsCore0:
      Rte_Al_TE2_Default_BSW_ASync_Task_0_10ms
        OsAlarmAction
          OsAlarmSetEvent: OsAlarmSetEventRef=Rte_Ev_Cyclic2_Default_BSW_ASync_Task_0_10ms, OsAlarmSetEventTaskRef=Os/Default_BSW_ASync_Task
      Rte_Al_TE_StartApp_StartApp_Cyclic1000ms
        OsAlarmAction
          OsAlarmSetEvent: OsAlarmSetEventRef=Rte_Ev_Run_StartApp_StartApp_Cyclic1000ms, OsAlarmSetEventTaskRef=Os/Default_Appl_Task
      Rte_Al_TE_StartApp_StartApp_Cyclic250ms
        OsAlarmAction
          OsAlarmSetEvent: OsAlarmSetEventRef=Rte_Ev_Run_StartApp_StartApp_Cyclic250ms, OsAlarmSetEventTaskRef=Os/Default_Appl_Task
    Rte_Ev_Run_StartApp_StartApp_Cyclic1000ms (OsEvent)
    Rte_Ev_Run_StartApp_StartApp_Cyclic250ms (OsEvent)
    Rte_Al_TE2_Default_BSW_ASync_Task_0_20ms (OsAlarm): OsAlarmCounterRef=SystemTimer, OsAlarmAccessingApplication=SystemApplication_OsCore0
      OsAlarmAction
        OsAlarmSetEvent: OsAlarmSetEventRef=Rte_Ev_Cyclic2_Default_BSW_ASync_Task_0_20ms, OsAlarmSetEventTaskRef=Os/Default_BSW_ASync_Task
    Rte_Ev_Cyclic2_Default_BSW_ASync_Task_0_10ms (OsEvent)
    Rte_Ev_Cyclic2_Default_BSW_ASync_Task_0_20ms (OsEvent)
    3 x OsIsr, all with OsIsrCategory=CATEGORY_2, OsIsrInterruptType=EXTERNAL, OsIsrStackSize=1024, OsIsrEnableNesting=false, OsIsrUsesFpu=false, OsIsrInitialEnableInterruptSource=true:
      AdcIsr_G0: OsIsrInterruptPriority=79, OsIsrInterruptSource=1648, OsIsrSpecialFunctionName=ADC0SR0_ISR
      AdcIsr_G8: OsIsrInterruptPriority=78, OsIsrInterruptSource=1776, OsIsrSpecialFunctionName=ADC8SR0_ISR
      CanIsr_0: OsIsrInterruptPriority=60, OsIsrInterruptSource=1456  # /ActiveEcuC/Can PLAIN_TEXT Can messages event (for a specific controllers)
    MotorTask (OsTask):
      OsTaskActivation = 1
      OsTaskPriority = 200
      OsTaskSchedule = NON
      OsTaskStackSharing = false
      OsTaskStackSize = 1024
      OsTaskType = EXTENDED
      OsTaskUsesFpu = true
      OsTaskAccessingApplication = SystemApplication_OsCore0
      OsTaskEventRef = Rte_Ev_Run_MotorCdd_MotorCDDMainFunction
      OsTaskEventRef = Rte_Ev_Run_MotorControll_MotorControll_MainFunction
      OsTaskEventRef = Rte_Ev_Run_MotorCdd_MotorCdd_AdcOnSampleReady_Rp_AdcSampleReady_AdcSampleReady
    4 x OsAlarm, all with OsAlarmCounterRef=SystemTimer, OsAlarmAccessingApplication=SystemApplication_OsCore0:
      Rte_Al_TE_StartApp_StartApp_Cyclic10ms
        OsAlarmAction
          OsAlarmSetEvent: OsAlarmSetEventRef=Rte_Ev_Run_StartApp_StartApp_Cyclic10ms, OsAlarmSetEventTaskRef=Os/Default_Appl_Task
      Rte_Al_TE_StartApp_StartApp_Cyclic1ms
        OsAlarmAction
          OsAlarmSetEvent: OsAlarmSetEventRef=Rte_Ev_Run_StartApp_StartApp_Cyclic1ms, OsAlarmSetEventTaskRef=Os/Default_Appl_Task
      Rte_Al_TE_MotorCdd_MotorCDDMainFunction
        OsAlarmAction
          OsAlarmSetEvent: OsAlarmSetEventRef=Rte_Ev_Run_MotorCdd_MotorCDDMainFunction, OsAlarmSetEventTaskRef=Os/MotorTask
      Rte_Al_TE_MotorControll_MotorControll_MainFunction
        OsAlarmAction
          OsAlarmSetEvent: OsAlarmSetEventRef=Rte_Ev_Run_MotorControll_MotorControll_MainFunction, OsAlarmSetEventTaskRef=Os/MotorTask
    5 x OsEvent:
      Rte_Ev_Run_MotorCdd_MotorCDDMainFunction
      Rte_Ev_Run_MotorControll_MotorControll_MainFunction
      Rte_Ev_Run_StartApp_StartApp_Cyclic10ms
      Rte_Ev_Run_StartApp_StartApp_Cyclic1ms
      Rte_Ev_Run_MotorCdd_MotorCdd_AdcOnSampleReady_Rp_AdcSampleReady_AdcSampleReady
    Rte_Al_TE_Spi_Spi_MainFunction_Handling (OsAlarm): OsAlarmCounterRef=SystemTimer, OsAlarmAccessingApplication=SystemApplication_OsCore0
      OsAlarmAction
        OsAlarmSetEvent: OsAlarmSetEventRef=Rte_Ev_Run_Spi_Spi_MainFunction_Handling, OsAlarmSetEventTaskRef=Os/Default_BSW_ASync_Task
    Rte_Ev_Run_Spi_Spi_MainFunction_Handling (OsEvent)
    7 x OsIsr, all with OsIsrCategory=CATEGORY_2, OsIsrInterruptType=EXTERNAL, OsIsrStackSize=1024, OsIsrEnableNesting=false, OsIsrUsesFpu=false, OsIsrInitialEnableInterruptSource=true:
      OsIsr_QSPI2_PT: OsIsrInterruptPriority=20, OsIsrInterruptSource=292, OsIsrSpecialFunctionName=QSPI2PT_ISR
      OsIsr_DMA_ERR: OsIsrInterruptPriority=90, OsIsrInterruptSource=832, OsIsrSpecialFunctionName=DMAERR0SR_ISR
      OsIsr_QSPI2_ERR: OsIsrInterruptPriority=23, OsIsrInterruptSource=288, OsIsrSpecialFunctionName=QSPI2ERR_ISR
      OsIsr_QSPI3_PT: OsIsrInterruptPriority=21, OsIsrInterruptSource=312, OsIsrSpecialFunctionName=QSPI3PT_ISR
      OsIsr_QSPI3_ERR: OsIsrInterruptPriority=24, OsIsrInterruptSource=308, OsIsrSpecialFunctionName=QSPI3ERR_ISR
      OsIsr_QSPI1_PT: OsIsrInterruptPriority=19, OsIsrInterruptSource=272, OsIsrSpecialFunctionName=QSPI1PT_ISR
      OsIsr_QSPI1_ERR: OsIsrInterruptPriority=22, OsIsrInterruptSource=268, OsIsrSpecialFunctionName=QSPI1ERR_ISR
