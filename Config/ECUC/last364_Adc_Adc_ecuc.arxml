AUTOSAR XML (schema 00048)
package /ActiveEcuC
  module config Adc: implementation-config-variant=VARIANT-POST-BUILD-LOADABLE, module-description=Adc_Impl
    AdcConfigSet: AdcSyncClockDisable=false, AdcSystemClock=McuClockReferencePointConfig
      AdcGlobalInputClass:
        AdcChSampleTime = 0
        AdcChPreChargeClkCycles = ADC_INPUT_PRECHARGE_CYCLES_0
        AdcChConvMode = ADC_NOISE_REDUCTION_STEPS_0
        AdcChSESPSEnable = false
        AdcEmuxChSampleTime = 0
        AdcEmuxChPreChargeClkCycles = ADC_INPUT_PRECHARGE_CYCLES_0
        AdcEmuxChConvMode = ADC_NOISE_REDUCTION_STEPS_0
        AdcEmuxChSESPSEnable = false
      AdcGlobalInputClass_1 (AdcGlobalInputClass):
        AdcChSampleTime = 10
        AdcChPreChargeClkCycles = ADC_INPUT_PRECHARGE_CYCLES_0
        AdcChConvMode = ADC_NOISE_REDUCTION_STEPS_0
        AdcChSESPSEnable = false
        AdcEmuxChSampleTime = 0
        AdcEmuxChPreChargeClkCycles = ADC_INPUT_PRECHARGE_CYCLES_0
        AdcEmuxChConvMode = ADC_NOISE_REDUCTION_STEPS_0
        AdcEmuxChSESPSEnable = false
      4 x AdcHwUnit, all with AdcIdlePrechargeEnable=false, AdcInputBufferEnable=false, AdcPrechargeReference=ADC_VDD_VSM_USED, AdcReferencePrechargePhases=ADC_PRECHARGE_PHASE_1, AdcCalibrationSampleTime=ADC_CAL_TIME_2_TIMES_TADCI, AdcPostCalibrationDisable=false, AdcAnalogClockSyncDelay=0, AdcMSBDoubleClkEnable=false, AdcRequestSource0ConvMode=ADC_WAIT_FOR_START_MODE, AdcRequestSource1ConvMode=ADC_WAIT_FOR_START_MODE, AdcRequestSource2ConvMode=ADC_WAIT_FOR_START_MODE, AdcPrescale=4, AdcClockSource=ADC_SYSTEM_CLK:
        AdcHwUnit_ADC0: AdcHwUnitId=HWUNIT_ADC0, AdcSampleSyncEnable=true, AdcSyncConvMode=ADC_SYNC_MASTER
          AdcHwUnitInputClass:
            AdcChSampleTime = 10
            AdcChPreChargeClkCycles = ADC_INPUT_PRECHARGE_CYCLES_0
            AdcChConvMode = ADC_NOISE_REDUCTION_STEPS_0
            AdcChSESPSEnable = false
            AdcEmuxChSampleTime = 0
            AdcEmuxChPreChargeClkCycles = ADC_INPUT_PRECHARGE_CYCLES_0
            AdcEmuxChConvMode = ADC_NOISE_REDUCTION_STEPS_0
            AdcEmuxChSESPSEnable = false
          AdcHwUnitInputClass_1 (AdcHwUnitInputClass):
            AdcChSampleTime = 0
            AdcChPreChargeClkCycles = ADC_INPUT_PRECHARGE_CYCLES_0
            AdcChConvMode = ADC_NOISE_REDUCTION_STEPS_0
            AdcChSESPSEnable = false
            AdcEmuxChSampleTime = 0
            AdcEmuxChPreChargeClkCycles = ADC_INPUT_PRECHARGE_CYCLES_0
            AdcEmuxChConvMode = ADC_NOISE_REDUCTION_STEPS_0
            AdcEmuxChSESPSEnable = false
          AdcChannel_9183_VRO (AdcChannel):
            AdcChannelId = 0
            AdcAnChannelNum = G0CH1
            AdcInputClassSelection = ADC_HWUNIT_CLASS_0
            AdcSyncConvChannelEnable = false
            AdcBWDEnable = false
            AdcBWDPrechargeLevel = ADC_BWD_PRECH_VAGND
            AdcPullDownDiagnosticEnable = false
            AdcMultiplexerDiagnosticEnable = false
            AdcMultiplexerDiagnosticLevel = ADC_MD_PULL_DOWN
            AdcConverterDiagnosticEnable = false
            AdcConverterDiagnosticsLevel = ADC_CD_PULL_DEVICE_VDDM
          AdcGroup_9183Sense (AdcGroup):
            AdcGroupAccessMode = ADC_ACCESS_MODE_SINGLE
            AdcGroupConversionMode = ADC_CONV_MODE_ONESHOT
            AdcGroupId = 0
            AdcGroupTriggSrc = ADC_TRIGG_SRC_HW
            AdcStreamingBufferMode = ADC_STREAM_BUFFER_CIRCULAR
            AdcStreamingNumSamples = 1
            AdcHwExtTrigSelect = ADC_TRIG_8_GxREQTRI_GTM_ADCx_TRIG0
            AdcHwExtGateSelect = ADC_GATE_NONE
            AdcHwGateSignal = ADC_GATE_LVL_HIGH
            AdcChannel0Alias = 0
            AdcChannel1Alias = 1
            AdcEmuxChGroup = false
            AdcEmuxStartSelection = 0
            AdcResRegDefinition = 0
            AdcResRegDefinition = 1
            AdcHwTrigSignal = ADC_HW_TRIG_RISING_EDGE
            AdcNotification = Adc_9183SenseVo1andVro_Notification
            AdcGroupDefinition = AdcChannel_9183_VO1
            AdcGroupDefinition = AdcChannel_9183_VRO
            GtmTriggerTimerConfig: GtmTimerClockSelect=GTM_CONFIGURABLE_CLOCK_0, GtmTimerTimePeriod=100, GtmTimerCM0Ticks=10000, GtmTimerUsed=McuGtmAtomChannelAllocationConf_7
          AdcChannel_9183_VO1 (AdcChannel):
            AdcChannelId = 1
            AdcAnChannelNum = G0CH4
            AdcInputClassSelection = ADC_HWUNIT_CLASS_0
            AdcSyncConvChannelEnable = true
            AdcBWDEnable = false
            AdcBWDPrechargeLevel = ADC_BWD_PRECH_VAGND
            AdcPullDownDiagnosticEnable = false
            AdcMultiplexerDiagnosticEnable = false
            AdcMultiplexerDiagnosticLevel = ADC_MD_PULL_DOWN
            AdcConverterDiagnosticEnable = false
            AdcConverterDiagnosticsLevel = ADC_CD_PULL_DEVICE_VDDM
        AdcHwUnit_ADC2: AdcHwUnitId=HWUNIT_ADC2, AdcSampleSyncEnable=true, AdcSyncConvMode=ADC_SYNC_SLAVE
          AdcHwUnitInputClass:
            AdcChSampleTime = 10
            AdcChPreChargeClkCycles = ADC_INPUT_PRECHARGE_CYCLES_0
            AdcChConvMode = ADC_NOISE_REDUCTION_STEPS_0
            AdcChSESPSEnable = false
            AdcEmuxChSampleTime = 0
            AdcEmuxChPreChargeClkCycles = ADC_INPUT_PRECHARGE_CYCLES_0
            AdcEmuxChConvMode = ADC_NOISE_REDUCTION_STEPS_0
            AdcEmuxChSESPSEnable = false
          AdcHwUnitInputClass_1 (AdcHwUnitInputClass):
            AdcChSampleTime = 0
            AdcChPreChargeClkCycles = ADC_INPUT_PRECHARGE_CYCLES_0
            AdcChConvMode = ADC_NOISE_REDUCTION_STEPS_0
            AdcChSESPSEnable = false
            AdcEmuxChSampleTime = 0
            AdcEmuxChPreChargeClkCycles = ADC_INPUT_PRECHARGE_CYCLES_0
            AdcEmuxChConvMode = ADC_NOISE_REDUCTION_STEPS_0
            AdcEmuxChSESPSEnable = false
          AdcChannel_9183_VO2 (AdcChannel):
            AdcChannelId = 0
            AdcAnChannelNum = G2CH4
            AdcInputClassSelection = ADC_HWUNIT_CLASS_0
            AdcSyncConvChannelEnable = true
            AdcBWDEnable = false
            AdcBWDPrechargeLevel = ADC_BWD_PRECH_VAGND
            AdcPullDownDiagnosticEnable = false
            AdcMultiplexerDiagnosticEnable = false
            AdcMultiplexerDiagnosticLevel = ADC_MD_PULL_DOWN
            AdcConverterDiagnosticEnable = false
            AdcConverterDiagnosticsLevel = ADC_CD_PULL_DEVICE_VDDM
          AdcGroup:
            AdcGroupAccessMode = ADC_ACCESS_MODE_SINGLE
            AdcGroupConversionMode = ADC_CONV_MODE_ONESHOT
            AdcGroupId = 64
            AdcGroupTriggSrc = ADC_TRIGG_SRC_HW
            AdcStreamingBufferMode = ADC_STREAM_BUFFER_CIRCULAR
            AdcStreamingNumSamples = 1
            AdcHwExtTrigSelect = ADC_TRIG_8_GxREQTRI_GTM_ADCx_TRIG0
            AdcHwExtGateSelect = ADC_GATE_NONE
            AdcHwGateSignal = ADC_GATE_LVL_HIGH
            AdcChannel0Alias = 0
            AdcChannel1Alias = 1
            AdcEmuxChGroup = false
            AdcEmuxStartSelection = 0
            AdcResRegDefinition = 0
            AdcResRegDefinition = 1
            AdcHwTrigSignal = ADC_HW_TRIG_RISING_EDGE
            AdcGroupDefinition = AdcChannel_9183_VO2
            AdcGroupDefinition = AdcChannel_V_INV
          AdcChannel_V_INV (AdcChannel):
            AdcChannelId = 1
            AdcAnChannelNum = G2CH1
            AdcInputClassSelection = ADC_HWUNIT_CLASS_0
            AdcSyncConvChannelEnable = true
            AdcBWDEnable = false
            AdcBWDPrechargeLevel = ADC_BWD_PRECH_VAGND
            AdcPullDownDiagnosticEnable = false
            AdcMultiplexerDiagnosticEnable = false
            AdcMultiplexerDiagnosticLevel = ADC_MD_PULL_DOWN
            AdcConverterDiagnosticEnable = false
            AdcConverterDiagnosticsLevel = ADC_CD_PULL_DEVICE_VDDM
        AdcHwUnit_ADC3: AdcHwUnitId=HWUNIT_ADC3, AdcSampleSyncEnable=true, AdcSyncConvMode=ADC_SYNC_SLAVE
          AdcHwUnitInputClass:
            AdcChSampleTime = 10
            AdcChPreChargeClkCycles = ADC_INPUT_PRECHARGE_CYCLES_0
            AdcChConvMode = ADC_NOISE_REDUCTION_STEPS_0
            AdcChSESPSEnable = false
            AdcEmuxChSampleTime = 0
            AdcEmuxChPreChargeClkCycles = ADC_INPUT_PRECHARGE_CYCLES_0
            AdcEmuxChConvMode = ADC_NOISE_REDUCTION_STEPS_0
            AdcEmuxChSESPSEnable = false
          AdcHwUnitInputClass_1 (AdcHwUnitInputClass):
            AdcChSampleTime = 0
            AdcChPreChargeClkCycles = ADC_INPUT_PRECHARGE_CYCLES_0
            AdcChConvMode = ADC_NOISE_REDUCTION_STEPS_0
            AdcChSESPSEnable = false
            AdcEmuxChSampleTime = 0
            AdcEmuxChPreChargeClkCycles = ADC_INPUT_PRECHARGE_CYCLES_0
            AdcEmuxChConvMode = ADC_NOISE_REDUCTION_STEPS_0
            AdcEmuxChSESPSEnable = false
          AdcChannel_9183_VO3 (AdcChannel):
            AdcChannelId = 0
            AdcAnChannelNum = G3CH4
            AdcInputClassSelection = ADC_HWUNIT_CLASS_0
            AdcSyncConvChannelEnable = true
            AdcBWDEnable = false
            AdcBWDPrechargeLevel = ADC_BWD_PRECH_VAGND
            AdcPullDownDiagnosticEnable = false
            AdcMultiplexerDiagnosticEnable = false
            AdcMultiplexerDiagnosticLevel = ADC_MD_PULL_DOWN
            AdcConverterDiagnosticEnable = false
            AdcConverterDiagnosticsLevel = ADC_CD_PULL_DEVICE_VDDM
          AdcGroup_1 (AdcGroup):
            AdcGroupAccessMode = ADC_ACCESS_MODE_SINGLE
            AdcGroupConversionMode = ADC_CONV_MODE_ONESHOT
            AdcGroupId = 96
            AdcGroupTriggSrc = ADC_TRIGG_SRC_HW
            AdcStreamingBufferMode = ADC_STREAM_BUFFER_CIRCULAR
            AdcStreamingNumSamples = 1
            AdcHwExtTrigSelect = ADC_TRIG_8_GxREQTRI_GTM_ADCx_TRIG0
            AdcHwExtGateSelect = ADC_GATE_NONE
            AdcHwGateSignal = ADC_GATE_LVL_HIGH
            AdcChannel0Alias = 0
            AdcChannel1Alias = 1
            AdcEmuxChGroup = false
            AdcEmuxStartSelection = 0
            AdcResRegDefinition = 0
            AdcHwTrigSignal = ADC_HW_TRIG_RISING_EDGE
            AdcGroupDefinition = AdcChannel_9183_VO3
        AdcHwUnit_ADC8: AdcHwUnitId=HWUNIT_ADC8, AdcSampleSyncEnable=false, AdcSyncConvMode=ADC_STAND_ALONE
          AdcHwUnitInputClass:
            AdcChSampleTime = 0
            AdcChPreChargeClkCycles = ADC_INPUT_PRECHARGE_CYCLES_0
            AdcChConvMode = ADC_NOISE_REDUCTION_STEPS_0
            AdcChSESPSEnable = false
            AdcEmuxChSampleTime = 0
            AdcEmuxChPreChargeClkCycles = ADC_INPUT_PRECHARGE_CYCLES_0
            AdcEmuxChConvMode = ADC_NOISE_REDUCTION_STEPS_0
            AdcEmuxChSESPSEnable = false
          AdcHwUnitInputClass_1 (AdcHwUnitInputClass):
            AdcChSampleTime = 0
            AdcChPreChargeClkCycles = ADC_INPUT_PRECHARGE_CYCLES_0
            AdcChConvMode = ADC_NOISE_REDUCTION_STEPS_0
            AdcChSESPSEnable = false
            AdcEmuxChSampleTime = 0
            AdcEmuxChPreChargeClkCycles = ADC_INPUT_PRECHARGE_CYCLES_0
            AdcEmuxChConvMode = ADC_NOISE_REDUCTION_STEPS_0
            AdcEmuxChSESPSEnable = false
          AdcChannel_SS_BatteryCheck (AdcChannel):
            AdcChannelId = 0
            AdcAnChannelNum = G8CH3
            AdcInputClassSelection = ADC_HWUNIT_CLASS_0
            AdcSyncConvChannelEnable = false
            AdcBWDEnable = false
            AdcBWDPrechargeLevel = ADC_BWD_PRECH_VAGND
            AdcPullDownDiagnosticEnable = false
            AdcMultiplexerDiagnosticEnable = false
            AdcMultiplexerDiagnosticLevel = ADC_MD_PULL_DOWN
            AdcConverterDiagnosticEnable = false
            AdcConverterDiagnosticsLevel = ADC_CD_PULL_DEVICE_VDDM
          AdcGroup_2 (AdcGroup):
            AdcGroupAccessMode = ADC_ACCESS_MODE_SINGLE
            AdcGroupConversionMode = ADC_CONV_MODE_ONESHOT
            AdcGroupId = 256
            AdcGroupTriggSrc = ADC_TRIGG_SRC_SW
            AdcStreamingBufferMode = ADC_STREAM_BUFFER_LINEAR
            AdcStreamingNumSamples = 1
            AdcHwExtTrigSelect = ADC_TRIG_NONE
            AdcHwExtGateSelect = ADC_GATE_NONE
            AdcHwGateSignal = ADC_GATE_LVL_HIGH
            AdcChannel0Alias = 0
            AdcChannel1Alias = 1
            AdcEmuxChGroup = false
            AdcEmuxStartSelection = 0
            AdcResRegDefinition = 0
            AdcGroupDefinition = AdcChannel_SS_BatteryCheck
    AdcGeneral:
      AdcDeInitApi = true
      AdcDevErrorDetect = true
      AdcSafetyEnable = false
      AdcMultiCoreErrorDetect = false
      AdcInitCheckApi = false
      AdcEnableLimitCheck = false
      AdcEnableQueuing = false
      AdcEnableStartStopGroupApi = true
      AdcGrpNotifCapability = true
      AdcHwTriggerApi = true
      AdcReadGroupApi = true
      AdcVersionInfoApi = false
      AdcStartupCalibApi = false
      AdcTriggerOneConversionEnable = false
      AdcSyncConvEnable = true
      AdcPriorityImplementation = ADC_PRIORITY_NONE
      AdcResultHandlingImplementation = ADC_INTERRUPT_MODE_RESULT_HANDLING
      AdcResultAlignment = ADC_ALIGN_RIGHT
      AdcMaxChConvTimeCount = 0
      AdcSleepMode = ADC_SLEEP_MODE_ACCEPT
      AdcSupplyVoltage = ADC_VOLTAGE_CONTROLLED_BY_SUPPLY
      AdcRuntimeApiMode = ADC_MCAL_SUPERVISOR
      AdcInitDeInitApiMode = ADC_MCAL_SUPERVISOR
      AdcEmuxEnable = false
      AdcEmuxGroupInterface0 = HWUNIT_ADC0
      AdcEmuxGroupInterface1 = HWUNIT_ADC1
    AdcPublishedInformation: AdcChannelValueSigned=false, AdcGroupFirstChannelFixed=false, AdcMaxChannelResolution=12
    CommonPublishedInformation:
      ArMajorVersion = 4
      ArMinorVersion = 2
      ArPatchVersion = 2
      SwMajorVersion = 20
      SwMinorVersion = 10
      SwPatchVersion = 0
      ModuleId = 123
      VendorId = 17
      Release = _TRICORE_TC364_TQFP
    AdcDemEventParameterRefs
