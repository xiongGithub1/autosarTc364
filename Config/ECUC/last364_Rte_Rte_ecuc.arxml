AUTOSAR XML (schema 00048)
package /ActiveEcuC
  module config Rte: implementation-config-variant=VARIANT-PRE-COMPILE, module-description=Rte_Impl
    RteOsInteraction
      9 x RteUsedOsActivation, all with RteExpectedActivationOffset=0, RteExpectedTickDuration=0:
        Rte_Al_TE_StartApp_StartApp_Cyclic1000ms: RteActivationOsAlarmRef=Rte_Al_TE_StartApp_StartApp_Cyclic1000ms, RteActivationOsTaskRef=Default_Appl_Task
        Rte_Al_TE_StartApp_StartApp_Cyclic250ms: RteActivationOsAlarmRef=Rte_Al_TE_StartApp_StartApp_Cyclic250ms, RteActivationOsTaskRef=Default_Appl_Task
        Rte_Al_TE_StartApp_StartApp_Cyclic10ms: RteActivationOsAlarmRef=Rte_Al_TE_StartApp_StartApp_Cyclic10ms, RteActivationOsTaskRef=Default_Appl_Task
        Rte_Al_TE_Com_Com_MainFunctionTx_ComMainFunctionTx: RteActivationOsAlarmRef=Rte_Al_TE_Com_Com_MainFunctionTx_ComMainFunctionTx, RteActivationOsTaskRef=Default_BSW_ASync_Task_10ms
        Rte_Al_TE_StartApp_StartApp_Cyclic1ms: RteActivationOsAlarmRef=Rte_Al_TE_StartApp_StartApp_Cyclic1ms, RteActivationOsTaskRef=Default_Appl_Task
        Rte_Al_TE2_Default_BSW_ASync_Task_10ms_0_10ms: RteActivationOsAlarmRef=Rte_Al_TE2_Default_BSW_ASync_Task_10ms_0_10ms, RteActivationOsTaskRef=Default_BSW_ASync_Task_10ms
        Rte_Al_TE2_Default_BSW_ASync_Task_10ms_0_20ms: RteActivationOsAlarmRef=Rte_Al_TE2_Default_BSW_ASync_Task_10ms_0_20ms, RteActivationOsTaskRef=Default_BSW_ASync_Task_10ms
        Rte_Al_TE2_EcuM_EcuM_MainFunction: RteActivationOsAlarmRef=Rte_Al_TE2_EcuM_EcuM_MainFunction, RteActivationOsTaskRef=BswCore1Task
        Rte_Al_TE_MotorTask_0_1ms: RteActivationOsAlarmRef=Rte_Al_TE_MotorTask_0_1ms, RteActivationOsTaskRef=MotorTask
    RteGeneration:
      RteGenerationMode = COMPATIBILITY_MODE
      RteIocInteractionReturnValue = RTE_IOC
      RteValueRangeCheckEnabled = false
      RteCalibrationSupport = NONE
      RteCodeVendorId = 30
      RteDevErrorDetect = false
      RteDevErrorDetectUninit = false
      RteMeasurementSupport = false
      RteOptimizationMode = RUNTIME
      RteVfbTraceEnabled = false
    RteInitializationBehavior: RteInitializationStrategy=RTE_INITIALIZATION_STRATEGY_AT_DATA_DECLARATION, RteSectionInitializationPolicy=INIT
    RteBswGeneral: RteSchMVersionInfoApi=false, RteUseComShadowSignalApi=false
    BswM (RteBswModuleInstance): RteBswImplementationRef=BswM_Impl, RteBswModuleConfigurationRef=BswM
      BSWM_EXCLUSIVE_AREA_0 (RteBswExclusiveAreaImpl): RteExclusiveAreaImplMechanism=OS_INTERRUPT_BLOCKING, RteBswExclusiveAreaRef=BSWM_EXCLUSIVE_AREA_0
      BswM_MainFunctionTimingEvent0 (RteBswEventToTaskMapping):
        RteBswImmediateRestart = false
        RteBswPositionInTask = 0
        RteBswEventRef = BswM_MainFunctionTimingEvent0
        RteBswMappedToTaskRef = Default_BSW_ASync_Task_10ms
        RteBswUsedOsEventRef = Rte_Ev_Cyclic2_Default_BSW_ASync_Task_10ms_0_10ms
        RteBswUsedOsAlarmRef = Rte_Al_TE2_Default_BSW_ASync_Task_10ms_0_10ms
    Det_EcuSwComposition (RteSwComponentInstance): RteSoftwareComponentInstanceRef=Det
    Os_OsCore0_swc_EcuSwComposition (RteSwComponentInstance): RteSoftwareComponentInstanceRef=Os_OsCore0_swc
      OpEventGetCounterValue_GetCounterValue_OsService_SystemTimer (RteEventToTaskMapping): RteImmediateRestart=false, RteEventRef=OpEventGetCounterValue_GetCounterValue_OsService_SystemTimer
      OpEventGetElapsedValue_GetElapsedValue_OsService_SystemTimer (RteEventToTaskMapping): RteImmediateRestart=false, RteEventRef=OpEventGetElapsedValue_GetElapsedValue_OsService_SystemTimer
    Rte (RteBswModuleInstance): RteBswImplementationRef=Rte_Impl, RteBswModuleConfigurationRef=Rte
      Rte_ComSendSignalProxyPeriodicTimingEvent0 (RteBswEventToTaskMapping): RteBswImmediateRestart=false, RteBswEventRef=Rte_ComSendSignalProxyPeriodicTimingEvent0
    Det (RteBswModuleInstance): RteBswImplementationRef=Det_Impl, RteBswModuleConfigurationRef=Det
      DET_EXCLUSIVE_AREA_0 (RteBswExclusiveAreaImpl): RteExclusiveAreaImplMechanism=OS_INTERRUPT_BLOCKING, RteBswExclusiveAreaRef=DET_EXCLUSIVE_AREA_0
    BswM_EcuSwComposition (RteSwComponentInstance): RteSoftwareComponentInstanceRef=BswM
      Timer_BswM_MainFunction (RteEventToTaskMapping):
        RteImmediateRestart = false
        RtePositionInTask = 0
        RteEventRef = Timer_BswM_MainFunction
        RteMappedToTaskRef = Default_BSW_ASync_Task_10ms
        RteUsedOsEventRef = Rte_Ev_Cyclic2_Default_BSW_ASync_Task_10ms_0_10ms
        RteUsedOsAlarmRef = Rte_Al_TE2_Default_BSW_ASync_Task_10ms_0_10ms
    StartApp_EcuSwComposition (RteSwComponentInstance): RteSoftwareComponentInstanceRef=StartApp
      5 x RteEventToTaskMapping, all with RteImmediateRestart=false:
        StartApp_InitEvent: RtePositionInTask=0, RteEventRef=StartApp_InitEvent, RteMappedToTaskRef=Default_Appl_Init_Task
        TMT_StartApp_Cyclic1ms: RtePositionInTask=0, RteEventRef=TMT_StartApp_Cyclic1ms, RteMappedToTaskRef=Default_Appl_Task, RteUsedOsEventRef=Rte_Ev_Run_StartApp_StartApp_Cyclic1ms, RteUsedOsAlarmRef=Rte_Al_TE_StartApp_StartApp_Cyclic1ms
        TMT_StartApp_Cyclic500ms: RtePositionInTask=2, RteEventRef=TMT_StartApp_Cyclic500ms, RteMappedToTaskRef=Default_Appl_Task, RteUsedOsEventRef=Rte_Ev_Run_StartApp_StartApp_Cyclic250ms, RteUsedOsAlarmRef=Rte_Al_TE_StartApp_StartApp_Cyclic250ms
        TMT_StartApp_Cyclic10ms: RtePositionInTask=1, RteEventRef=TMT_StartApp_Cyclic10ms, RteMappedToTaskRef=Default_Appl_Task, RteUsedOsEventRef=Rte_Ev_Run_StartApp_StartApp_Cyclic10ms, RteUsedOsAlarmRef=Rte_Al_TE_StartApp_StartApp_Cyclic10ms
        TMT_StartApp_Cyclic1000ms: RtePositionInTask=3, RteEventRef=TMT_StartApp_Cyclic1000ms, RteMappedToTaskRef=Default_Appl_Task, RteUsedOsEventRef=Rte_Ev_Run_StartApp_StartApp_Cyclic1000ms, RteUsedOsAlarmRef=Rte_Al_TE_StartApp_StartApp_Cyclic1000ms
    StartApp (RteSwComponentType): RteComponentTypeRef=StartApp, RteImplementationRef=StartApp_Implementation
      ComponentTypeCalibration (RteComponentTypeCalibration): RteCalibrationSupportEnabled=false
    3 x RteBswModuleInstance:
      McalLib: RteBswImplementationRef=McalLib_Impl, RteBswModuleConfigurationRef=McalLib
        4 x RteBswExclusiveAreaImpl, all with RteExclusiveAreaImplMechanism=OS_INTERRUPT_BLOCKING:
          PeripheralEndInit: RteBswExclusiveAreaRef=PeripheralEndInit
          SafetyEndInit: RteBswExclusiveAreaRef=SafetyEndInit
          CpuEndInit: RteBswExclusiveAreaRef=CpuEndInit
          StmTimerResolution: RteBswExclusiveAreaRef=StmTimerResolution
      ComXf: RteBswImplementationRef=ComXf_Impl, RteBswModuleConfigurationRef=ComXf
      E2EXf: RteBswImplementationRef=E2EXf_Impl, RteBswModuleConfigurationRef=E2EXf
    ComM_EcuSwComposition (RteSwComponentInstance): RteSoftwareComponentInstanceRef=ComM
      13 x RteEventToTaskMapping, all with RteImmediateRestart=false:
        Timer_ComM_MainFunction_0: RtePositionInTask=7, RteEventRef=Timer_ComM_MainFunction_0, RteMappedToTaskRef=Default_BSW_ASync_Task_10ms, RteUsedOsEventRef=Rte_Ev_Cyclic2_Default_BSW_ASync_Task_10ms_0_20ms, RteUsedOsAlarmRef=Rte_Al_TE2_Default_BSW_ASync_Task_10ms_0_20ms
        OpEventGetInhibitionStatus_GetInhibitionStatus_CL_CN_CAN00_5e566ad9: RteEventRef=OpEventGetInhibitionStatus_GetInhibitionStatus_CL_CN_CAN00_5e566ad9
        OpEventGetInhibitionStatus_GetInhibitionStatus_CW_CN_CAN00_5e566ad9: RteEventRef=OpEventGetInhibitionStatus_GetInhibitionStatus_CW_CN_CAN00_5e566ad9
        OpEventLimitECUToNoComMode_LimitECUToNoComMode_modeLimitation: RteEventRef=OpEventLimitECUToNoComMode_LimitECUToNoComMode_modeLimitation
        OpEventReadInhibitCounter_ReadInhibitCounter_modeLimitation: RteEventRef=OpEventReadInhibitCounter_ReadInhibitCounter_modeLimitation
        OpEventResetInhibitCounter_ResetInhibitCounter_modeLimitation: RteEventRef=OpEventResetInhibitCounter_ResetInhibitCounter_modeLimitation
        OpEventSetECUGroupClassification_SetECUGroupClassification_modeLimitation: RteEventRef=OpEventSetECUGroupClassification_SetECUGroupClassification_modeLimitation
        OpEventLimitChannelToNoComMode_LimitChannelToNoComMode_CL_CN_CAN00_5e566ad9: RteEventRef=OpEventLimitChannelToNoComMode_LimitChannelToNoComMode_CL_CN_CAN00_5e566ad9
        OpEventPreventWakeUp_PreventWakeUp_CW_CN_CAN00_5e566ad9: RteEventRef=OpEventPreventWakeUp_PreventWakeUp_CW_CN_CAN00_5e566ad9
        OpEventRequestComMode_RequestComMode_UR_CN_CAN00_06ecbb07: RteEventRef=OpEventRequestComMode_RequestComMode_UR_CN_CAN00_06ecbb07
        OpEventGetCurrentComMode_GetCurrentComMode_UR_CN_CAN00_06ecbb07: RteEventRef=OpEventGetCurrentComMode_GetCurrentComMode_UR_CN_CAN00_06ecbb07
        OpEventGetMaxComMode_GetMaxComMode_UR_CN_CAN00_06ecbb07: RteEventRef=OpEventGetMaxComMode_GetMaxComMode_UR_CN_CAN00_06ecbb07
        OpEventGetRequestedComMode_GetRequestedComMode_UR_CN_CAN00_06ecbb07: RteEventRef=OpEventGetRequestedComMode_GetRequestedComMode_UR_CN_CAN00_06ecbb07
    6 x RteBswModuleInstance:
      Can: RteBswImplementationRef=Can_Impl, RteBswModuleConfigurationRef=Can
        3 x RteBswEventToTaskMapping, all with RteBswImmediateRestart=false:
          Can_MainFunction_BusOffTimingEvent0: RteBswPositionInTask=4, RteBswEventRef=Can_MainFunction_BusOffTimingEvent0, RteBswMappedToTaskRef=Default_BSW_ASync_Task_10ms, RteBswUsedOsEventRef=Rte_Ev_Cyclic2_Default_BSW_ASync_Task_10ms_0_10ms, RteBswUsedOsAlarmRef=Rte_Al_TE2_Default_BSW_ASync_Task_10ms_0_10ms
          Can_MainFunction_WakeupTimingEvent0: RteBswEventRef=Can_MainFunction_WakeupTimingEvent0
          Can_MainFunction_ModeTimingEvent0: RteBswPositionInTask=3, RteBswEventRef=Can_MainFunction_ModeTimingEvent0, RteBswMappedToTaskRef=Default_BSW_ASync_Task_10ms, RteBswUsedOsEventRef=Rte_Ev_Cyclic2_Default_BSW_ASync_Task_10ms_0_10ms, RteBswUsedOsAlarmRef=Rte_Al_TE2_Default_BSW_ASync_Task_10ms_0_10ms
        8 x RteBswExclusiveAreaImpl:
          CAN_EXCLUSIVE_AREA_{0..5}: RteExclusiveAreaImplMechanism=OS_INTERRUPT_BLOCKING, RteBswExclusiveAreaRef=CAN_EXCLUSIVE_AREA_{0..5}
          CAN_EXCLUSIVE_AREA_6: RteExclusiveAreaImplMechanism=CUSTOM, RteBswExclusiveAreaRef=CAN_EXCLUSIVE_AREA_6
          CAN_EXCLUSIVE_AREA_7: RteExclusiveAreaImplMechanism=OS_INTERRUPT_BLOCKING, RteBswExclusiveAreaRef=CAN_EXCLUSIVE_AREA_7
        Can_MainFunction_ReadTimingEvent0 (RteBswEventToTaskMapping):
          RteBswImmediateRestart = false
          RteBswPositionInTask = 6
          RteBswEventRef = Can_MainFunction_ReadTimingEvent0
          RteBswMappedToTaskRef = Default_BSW_ASync_Task_10ms
          RteBswUsedOsEventRef = Rte_Ev_Cyclic2_Default_BSW_ASync_Task_10ms_0_10ms
          RteBswUsedOsAlarmRef = Rte_Al_TE2_Default_BSW_ASync_Task_10ms_0_10ms
        Can_MainFunction_WriteTimingEvent0 (RteBswEventToTaskMapping):
          RteBswImmediateRestart = false
          RteBswPositionInTask = 5
          RteBswEventRef = Can_MainFunction_WriteTimingEvent0
          RteBswMappedToTaskRef = Default_BSW_ASync_Task_10ms
          RteBswUsedOsEventRef = Rte_Ev_Cyclic2_Default_BSW_ASync_Task_10ms_0_10ms
          RteBswUsedOsAlarmRef = Rte_Al_TE2_Default_BSW_ASync_Task_10ms_0_10ms
      CanIf: RteBswImplementationRef=CanIf_Impl, RteBswModuleConfigurationRef=CanIf
        8 x RteBswExclusiveAreaImpl:
          CANIF_EXCLUSIVE_AREA_0: RteExclusiveAreaImplMechanism=CUSTOM, RteBswExclusiveAreaRef=CANIF_EXCLUSIVE_AREA_0
          CANIF_EXCLUSIVE_AREA_{1..7}: RteExclusiveAreaImplMechanism=OS_INTERRUPT_BLOCKING, RteBswExclusiveAreaRef=CANIF_EXCLUSIVE_AREA_{1..7}
      CanSM: RteBswImplementationRef=CanSM_Impl, RteBswModuleConfigurationRef=CanSM
        CanSM_MainFunctionTimingEvent0 (RteBswEventToTaskMapping):
          RteBswImmediateRestart = false
          RteBswPositionInTask = 2
          RteBswEventRef = CanSM_MainFunctionTimingEvent0
          RteBswMappedToTaskRef = Default_BSW_ASync_Task_10ms
          RteBswUsedOsEventRef = Rte_Ev_Cyclic2_Default_BSW_ASync_Task_10ms_0_10ms
          RteBswUsedOsAlarmRef = Rte_Al_TE2_Default_BSW_ASync_Task_10ms_0_10ms
        6 x RteBswExclusiveAreaImpl:
          CANSM_EXCLUSIVE_AREA_1: RteExclusiveAreaImplMechanism=CUSTOM, RteBswExclusiveAreaRef=CANSM_EXCLUSIVE_AREA_1
          CANSM_EXCLUSIVE_AREA_2: RteExclusiveAreaImplMechanism=OS_INTERRUPT_BLOCKING, RteBswExclusiveAreaRef=CANSM_EXCLUSIVE_AREA_2
          CANSM_EXCLUSIVE_AREA_3: RteExclusiveAreaImplMechanism=OS_INTERRUPT_BLOCKING, RteBswExclusiveAreaRef=CANSM_EXCLUSIVE_AREA_3
          CANSM_EXCLUSIVE_AREA_4: RteExclusiveAreaImplMechanism=CUSTOM, RteBswExclusiveAreaRef=CANSM_EXCLUSIVE_AREA_4
          CANSM_EXCLUSIVE_AREA_5: RteExclusiveAreaImplMechanism=OS_INTERRUPT_BLOCKING, RteBswExclusiveAreaRef=CANSM_EXCLUSIVE_AREA_5
          CANSM_EXCLUSIVE_AREA_6: RteExclusiveAreaImplMechanism=OS_INTERRUPT_BLOCKING, RteBswExclusiveAreaRef=CANSM_EXCLUSIVE_AREA_6
      ComM: RteBswImplementationRef=ComM_Impl, RteBswModuleConfigurationRef=ComM
        ComM_MainFunction_0TimingEvent0 (RteBswEventToTaskMapping):
          RteBswImmediateRestart = false
          RteBswPositionInTask = 7
          RteBswEventRef = ComM_MainFunction_0TimingEvent0
          RteBswMappedToTaskRef = Default_BSW_ASync_Task_10ms
          RteBswUsedOsEventRef = Rte_Ev_Cyclic2_Default_BSW_ASync_Task_10ms_0_20ms
          RteBswUsedOsAlarmRef = Rte_Al_TE2_Default_BSW_ASync_Task_10ms_0_20ms
        8 x RteBswExclusiveAreaImpl:
          COMM_EXCLUSIVE_AREA_0: RteExclusiveAreaImplMechanism=OS_INTERRUPT_BLOCKING, RteBswExclusiveAreaRef=COMM_EXCLUSIVE_AREA_0
          COMM_EXCLUSIVE_AREA_1: RteExclusiveAreaImplMechanism=CUSTOM, RteBswExclusiveAreaRef=COMM_EXCLUSIVE_AREA_1
          COMM_EXCLUSIVE_AREA_{2..7}: RteExclusiveAreaImplMechanism=OS_INTERRUPT_BLOCKING, RteBswExclusiveAreaRef=COMM_EXCLUSIVE_AREA_{2..7}
      EcuM: RteBswImplementationRef=EcuM_Impl, RteBswModuleConfigurationRef=EcuM
        EcuM_MainFunctionTimingEvent0 (RteBswEventToTaskMapping):
          RteBswImmediateRestart = false
          RteBswPositionInTask = 1
          RteBswEventRef = EcuM_MainFunctionTimingEvent0
          RteBswMappedToTaskRef = Default_BSW_ASync_Task_10ms
          RteBswUsedOsEventRef = Rte_Ev_Cyclic2_Default_BSW_ASync_Task_10ms_0_10ms
          RteBswUsedOsAlarmRef = Rte_Al_TE2_Default_BSW_ASync_Task_10ms_0_10ms
        4 x RteBswExclusiveAreaImpl, all with RteExclusiveAreaImplMechanism=OS_INTERRUPT_BLOCKING:
          ECUM_EXCLUSIVE_AREA_{0..3}: RteBswExclusiveAreaRef=ECUM_EXCLUSIVE_AREA_{0..3}
        EcuM_MainFunctionTimingEvent1 (RteBswEventToTaskMapping):
          RteBswImmediateRestart = false
          RteBswPositionInTask = 1
          RteBswEventRef = EcuM_MainFunctionTimingEvent1
          RteBswMappedToTaskRef = BswCore1Task
          RteBswUsedOsAlarmRef = Rte_Al_TE2_EcuM_EcuM_MainFunction
      PduR: RteBswImplementationRef=PduR_Impl, RteBswModuleConfigurationRef=PduR
        PDUR_EXCLUSIVE_AREA_0 (RteBswExclusiveAreaImpl): RteExclusiveAreaImplMechanism=OS_INTERRUPT_BLOCKING, RteBswExclusiveAreaRef=PDUR_EXCLUSIVE_AREA_0
    EcuM_EcuSwComposition (RteSwComponentInstance): RteSoftwareComponentInstanceRef=EcuM
      13 x RteEventToTaskMapping, all with RteImmediateRestart=false:
        Timer_EcuM_MainFunction: RtePositionInTask=1, RteEventRef=Timer_EcuM_MainFunction, RteMappedToTaskRef=Default_BSW_ASync_Task_10ms, RteUsedOsEventRef=Rte_Ev_Cyclic2_Default_BSW_ASync_Task_10ms_0_10ms, RteUsedOsAlarmRef=Rte_Al_TE2_Default_BSW_ASync_Task_10ms_0_10ms
        OpEventSelectShutdownTarget_SelectShutdownTarget_EcuM_ShutdownTarget: RteEventRef=OpEventSelectShutdownTarget_SelectShutdownTarget_EcuM_ShutdownTarget
        OpEventGetShutdownTarget_GetShutdownTarget_EcuM_ShutdownTarget: RteEventRef=OpEventGetShutdownTarget_GetShutdownTarget_EcuM_ShutdownTarget
        OpEventGetLastShutdownTarget_GetLastShutdownTarget_EcuM_ShutdownTarget: RteEventRef=OpEventGetLastShutdownTarget_GetLastShutdownTarget_EcuM_ShutdownTarget
        OpEventSelectShutdownCause_SelectShutdownCause_EcuM_ShutdownTarget: RteEventRef=OpEventSelectShutdownCause_SelectShutdownCause_EcuM_ShutdownTarget
        OpEventGetShutdownCause_GetShutdownCause_EcuM_ShutdownTarget: RteEventRef=OpEventGetShutdownCause_GetShutdownCause_EcuM_ShutdownTarget
        OpEventSelectBootTarget_SelectBootTarget_EcuM_BootTarget: RteEventRef=OpEventSelectBootTarget_SelectBootTarget_EcuM_BootTarget
        OpEventGetBootTarget_GetBootTarget_EcuM_BootTarget: RteEventRef=OpEventGetBootTarget_GetBootTarget_EcuM_BootTarget
        OpEventReleasePOSTRUN_ReleasePOSTRUN_StateRequest_EcuMConf_EcuMFixedUserConfig_EcuMFixedUserConfig: RteEventRef=OpEventReleasePOSTRUN_ReleasePOSTRUN_StateRequest_EcuMConf_EcuMFixedUserConfig_EcuMFixedUserConfig
        OpEventReleaseRUN_ReleaseRUN_StateRequest_EcuMConf_EcuMFixedUserConfig_EcuMFixedUserConfig: RteEventRef=OpEventReleaseRUN_ReleaseRUN_StateRequest_EcuMConf_EcuMFixedUserConfig_EcuMFixedUserConfig
        OpEventRequestPOSTRUN_RequestPOSTRUN_StateRequest_EcuMConf_EcuMFixedUserConfig_EcuMFixedUserConfig: RteEventRef=OpEventRequestPOSTRUN_RequestPOSTRUN_StateRequest_EcuMConf_EcuMFixedUserConfig_EcuMFixedUserConfig
        OpEventRequestRUN_RequestRUN_StateRequest_EcuMConf_EcuMFixedUserConfig_EcuMFixedUserConfig: RteEventRef=OpEventRequestRUN_RequestRUN_StateRequest_EcuMConf_EcuMFixedUserConfig_EcuMFixedUserConfig
        OpEventGetStateWrapper_GetStateWrapper_StateRequest_EcuMConf_EcuMFixedUserConfig_EcuMFixedUserConfig: RteEventRef=OpEventGetStateWrapper_GetStateWrapper_StateRequest_EcuMConf_EcuMFixedUserConfig_EcuMFixedUserConfig
    9 x RteBswModuleInstance:
      Com: RteBswImplementationRef=Com_Impl, RteBswModuleConfigurationRef=Com
        3 x RteBswExclusiveAreaImpl, all with RteExclusiveAreaImplMechanism=OS_INTERRUPT_BLOCKING:
          COM_EXCLUSIVE_AREA_TX: RteBswExclusiveAreaRef=COM_EXCLUSIVE_AREA_TX
          COM_EXCLUSIVE_AREA_RX: RteBswExclusiveAreaRef=COM_EXCLUSIVE_AREA_RX
          COM_EXCLUSIVE_AREA_BOTH: RteBswExclusiveAreaRef=COM_EXCLUSIVE_AREA_BOTH
        Com_MainFunctionTx_ComMainFunctionTxTimingEvent0 (RteBswEventToTaskMapping):
          RteBswImmediateRestart = false
          RteBswPositionInTask = 9
          RteBswEventRef = Com_MainFunctionTx_ComMainFunctionTxTimingEvent0
          RteBswMappedToTaskRef = Default_BSW_ASync_Task_10ms
          RteBswUsedOsEventRef = Rte_Ev_Run_Com_Com_MainFunctionTx_ComMainFunctionTx
          RteBswUsedOsAlarmRef = Rte_Al_TE_Com_Com_MainFunctionTx_ComMainFunctionTx
        Com_MainFunctionRx_ComMainFunctionRxTimingEvent0 (RteBswEventToTaskMapping):
          RteBswImmediateRestart = false
          RteBswPositionInTask = 8
          RteBswEventRef = Com_MainFunctionRx_ComMainFunctionRxTimingEvent0
          RteBswMappedToTaskRef = Default_BSW_ASync_Task_10ms
          RteBswUsedOsEventRef = Rte_Ev_Cyclic2_Default_BSW_ASync_Task_10ms_0_10ms
          RteBswUsedOsAlarmRef = Rte_Al_TE2_Default_BSW_ASync_Task_10ms_0_10ms
      Dio: RteBswImplementationRef=Dio_Impl, RteBswModuleConfigurationRef=Dio
      Port: RteBswImplementationRef=Port_Impl, RteBswModuleConfigurationRef=Port
      Mcu: RteBswImplementationRef=Mcu_Impl, RteBswModuleConfigurationRef=Mcu
        TomTgcReg (RteBswExclusiveAreaImpl): RteExclusiveAreaImplMechanism=OS_INTERRUPT_BLOCKING, RteBswExclusiveAreaRef=TomTgcReg
        AtomAgcReg (RteBswExclusiveAreaImpl): RteExclusiveAreaImplMechanism=OS_INTERRUPT_BLOCKING, RteBswExclusiveAreaRef=AtomAgcReg
      Spi: RteBswImplementationRef=Spi_Impl, RteBswModuleConfigurationRef=Spi
        11 x RteBswExclusiveAreaImpl, all with RteExclusiveAreaImplMechanism=OS_INTERRUPT_BLOCKING:
          Buffer_Update: RteBswExclusiveAreaRef=Buffer_Update
          SyncLock: RteBswExclusiveAreaRef=SyncLock
          ChannelLock: RteBswExclusiveAreaRef=ChannelLock
          Cancel_Seq: RteBswExclusiveAreaRef=Cancel_Seq
          Queue_Update_QSPI{0..5}: RteBswExclusiveAreaRef=Queue_Update_QSPI{0..5}
          Queue_Update: RteBswExclusiveAreaRef=Queue_Update
        Spi_MainFunction_HandlingTimingEvent0 (RteBswEventToTaskMapping): RteBswImmediateRestart=false, RteBswEventRef=Spi_MainFunction_HandlingTimingEvent0
      Adc: RteBswImplementationRef=Adc_Impl, RteBswModuleConfigurationRef=Adc
        KernelData (RteBswExclusiveAreaImpl): RteExclusiveAreaImplMechanism=OS_INTERRUPT_BLOCKING, RteBswExclusiveAreaRef=KernelData
        SrcRegAccess (RteBswExclusiveAreaImpl): RteExclusiveAreaImplMechanism=OS_INTERRUPT_BLOCKING, RteBswExclusiveAreaRef=SrcRegAccess
      Dma: RteBswImplementationRef=Dma_Impl, RteBswModuleConfigurationRef=Dma
        9 x RteBswExclusiveAreaImpl, all with RteExclusiveAreaImplMechanism=OS_INTERRUPT_BLOCKING:
          ChannelInitDeinit: RteBswExclusiveAreaRef=ChannelInitDeinit
          ChannelFreezeResume: RteBswExclusiveAreaRef=ChannelFreezeResume
          ChannelHWTrigger: RteBswExclusiveAreaRef=ChannelHWTrigger
          ChannelStartStop: RteBswExclusiveAreaRef=ChannelStartStop
          ChannelSwitchBuffer: RteBswExclusiveAreaRef=ChannelSwitchBuffer
          ChEventStatus: RteBswExclusiveAreaRef=ChEventStatus
          MEErrorStatus: RteBswExclusiveAreaRef=MEErrorStatus
          InterruptStatus: RteBswExclusiveAreaRef=InterruptStatus
          ChannelConfigUpdate: RteBswExclusiveAreaRef=ChannelConfigUpdate
      Irq: RteBswImplementationRef=Irq_Impl, RteBswModuleConfigurationRef=Irq
      Pwm: RteBswImplementationRef=Pwm_Impl, RteBswModuleConfigurationRef=Pwm
        HandleNotification (RteBswExclusiveAreaImpl): RteExclusiveAreaImplMechanism=OS_INTERRUPT_BLOCKING, RteBswExclusiveAreaRef=HandleNotification
        PeriodAndDutyUpdate (RteBswExclusiveAreaImpl): RteExclusiveAreaImplMechanism=OS_INTERRUPT_BLOCKING, RteBswExclusiveAreaRef=PeriodAndDutyUpdate
    MotorControll_EcuSwComposition (RteSwComponentInstance): RteSoftwareComponentInstanceRef=MotorControll
      MotorControll_InitEvent (RteEventToTaskMapping): RteImmediateRestart=false, RtePositionInTask=1, RteEventRef=MotorControll_InitEvent, RteMappedToTaskRef=Default_MotorInitTask
      TMT_MotorControll_MainFunction (RteEventToTaskMapping):
        RteImmediateRestart = false
        RtePositionInTask = 1
        RteEventRef = TMT_MotorControll_MainFunction
        RteMappedToTaskRef = MotorTask
        RteUsedOsEventRef = Rte_Ev_Cyclic_MotorTask_0_1ms
        RteUsedOsAlarmRef = Rte_Al_TE_MotorTask_0_1ms
    MotorControll (RteSwComponentType): RteComponentTypeRef=MotorControll, RteImplementationRef=MotorControll_Implementation
      ComponentTypeCalibration (RteComponentTypeCalibration): RteCalibrationSupportEnabled=false
    MotorCdd_EcuSwComposition (RteSwComponentInstance): RteSoftwareComponentInstanceRef=MotorCdd
      4 x RteEventToTaskMapping, all with RteImmediateRestart=false:
        MotorCdd_InitEvent: RtePositionInTask=0, RteEventRef=MotorCdd_InitEvent, RteMappedToTaskRef=Default_MotorInitTask
        OIT_MotorPp_MotorCdd_EnableInverter_EnableInverterswitch_Pp_MotorCdd_EnableInverter_EnableInverter: RteEventRef=OIT_MotorPp_MotorCdd_EnableInverter_EnableInverterswitch_Pp_MotorCdd_EnableInverter_EnableInverter
        EXTO_AdcSampleReady_Rp_AdcSampleReady_AdcSampleReady: RtePositionInTask=2, RteEventRef=EXTO_AdcSampleReady_Rp_AdcSampleReady_AdcSampleReady, RteMappedToTaskRef=MotorTask, RteUsedOsEventRef=Rte_Ev_Run_MotorCdd_AdcSampleReady_Rp_AdcSampleReady_AdcSampleReady
        TMT_MotorCdd_MainFunction: RtePositionInTask=0, RteEventRef=TMT_MotorCdd_MainFunction, RteMappedToTaskRef=MotorTask, RteUsedOsEventRef=Rte_Ev_Cyclic_MotorTask_0_1ms, RteUsedOsAlarmRef=Rte_Al_TE_MotorTask_0_1ms
    MotorCdd (RteSwComponentType): RteComponentTypeRef=MotorCdd, RteImplementationRef=MotorCdd_Implementation
      ComponentTypeCalibration (RteComponentTypeCalibration): RteCalibrationSupportEnabled=false
    Sbc (RteBswModuleInstance): RteBswImplementationRef=Sbc_Impl, RteBswModuleConfigurationRef=Sbc
      5 x RteBswExclusiveAreaImpl, all with RteExclusiveAreaImplMechanism=OS_INTERRUPT_BLOCKING:
        SBC_EXCLUSIVE_AREA_{0..4}: RteBswExclusiveAreaRef=SBC_EXCLUSIVE_AREA_{0..4}
    Fee (RteBswModuleInstance): RteBswImplementationRef=Fee_Impl, RteBswModuleConfigurationRef=Fee
      Fee_MainFunctionTimingEvent0 (RteBswEventToTaskMapping):
        RteBswImmediateRestart = false
        RteBswPositionInTask = 11
        RteBswEventRef = Fee_MainFunctionTimingEvent0
        RteBswMappedToTaskRef = Default_BSW_ASync_Task_10ms
        RteBswUsedOsEventRef = Rte_Ev_Cyclic2_Default_BSW_ASync_Task_10ms_0_10ms
        RteBswUsedOsAlarmRef = Rte_Al_TE2_Default_BSW_ASync_Task_10ms_0_10ms
    NvM_EcuSwComposition (RteSwComponentInstance): RteSoftwareComponentInstanceRef=NvM
      Timer_NvM_MainFunction (RteEventToTaskMapping):
        RteImmediateRestart = false
        RtePositionInTask = 10
        RteEventRef = Timer_NvM_MainFunction
        RteMappedToTaskRef = Default_BSW_ASync_Task_10ms
        RteUsedOsEventRef = Rte_Ev_Cyclic2_Default_BSW_ASync_Task_10ms_0_10ms
        RteUsedOsAlarmRef = Rte_Al_TE2_Default_BSW_ASync_Task_10ms_0_10ms
    3 x RteBswModuleInstance:
      NvM: RteBswImplementationRef=NvM_Impl, RteBswModuleConfigurationRef=NvM
        NvM_MainFunctionTimingEvent0 (RteBswEventToTaskMapping):
          RteBswImmediateRestart = false
          RteBswPositionInTask = 10
          RteBswEventRef = NvM_MainFunctionTimingEvent0
          RteBswMappedToTaskRef = Default_BSW_ASync_Task_10ms
          RteBswUsedOsEventRef = Rte_Ev_Cyclic2_Default_BSW_ASync_Task_10ms_0_10ms
          RteBswUsedOsAlarmRef = Rte_Al_TE2_Default_BSW_ASync_Task_10ms_0_10ms
        NVM_EXCLUSIVE_AREA_0 (RteBswExclusiveAreaImpl): RteExclusiveAreaImplMechanism=OS_INTERRUPT_BLOCKING, RteBswExclusiveAreaRef=NVM_EXCLUSIVE_AREA_0
      Fls: RteBswImplementationRef=Fls_Impl, RteBswModuleConfigurationRef=Fls
        Fls_17_Dmu_MainFunctionTimingEvent0 (RteBswEventToTaskMapping):
          RteBswImmediateRestart = false
          RteBswPositionInTask = 12
          RteBswEventRef = Fls_17_Dmu_MainFunctionTimingEvent0
          RteBswMappedToTaskRef = Default_BSW_ASync_Task_10ms
          RteBswUsedOsEventRef = Rte_Ev_Cyclic2_Default_BSW_ASync_Task_10ms_0_10ms
          RteBswUsedOsAlarmRef = Rte_Al_TE2_Default_BSW_ASync_Task_10ms_0_10ms
        6 x RteBswExclusiveAreaImpl, all with RteExclusiveAreaImplMechanism=OS_INTERRUPT_BLOCKING:
          Init: RteBswExclusiveAreaRef=Init
          Erase: RteBswExclusiveAreaRef=Erase
          Write: RteBswExclusiveAreaRef=Write
          Main: RteBswExclusiveAreaRef=Main
          ResumeErase: RteBswExclusiveAreaRef=ResumeErase
          UserContentCount: RteBswExclusiveAreaRef=UserContentCount
      Crc: RteBswImplementationRef=Crc_Impl, RteBswModuleConfigurationRef=Crc
        CriticalSection (RteBswExclusiveAreaImpl): RteExclusiveAreaImplMechanism=OS_INTERRUPT_BLOCKING, RteBswExclusiveAreaRef=CriticalSection
    Os_OsCore1_swc_EcuSwComposition (RteSwComponentInstance): RteSoftwareComponentInstanceRef=Os_OsCore1_swc
      OpEventGetCounterValue_GetCounterValue_OsService_SystemTimer1 (RteEventToTaskMapping): RteImmediateRestart=false, RteEventRef=OpEventGetCounterValue_GetCounterValue_OsService_SystemTimer1
      OpEventGetElapsedValue_GetElapsedValue_OsService_SystemTimer1 (RteEventToTaskMapping): RteImmediateRestart=false, RteEventRef=OpEventGetElapsedValue_GetElapsedValue_OsService_SystemTimer1
    Xcp (RteBswModuleInstance): RteBswImplementationRef=Xcp_Impl, RteBswModuleConfigurationRef=Xcp
      Xcp_MainFunctionTimingEvent0 (RteBswEventToTaskMapping): RteBswImmediateRestart=false, RteBswEventRef=Xcp_MainFunctionTimingEvent0
      8 x RteBswExclusiveAreaImpl, all with RteExclusiveAreaImplMechanism=ALL_INTERRUPT_BLOCKING:
        XCP_EXCLUSIVE_AREA_{0..2}: RteBswExclusiveAreaRef=XCP_EXCLUSIVE_AREA_{0..2}
        CANXCP_EXCLUSIVE_AREA_0: RteBswExclusiveAreaRef=CANXCP_EXCLUSIVE_AREA_0
        FRXCP_EXCLUSIVE_AREA_{0..2}: RteBswExclusiveAreaRef=FRXCP_EXCLUSIVE_AREA_{0..2}
        TCPIPXCP_EXCLUSIVE_AREA_0: RteBswExclusiveAreaRef=TCPIPXCP_EXCLUSIVE_AREA_0
      CanXcp_MainFunctionTimingEvent0 (RteBswEventToTaskMapping): RteBswImmediateRestart=false, RteBswEventRef=CanXcp_MainFunctionTimingEvent0
