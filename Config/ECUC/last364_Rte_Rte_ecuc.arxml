AUTOSAR XML (schema 00048)
package /ActiveEcuC
  module config Rte: implementation-config-variant=VARIANT-PRE-COMPILE, module-description=Rte_Impl
    RteOsInteraction
      9 x RteUsedOsActivation, all with RteExpectedActivationOffset=0, RteExpectedTickDuration=0:
        Rte_Al_TE_StartApp_StartApp_Cyclic1000ms: RteActivationOsAlarmRef=Rte_Al_TE_StartApp_StartApp_Cyclic1000ms, RteActivationOsTaskRef=Default_Appl_Task
        Rte_Al_TE_StartApp_StartApp_Cyclic250ms: RteActivationOsAlarmRef=Rte_Al_TE_StartApp_StartApp_Cyclic250ms, RteActivationOsTaskRef=Default_Appl_Task
        Rte_Al_TE_StartApp_StartApp_Cyclic10ms: RteActivationOsAlarmRef=Rte_Al_TE_StartApp_StartApp_Cyclic10ms, RteActivationOsTaskRef=Default_Appl_Task
        Rte_Al_TE_StartApp_StartApp_Cyclic1ms: RteActivationOsAlarmRef=Rte_Al_TE_StartApp_StartApp_Cyclic1ms, RteActivationOsTaskRef=Default_Appl_Task
        Rte_Al_TE2_Default_BSW_ASync_Task_10ms_0_10ms: RteActivationOsAlarmRef=Rte_Al_TE2_Default_BSW_ASync_Task_10ms_0_10ms, RteActivationOsTaskRef=Default_BSW_ASync_Task_10ms
        Rte_Al_TE2_Default_BSW_ASync_Task_10ms_0_20ms: RteActivationOsAlarmRef=Rte_Al_TE2_Default_BSW_ASync_Task_10ms_0_20ms, RteActivationOsTaskRef=Default_BSW_ASync_Task_10ms
        Rte_Al_TE2_EcuM_EcuM_MainFunction: RteActivationOsAlarmRef=Rte_Al_TE2_EcuM_EcuM_MainFunction, RteActivationOsTaskRef=BswCore1Task
        Rte_Al_TE_MotorTask_0_1ms: RteActivationOsAlarmRef=Rte_Al_TE_MotorTask_0_1ms, RteActivationOsTaskRef=MotorTask
        Rte_Al_TE2_Default_BSW_ASync_Task_10ms_0_5ms: RteActivationOsAlarmRef=Rte_Al_TE2_Default_BSW_ASync_Task_10ms_0_5ms, RteActivationOsTaskRef=Default_BSW_ASync_Task_10ms
    RteGeneration:
      RteGenerationMode = COMPATIBILITY_MODE
      RteIocInteractionReturnValue = RTE_IOC
      RteValueRangeCheckEnabled = false
      RteCalibrationSupport = NONE
      RteCodeVendorId = 30
      RteDevErrorDetect = false
      RteDevErrorDetectUninit = false
      RteMeasurementSupport = false
      RteOptimizationMode = RUNTIME
      RteVfbTraceEnabled = false
    RteInitializationBehavior: RteInitializationStrategy=RTE_INITIALIZATION_STRATEGY_AT_DATA_DECLARATION, RteSectionInitializationPolicy=INIT
    RteBswGeneral: RteSchMVersionInfoApi=false, RteUseComShadowSignalApi=false
    BswM (RteBswModuleInstance): RteBswImplementationRef=BswM_Impl, RteBswModuleConfigurationRef=BswM
      BSWM_EXCLUSIVE_AREA_0 (RteBswExclusiveAreaImpl): RteExclusiveAreaImplMechanism=OS_INTERRUPT_BLOCKING, RteBswExclusiveAreaRef=BSWM_EXCLUSIVE_AREA_0
      BswM_MainFunctionTimingEvent0 (RteBswEventToTaskMapping):
        RteBswImmediateRestart = false
        RteBswPositionInTask = 0
        RteBswEventRef = BswM_MainFunctionTimingEvent0
        RteBswMappedToTaskRef = Default_BSW_ASync_Task_10ms
        RteBswUsedOsEventRef = Rte_Ev_Cyclic2_Default_BSW_ASync_Task_10ms_0_10ms
        RteBswUsedOsAlarmRef = Rte_Al_TE2_Default_BSW_ASync_Task_10ms_0_10ms
    Det_EcuSwComposition (RteSwComponentInstance): RteSoftwareComponentInstanceRef=Det
    Os_OsCore0_swc_EcuSwComposition (RteSwComponentInstance): RteSoftwareComponentInstanceRef=Os_OsCore0_swc
      OpEventGetCounterValue_GetCounterValue_OsService_SystemTimer (RteEventToTaskMapping): RteImmediateRestart=false, RteEventRef=OpEventGetCounterValue_GetCounterValue_OsService_SystemTimer
      OpEventGetElapsedValue_GetElapsedValue_OsService_SystemTimer (RteEventToTaskMapping): RteImmediateRestart=false, RteEventRef=OpEventGetElapsedValue_GetElapsedValue_OsService_SystemTimer
    Rte (RteBswModuleInstance): RteBswImplementationRef=Rte_Impl, RteBswModuleConfigurationRef=Rte
      Rte_ComSendSignalProxyPeriodicTimingEvent0 (RteBswEventToTaskMapping): RteBswImmediateRestart=false, RteBswEventRef=Rte_ComSendSignalProxyPeriodicTimingEvent0
    Det (RteBswModuleInstance): RteBswImplementationRef=Det_Impl, RteBswModuleConfigurationRef=Det
      DET_EXCLUSIVE_AREA_0 (RteBswExclusiveAreaImpl): RteExclusiveAreaImplMechanism=OS_INTERRUPT_BLOCKING, RteBswExclusiveAreaRef=DET_EXCLUSIVE_AREA_0
    BswM_EcuSwComposition (RteSwComponentInstance): RteSoftwareComponentInstanceRef=BswM
      Timer_BswM_MainFunction (RteEventToTaskMapping):
        RteImmediateRestart = false
        RtePositionInTask = 0
        RteEventRef = Timer_BswM_MainFunction
        RteMappedToTaskRef = Default_BSW_ASync_Task_10ms
        RteUsedOsEventRef = Rte_Ev_Cyclic2_Default_BSW_ASync_Task_10ms_0_10ms
        RteUsedOsAlarmRef = Rte_Al_TE2_Default_BSW_ASync_Task_10ms_0_10ms
    StartApp_EcuSwComposition (RteSwComponentInstance): RteSoftwareComponentInstanceRef=StartApp
      5 x RteEventToTaskMapping, all with RteImmediateRestart=false:
        StartApp_InitEvent: RtePositionInTask=0, RteEventRef=StartApp_InitEvent, RteMappedToTaskRef=Default_Appl_Init_Task
        TMT_StartApp_Cyclic1ms: RtePositionInTask=0, RteEventRef=TMT_StartApp_Cyclic1ms, RteMappedToTaskRef=Default_Appl_Task, RteUsedOsEventRef=Rte_Ev_Run_StartApp_StartApp_Cyclic1ms, RteUsedOsAlarmRef=Rte_Al_TE_StartApp_StartApp_Cyclic1ms
        TMT_StartApp_Cyclic500ms: RtePositionInTask=2, RteEventRef=TMT_StartApp_Cyclic500ms, RteMappedToTaskRef=Default_Appl_Task, RteUsedOsEventRef=Rte_Ev_Run_StartApp_StartApp_Cyclic250ms, RteUsedOsAlarmRef=Rte_Al_TE_StartApp_StartApp_Cyclic250ms
        TMT_StartApp_Cyclic10ms: RtePositionInTask=1, RteEventRef=TMT_StartApp_Cyclic10ms, RteMappedToTaskRef=Default_Appl_Task, RteUsedOsEventRef=Rte_Ev_Run_StartApp_StartApp_Cyclic10ms, RteUsedOsAlarmRef=Rte_Al_TE_StartApp_StartApp_Cyclic10ms
        TMT_StartApp_Cyclic1000ms: RtePositionInTask=3, RteEventRef=TMT_StartApp_Cyclic1000ms, RteMappedToTaskRef=Default_Appl_Task, RteUsedOsEventRef=Rte_Ev_Run_StartApp_StartApp_Cyclic1000ms, RteUsedOsAlarmRef=Rte_Al_TE_StartApp_StartApp_Cyclic1000ms
    StartApp (RteSwComponentType): RteComponentTypeRef=StartApp, RteImplementationRef=StartApp_Implementation
      ComponentTypeCalibration (RteComponentTypeCalibration): RteCalibrationSupportEnabled=false
    3 x RteBswModuleInstance:
      McalLib: RteBswImplementationRef=McalLib_Impl, RteBswModuleConfigurationRef=McalLib
        4 x RteBswExclusiveAreaImpl, all with RteExclusiveAreaImplMechanism=OS_INTERRUPT_BLOCKING:
          PeripheralEndInit: RteBswExclusiveAreaRef=PeripheralEndInit
          SafetyEndInit: RteBswExclusiveAreaRef=SafetyEndInit
          CpuEndInit: RteBswExclusiveAreaRef=CpuEndInit
          StmTimerResolution: RteBswExclusiveAreaRef=StmTimerResolution
      ComXf: RteBswImplementationRef=ComXf_Impl, RteBswModuleConfigurationRef=ComXf
      E2EXf: RteBswImplementationRef=E2EXf_Impl, RteBswModuleConfigurationRef=E2EXf
    ComM_EcuSwComposition (RteSwComponentInstance): RteSoftwareComponentInstanceRef=ComM
      13 x RteEventToTaskMapping, all with RteImmediateRestart=false:
        Timer_ComM_MainFunction_0: RtePositionInTask=7, RteEventRef=Timer_ComM_MainFunction_0, RteMappedToTaskRef=Default_BSW_ASync_Task_10ms, RteUsedOsEventRef=Rte_Ev_Cyclic2_Default_BSW_ASync_Task_10ms_0_20ms, RteUsedOsAlarmRef=Rte_Al_TE2_Default_BSW_ASync_Task_10ms_0_20ms
        OpEventGetInhibitionStatus_GetInhibitionStatus_CL_CN_CAN00_5e566ad9: RteEventRef=OpEventGetInhibitionStatus_GetInhibitionStatus_CL_CN_CAN00_5e566ad9
        OpEventGetInhibitionStatus_GetInhibitionStatus_CW_CN_CAN00_5e566ad9: RteEventRef=OpEventGetInhibitionStatus_GetInhibitionStatus_CW_CN_CAN00_5e566ad9
        OpEventLimitECUToNoComMode_LimitECUToNoComMode_modeLimitation: RteEventRef=OpEventLimitECUToNoComMode_LimitECUToNoComMode_modeLimitation
        OpEventReadInhibitCounter_ReadInhibitCounter_modeLimitation: RteEventRef=OpEventReadInhibitCounter_ReadInhibitCounter_modeLimitation
        OpEventResetInhibitCounter_ResetInhibitCounter_modeLimitation: RteEventRef=OpEventResetInhibitCounter_ResetInhibitCounter_modeLimitation
        OpEventSetECUGroupClassification_SetECUGroupClassification_modeLimitation: RteEventRef=OpEventSetECUGroupClassification_SetECUGroupClassification_modeLimitation
        OpEventLimitChannelToNoComMode_LimitChannelToNoComMode_CL_CN_CAN00_5e566ad9: RteEventRef=OpEventLimitChannelToNoComMode_LimitChannelToNoComMode_CL_CN_CAN00_5e566ad9
        OpEventPreventWakeUp_PreventWakeUp_CW_CN_CAN00_5e566ad9: RteEventRef=OpEventPreventWakeUp_PreventWakeUp_CW_CN_CAN00_5e566ad9
        OpEventRequestComMode_RequestComMode_UR_CN_CAN00_06ecbb07: RteEventRef=OpEventRequestComMode_RequestComMode_UR_CN_CAN00_06ecbb07
        OpEventGetCurrentComMode_GetCurrentComMode_UR_CN_CAN00_06ecbb07: RteEventRef=OpEventGetCurrentComMode_GetCurrentComMode_UR_CN_CAN00_06ecbb07
        OpEventGetMaxComMode_GetMaxComMode_UR_CN_CAN00_06ecbb07: RteEventRef=OpEventGetMaxComMode_GetMaxComMode_UR_CN_CAN00_06ecbb07
        OpEventGetRequestedComMode_GetRequestedComMode_UR_CN_CAN00_06ecbb07: RteEventRef=OpEventGetRequestedComMode_GetRequestedComMode_UR_CN_CAN00_06ecbb07
    6 x RteBswModuleInstance:
      Can: RteBswImplementationRef=Can_Impl, RteBswModuleConfigurationRef=Can
        3 x RteBswEventToTaskMapping, all with RteBswImmediateRestart=false:
          Can_MainFunction_BusOffTimingEvent0: RteBswPositionInTask=4, RteBswEventRef=Can_MainFunction_BusOffTimingEvent0, RteBswMappedToTaskRef=Default_BSW_ASync_Task_10ms, RteBswUsedOsEventRef=Rte_Ev_Cyclic2_Default_BSW_ASync_Task_10ms_0_10ms, RteBswUsedOsAlarmRef=Rte_Al_TE2_Default_BSW_ASync_Task_10ms_0_10ms
          Can_MainFunction_WakeupTimingEvent0: RteBswEventRef=Can_MainFunction_WakeupTimingEvent0
          Can_MainFunction_ModeTimingEvent0: RteBswPositionInTask=3, RteBswEventRef=Can_MainFunction_ModeTimingEvent0, RteBswMappedToTaskRef=Default_BSW_ASync_Task_10ms, RteBswUsedOsEventRef=Rte_Ev_Cyclic2_Default_BSW_ASync_Task_10ms_0_10ms, RteBswUsedOsAlarmRef=Rte_Al_TE2_Default_BSW_ASync_Task_10ms_0_10ms
        8 x RteBswExclusiveAreaImpl:
          CAN_EXCLUSIVE_AREA_{0..5}: RteExclusiveAreaImplMechanism=OS_INTERRUPT_BLOCKING, RteBswExclusiveAreaRef=CAN_EXCLUSIVE_AREA_{0..5}
          CAN_EXCLUSIVE_AREA_6: RteExclusiveAreaImplMechanism=CUSTOM, RteBswExclusiveAreaRef=CAN_EXCLUSIVE_AREA_6
          CAN_EXCLUSIVE_AREA_7: RteExclusiveAreaImplMechanism=OS_INTERRUPT_BLOCKING, RteBswExclusiveAreaRef=CAN_EXCLUSIVE_AREA_7
        Can_MainFunction_ReadTimingEvent0 (RteBswEventToTaskMapping):
          RteBswImmediateRestart = false
          RteBswPositionInTask = 6
          RteBswEventRef = Can_MainFunction_ReadTimingEvent0
          RteBswMappedToTaskRef = Default_BSW_ASync_Task_10ms
          RteBswUsedOsEventRef = Rte_Ev_Cyclic2_Default_BSW_ASync_Task_10ms_0_10ms
          RteBswUsedOsAlarmRef = Rte_Al_TE2_Default_BSW_ASync_Task_10ms_0_10ms
        Can_MainFunction_WriteTimingEvent0 (RteBswEventToTaskMapping):
          RteBswImmediateRestart = false
          RteBswPositionInTask = 5
          RteBswEventRef = Can_MainFunction_WriteTimingEvent0
          RteBswMappedToTaskRef = Default_BSW_ASync_Task_10ms
          RteBswUsedOsEventRef = Rte_Ev_Cyclic2_Default_BSW_ASync_Task_10ms_0_10ms
          RteBswUsedOsAlarmRef = Rte_Al_TE2_Default_BSW_ASync_Task_10ms_0_10ms
      CanIf: RteBswImplementationRef=CanIf_Impl, RteBswModuleConfigurationRef=CanIf
        8 x RteBswExclusiveAreaImpl:
          CANIF_EXCLUSIVE_AREA_0: RteExclusiveAreaImplMechanism=CUSTOM, RteBswExclusiveAreaRef=CANIF_EXCLUSIVE_AREA_0
          CANIF_EXCLUSIVE_AREA_{1..7}: RteExclusiveAreaImplMechanism=OS_INTERRUPT_BLOCKING, RteBswExclusiveAreaRef=CANIF_EXCLUSIVE_AREA_{1..7}
      CanSM: RteBswImplementationRef=CanSM_Impl, RteBswModuleConfigurationRef=CanSM
        CanSM_MainFunctionTimingEvent0 (RteBswEventToTaskMapping):
          RteBswImmediateRestart = false
          RteBswPositionInTask = 2
          RteBswEventRef = CanSM_MainFunctionTimingEvent0
          RteBswMappedToTaskRef = Default_BSW_ASync_Task_10ms
          RteBswUsedOsEventRef = Rte_Ev_Cyclic2_Default_BSW_ASync_Task_10ms_0_10ms
          RteBswUsedOsAlarmRef = Rte_Al_TE2_Default_BSW_ASync_Task_10ms_0_10ms
        6 x RteBswExclusiveAreaImpl:
          CANSM_EXCLUSIVE_AREA_1: RteExclusiveAreaImplMechanism=CUSTOM, RteBswExclusiveAreaRef=CANSM_EXCLUSIVE_AREA_1
          CANSM_EXCLUSIVE_AREA_2: RteExclusiveAreaImplMechanism=OS_INTERRUPT_BLOCKING, RteBswExclusiveAreaRef=CANSM_EXCLUSIVE_AREA_2
          CANSM_EXCLUSIVE_AREA_3: RteExclusiveAreaImplMechanism=OS_INTERRUPT_BLOCKING, RteBswExclusiveAreaRef=CANSM_EXCLUSIVE_AREA_3
          CANSM_EXCLUSIVE_AREA_4: RteExclusiveAreaImplMechanism=CUSTOM, RteBswExclusiveAreaRef=CANSM_EXCLUSIVE_AREA_4
          CANSM_EXCLUSIVE_AREA_5: RteExclusiveAreaImplMechanism=OS_INTERRUPT_BLOCKING, RteBswExclusiveAreaRef=CANSM_EXCLUSIVE_AREA_5
          CANSM_EXCLUSIVE_AREA_6: RteExclusiveAreaImplMechanism=OS_INTERRUPT_BLOCKING, RteBswExclusiveAreaRef=CANSM_EXCLUSIVE_AREA_6
      ComM: RteBswImplementationRef=ComM_Impl, RteBswModuleConfigurationRef=ComM
        ComM_MainFunction_0TimingEvent0 (RteBswEventToTaskMapping):
          RteBswImmediateRestart = false
          RteBswPositionInTask = 7
          RteBswEventRef = ComM_MainFunction_0TimingEvent0
          RteBswMappedToTaskRef = Default_BSW_ASync_Task_10ms
          RteBswUsedOsEventRef = Rte_Ev_Cyclic2_Default_BSW_ASync_Task_10ms_0_20ms
          RteBswUsedOsAlarmRef = Rte_Al_TE2_Default_BSW_ASync_Task_10ms_0_20ms
        8 x RteBswExclusiveAreaImpl:
          COMM_EXCLUSIVE_AREA_0: RteExclusiveAreaImplMechanism=OS_INTERRUPT_BLOCKING, RteBswExclusiveAreaRef=COMM_EXCLUSIVE_AREA_0
          COMM_EXCLUSIVE_AREA_1: RteExclusiveAreaImplMechanism=CUSTOM, RteBswExclusiveAreaRef=COMM_EXCLUSIVE_AREA_1
          COMM_EXCLUSIVE_AREA_{2..7}: RteExclusiveAreaImplMechanism=OS_INTERRUPT_BLOCKING, RteBswExclusiveAreaRef=COMM_EXCLUSIVE_AREA_{2..7}
      EcuM: RteBswImplementationRef=EcuM_Impl, RteBswModuleConfigurationRef=EcuM
        EcuM_MainFunctionTimingEvent0 (RteBswEventToTaskMapping):
          RteBswImmediateRestart = false
          RteBswPositionInTask = 1
          RteBswEventRef = EcuM_MainFunctionTimingEvent0
          RteBswMappedToTaskRef = Default_BSW_ASync_Task_10ms
          RteBswUsedOsEventRef = Rte_Ev_Cyclic2_Default_BSW_ASync_Task_10ms_0_10ms
          RteBswUsedOsAlarmRef = Rte_Al_TE2_Default_BSW_ASync_Task_10ms_0_10ms
        4 x RteBswExclusiveAreaImpl, all with RteExclusiveAreaImplMechanism=OS_INTERRUPT_BLOCKING:
          ECUM_EXCLUSIVE_AREA_{0..3}: RteBswExclusiveAreaRef=ECUM_EXCLUSIVE_AREA_{0..3}
        EcuM_MainFunctionTimingEvent1 (RteBswEventToTaskMapping):
          RteBswImmediateRestart = false
          RteBswPositionInTask = 1
          RteBswEventRef = EcuM_MainFunctionTimingEvent1
          RteBswMappedToTaskRef = BswCore1Task
          RteBswUsedOsAlarmRef = Rte_Al_TE2_EcuM_EcuM_MainFunction
      PduR: RteBswImplementationRef=PduR_Impl, RteBswModuleConfigurationRef=PduR
        PDUR_EXCLUSIVE_AREA_0 (RteBswExclusiveAreaImpl): RteExclusiveAreaImplMechanism=OS_INTERRUPT_BLOCKING, RteBswExclusiveAreaRef=PDUR_EXCLUSIVE_AREA_0
    EcuM_EcuSwComposition (RteSwComponentInstance): RteSoftwareComponentInstanceRef=EcuM
      13 x RteEventToTaskMapping, all with RteImmediateRestart=false:
        Timer_EcuM_MainFunction: RtePositionInTask=1, RteEventRef=Timer_EcuM_MainFunction, RteMappedToTaskRef=Default_BSW_ASync_Task_10ms, RteUsedOsEventRef=Rte_Ev_Cyclic2_Default_BSW_ASync_Task_10ms_0_10ms, RteUsedOsAlarmRef=Rte_Al_TE2_Default_BSW_ASync_Task_10ms_0_10ms
        OpEventSelectShutdownTarget_SelectShutdownTarget_EcuM_ShutdownTarget: RteEventRef=OpEventSelectShutdownTarget_SelectShutdownTarget_EcuM_ShutdownTarget
        OpEventGetShutdownTarget_GetShutdownTarget_EcuM_ShutdownTarget: RteEventRef=OpEventGetShutdownTarget_GetShutdownTarget_EcuM_ShutdownTarget
        OpEventGetLastShutdownTarget_GetLastShutdownTarget_EcuM_ShutdownTarget: RteEventRef=OpEventGetLastShutdownTarget_GetLastShutdownTarget_EcuM_ShutdownTarget
        OpEventSelectShutdownCause_SelectShutdownCause_EcuM_ShutdownTarget: RteEventRef=OpEventSelectShutdownCause_SelectShutdownCause_EcuM_ShutdownTarget
        OpEventGetShutdownCause_GetShutdownCause_EcuM_ShutdownTarget: RteEventRef=OpEventGetShutdownCause_GetShutdownCause_EcuM_ShutdownTarget
        OpEventSelectBootTarget_SelectBootTarget_EcuM_BootTarget: RteEventRef=OpEventSelectBootTarget_SelectBootTarget_EcuM_BootTarget
        OpEventGetBootTarget_GetBootTarget_EcuM_BootTarget: RteEventRef=OpEventGetBootTarget_GetBootTarget_EcuM_BootTarget
        OpEventReleasePOSTRUN_ReleasePOSTRUN_StateRequest_EcuMConf_EcuMFixedUserConfig_EcuMFixedUserConfig: RteEventRef=OpEventReleasePOSTRUN_ReleasePOSTRUN_StateRequest_EcuMConf_EcuMFixedUserConfig_EcuMFixedUserConfig
        OpEventReleaseRUN_ReleaseRUN_StateRequest_EcuMConf_EcuMFixedUserConfig_EcuMFixedUserConfig: RteEventRef=OpEventReleaseRUN_ReleaseRUN_StateRequest_EcuMConf_EcuMFixedUserConfig_EcuMFixedUserConfig
        OpEventRequestPOSTRUN_RequestPOSTRUN_StateRequest_EcuMConf_EcuMFixedUserConfig_EcuMFixedUserConfig: RteEventRef=OpEventRequestPOSTRUN_RequestPOSTRUN_StateRequest_EcuMConf_EcuMFixedUserConfig_EcuMFixedUserConfig
        OpEventRequestRUN_RequestRUN_StateRequest_EcuMConf_EcuMFixedUserConfig_EcuMFixedUserConfig: RteEventRef=OpEventRequestRUN_RequestRUN_StateRequest_EcuMConf_EcuMFixedUserConfig_EcuMFixedUserConfig
        OpEventGetStateWrapper_GetStateWrapper_StateRequest_EcuMConf_EcuMFixedUserConfig_EcuMFixedUserConfig: RteEventRef=OpEventGetStateWrapper_GetStateWrapper_StateRequest_EcuMConf_EcuMFixedUserConfig_EcuMFixedUserConfig
    9 x RteBswModuleInstance:
      Com: RteBswImplementationRef=Com_Impl, RteBswModuleConfigurationRef=Com
        3 x RteBswExclusiveAreaImpl, all with RteExclusiveAreaImplMechanism=OS_INTERRUPT_BLOCKING:
          COM_EXCLUSIVE_AREA_TX: RteBswExclusiveAreaRef=COM_EXCLUSIVE_AREA_TX
          COM_EXCLUSIVE_AREA_RX: RteBswExclusiveAreaRef=COM_EXCLUSIVE_AREA_RX
          COM_EXCLUSIVE_AREA_BOTH: RteBswExclusiveAreaRef=COM_EXCLUSIVE_AREA_BOTH
        Com_MainFunctionTx_ComMainFunctionTxTimingEvent0 (RteBswEventToTaskMapping):
          RteBswImmediateRestart = false
          RteBswPositionInTask = 9
          RteBswEventRef = Com_MainFunctionTx_ComMainFunctionTxTimingEvent0
          RteBswMappedToTaskRef = Default_BSW_ASync_Task_10ms
          RteBswUsedOsEventRef = Rte_Ev_Cyclic2_Default_BSW_ASync_Task_10ms_0_5ms
          RteBswUsedOsAlarmRef = Rte_Al_TE2_Default_BSW_ASync_Task_10ms_0_5ms
        Com_MainFunctionRx_ComMainFunctionRxTimingEvent0 (RteBswEventToTaskMapping):
          RteBswImmediateRestart = false
          RteBswPositionInTask = 8
          RteBswEventRef = Com_MainFunctionRx_ComMainFunctionRxTimingEvent0
          RteBswMappedToTaskRef = Default_BSW_ASync_Task_10ms
          RteBswUsedOsEventRef = Rte_Ev_Cyclic2_Default_BSW_ASync_Task_10ms_0_10ms
          RteBswUsedOsAlarmRef = Rte_Al_TE2_Default_BSW_ASync_Task_10ms_0_10ms
      Dio: RteBswImplementationRef=Dio_Impl, RteBswModuleConfigurationRef=Dio
      Port: RteBswImplementationRef=Port_Impl, RteBswModuleConfigurationRef=Port
      Mcu: RteBswImplementationRef=Mcu_Impl, RteBswModuleConfigurationRef=Mcu
        TomTgcReg (RteBswExclusiveAreaImpl): RteExclusiveAreaImplMechanism=OS_INTERRUPT_BLOCKING, RteBswExclusiveAreaRef=TomTgcReg
        AtomAgcReg (RteBswExclusiveAreaImpl): RteExclusiveAreaImplMechanism=OS_INTERRUPT_BLOCKING, RteBswExclusiveAreaRef=AtomAgcReg
      Spi: RteBswImplementationRef=Spi_Impl, RteBswModuleConfigurationRef=Spi
        11 x RteBswExclusiveAreaImpl, all with RteExclusiveAreaImplMechanism=OS_INTERRUPT_BLOCKING:
          Buffer_Update: RteBswExclusiveAreaRef=Buffer_Update
          SyncLock: RteBswExclusiveAreaRef=SyncLock
          ChannelLock: RteBswExclusiveAreaRef=ChannelLock
          Cancel_Seq: RteBswExclusiveAreaRef=Cancel_Seq
          Queue_Update_QSPI{0..5}: RteBswExclusiveAreaRef=Queue_Update_QSPI{0..5}
          Queue_Update: RteBswExclusiveAreaRef=Queue_Update
        Spi_MainFunction_HandlingTimingEvent0 (RteBswEventToTaskMapping): RteBswImmediateRestart=false, RteBswEventRef=Spi_MainFunction_HandlingTimingEvent0
      Adc: RteBswImplementationRef=Adc_Impl, RteBswModuleConfigurationRef=Adc
        KernelData (RteBswExclusiveAreaImpl): RteExclusiveAreaImplMechanism=OS_INTERRUPT_BLOCKING, RteBswExclusiveAreaRef=KernelData
        SrcRegAccess (RteBswExclusiveAreaImpl): RteExclusiveAreaImplMechanism=OS_INTERRUPT_BLOCKING, RteBswExclusiveAreaRef=SrcRegAccess
      Dma: RteBswImplementationRef=Dma_Impl, RteBswModuleConfigurationRef=Dma
        9 x RteBswExclusiveAreaImpl, all with RteExclusiveAreaImplMechanism=OS_INTERRUPT_BLOCKING:
          ChannelInitDeinit: RteBswExclusiveAreaRef=ChannelInitDeinit
          ChannelFreezeResume: RteBswExclusiveAreaRef=ChannelFreezeResume
          ChannelHWTrigger: RteBswExclusiveAreaRef=ChannelHWTrigger
          ChannelStartStop: RteBswExclusiveAreaRef=ChannelStartStop
          ChannelSwitchBuffer: RteBswExclusiveAreaRef=ChannelSwitchBuffer
          ChEventStatus: RteBswExclusiveAreaRef=ChEventStatus
          MEErrorStatus: RteBswExclusiveAreaRef=MEErrorStatus
          InterruptStatus: RteBswExclusiveAreaRef=InterruptStatus
          ChannelConfigUpdate: RteBswExclusiveAreaRef=ChannelConfigUpdate
      Irq: RteBswImplementationRef=Irq_Impl, RteBswModuleConfigurationRef=Irq
      Pwm: RteBswImplementationRef=Pwm_Impl, RteBswModuleConfigurationRef=Pwm
        HandleNotification (RteBswExclusiveAreaImpl): RteExclusiveAreaImplMechanism=OS_INTERRUPT_BLOCKING, RteBswExclusiveAreaRef=HandleNotification
        PeriodAndDutyUpdate (RteBswExclusiveAreaImpl): RteExclusiveAreaImplMechanism=OS_INTERRUPT_BLOCKING, RteBswExclusiveAreaRef=PeriodAndDutyUpdate
    MotorControll_EcuSwComposition (RteSwComponentInstance): RteSoftwareComponentInstanceRef=MotorControll
      MotorControll_InitEvent (RteEventToTaskMapping): RteImmediateRestart=false, RtePositionInTask=1, RteEventRef=MotorControll_InitEvent, RteMappedToTaskRef=Default_MotorInitTask
      TMT_MotorControll_MainFunction (RteEventToTaskMapping):
        RteImmediateRestart = false
        RtePositionInTask = 1
        RteEventRef = TMT_MotorControll_MainFunction
        RteMappedToTaskRef = MotorTask
        RteUsedOsEventRef = Rte_Ev_Cyclic_MotorTask_0_1ms
        RteUsedOsAlarmRef = Rte_Al_TE_MotorTask_0_1ms
    MotorControll (RteSwComponentType): RteComponentTypeRef=MotorControll, RteImplementationRef=MotorControll_Implementation
      ComponentTypeCalibration (RteComponentTypeCalibration): RteCalibrationSupportEnabled=false
    MotorCdd_EcuSwComposition (RteSwComponentInstance): RteSoftwareComponentInstanceRef=MotorCdd
      4 x RteEventToTaskMapping, all with RteImmediateRestart=false:
        MotorCdd_InitEvent: RtePositionInTask=0, RteEventRef=MotorCdd_InitEvent, RteMappedToTaskRef=Default_MotorInitTask
        OIT_MotorPp_MotorCdd_EnableInverter_EnableInverterswitch_Pp_MotorCdd_EnableInverter_EnableInverter: RteEventRef=OIT_MotorPp_MotorCdd_EnableInverter_EnableInverterswitch_Pp_MotorCdd_EnableInverter_EnableInverter
        EXTO_AdcSampleReady_Rp_AdcSampleReady_AdcSampleReady: RtePositionInTask=2, RteEventRef=EXTO_AdcSampleReady_Rp_AdcSampleReady_AdcSampleReady, RteMappedToTaskRef=MotorTask, RteUsedOsEventRef=Rte_Ev_Run_MotorCdd_AdcSampleReady_Rp_AdcSampleReady_AdcSampleReady
        TMT_MotorCdd_MainFunction: RtePositionInTask=0, RteEventRef=TMT_MotorCdd_MainFunction, RteMappedToTaskRef=MotorTask, RteUsedOsEventRef=Rte_Ev_Cyclic_MotorTask_0_1ms, RteUsedOsAlarmRef=Rte_Al_TE_MotorTask_0_1ms
    MotorCdd (RteSwComponentType): RteComponentTypeRef=MotorCdd, RteImplementationRef=MotorCdd_Implementation
      ComponentTypeCalibration (RteComponentTypeCalibration): RteCalibrationSupportEnabled=false
    Sbc (RteBswModuleInstance): RteBswImplementationRef=Sbc_Impl, RteBswModuleConfigurationRef=Sbc
      5 x RteBswExclusiveAreaImpl, all with RteExclusiveAreaImplMechanism=OS_INTERRUPT_BLOCKING:
        SBC_EXCLUSIVE_AREA_{0..4}: RteBswExclusiveAreaRef=SBC_EXCLUSIVE_AREA_{0..4}
    Fee (RteBswModuleInstance): RteBswImplementationRef=Fee_Impl, RteBswModuleConfigurationRef=Fee
      Fee_MainFunctionTimingEvent0 (RteBswEventToTaskMapping):
        RteBswImmediateRestart = false
        RteBswPositionInTask = 11
        RteBswEventRef = Fee_MainFunctionTimingEvent0
        RteBswMappedToTaskRef = Default_BSW_ASync_Task_10ms
        RteBswUsedOsEventRef = Rte_Ev_Cyclic2_Default_BSW_ASync_Task_10ms_0_10ms
        RteBswUsedOsAlarmRef = Rte_Al_TE2_Default_BSW_ASync_Task_10ms_0_10ms
    NvM_EcuSwComposition (RteSwComponentInstance): RteSoftwareComponentInstanceRef=NvM
      Timer_NvM_MainFunction (RteEventToTaskMapping):
        RteImmediateRestart = false
        RtePositionInTask = 10
        RteEventRef = Timer_NvM_MainFunction
        RteMappedToTaskRef = Default_BSW_ASync_Task_10ms
        RteUsedOsEventRef = Rte_Ev_Cyclic2_Default_BSW_ASync_Task_10ms_0_10ms
        RteUsedOsAlarmRef = Rte_Al_TE2_Default_BSW_ASync_Task_10ms_0_10ms
    3 x RteBswModuleInstance:
      NvM: RteBswImplementationRef=NvM_Impl, RteBswModuleConfigurationRef=NvM
        NvM_MainFunctionTimingEvent0 (RteBswEventToTaskMapping):
          RteBswImmediateRestart = false
          RteBswPositionInTask = 10
          RteBswEventRef = NvM_MainFunctionTimingEvent0
          RteBswMappedToTaskRef = Default_BSW_ASync_Task_10ms
          RteBswUsedOsEventRef = Rte_Ev_Cyclic2_Default_BSW_ASync_Task_10ms_0_10ms
          RteBswUsedOsAlarmRef = Rte_Al_TE2_Default_BSW_ASync_Task_10ms_0_10ms
        NVM_EXCLUSIVE_AREA_0 (RteBswExclusiveAreaImpl): RteExclusiveAreaImplMechanism=OS_INTERRUPT_BLOCKING, RteBswExclusiveAreaRef=NVM_EXCLUSIVE_AREA_0
      Fls: RteBswImplementationRef=Fls_Impl, RteBswModuleConfigurationRef=Fls
        Fls_17_Dmu_MainFunctionTimingEvent0 (RteBswEventToTaskMapping):
          RteBswImmediateRestart = false
          RteBswPositionInTask = 12
          RteBswEventRef = Fls_17_Dmu_MainFunctionTimingEvent0
          RteBswMappedToTaskRef = Default_BSW_ASync_Task_10ms
          RteBswUsedOsEventRef = Rte_Ev_Cyclic2_Default_BSW_ASync_Task_10ms_0_10ms
          RteBswUsedOsAlarmRef = Rte_Al_TE2_Default_BSW_ASync_Task_10ms_0_10ms
        6 x RteBswExclusiveAreaImpl, all with RteExclusiveAreaImplMechanism=OS_INTERRUPT_BLOCKING:
          Init: RteBswExclusiveAreaRef=Init
          Erase: RteBswExclusiveAreaRef=Erase
          Write: RteBswExclusiveAreaRef=Write
          Main: RteBswExclusiveAreaRef=Main
          ResumeErase: RteBswExclusiveAreaRef=ResumeErase
          UserContentCount: RteBswExclusiveAreaRef=UserContentCount
      Crc: RteBswImplementationRef=Crc_Impl, RteBswModuleConfigurationRef=Crc
        CriticalSection (RteBswExclusiveAreaImpl): RteExclusiveAreaImplMechanism=OS_INTERRUPT_BLOCKING, RteBswExclusiveAreaRef=CriticalSection
    Os_OsCore1_swc_EcuSwComposition (RteSwComponentInstance): RteSoftwareComponentInstanceRef=Os_OsCore1_swc
      OpEventGetCounterValue_GetCounterValue_OsService_SystemTimer1 (RteEventToTaskMapping): RteImmediateRestart=false, RteEventRef=OpEventGetCounterValue_GetCounterValue_OsService_SystemTimer1
      OpEventGetElapsedValue_GetElapsedValue_OsService_SystemTimer1 (RteEventToTaskMapping): RteImmediateRestart=false, RteEventRef=OpEventGetElapsedValue_GetElapsedValue_OsService_SystemTimer1
    4 x RteBswModuleInstance:
      Xcp: RteBswImplementationRef=Xcp_Impl, RteBswModuleConfigurationRef=Xcp
        Xcp_MainFunctionTimingEvent0 (RteBswEventToTaskMapping):
          RteBswImmediateRestart = false
          RteBswPositionInTask = 15
          RteBswEventRef = Xcp_MainFunctionTimingEvent0
          RteBswMappedToTaskRef = Default_BSW_ASync_Task_10ms
          RteBswUsedOsEventRef = Rte_Ev_Cyclic2_Default_BSW_ASync_Task_10ms_0_5ms
          RteBswUsedOsAlarmRef = Rte_Al_TE2_Default_BSW_ASync_Task_10ms_0_5ms
        8 x RteBswExclusiveAreaImpl, all with RteExclusiveAreaImplMechanism=ALL_INTERRUPT_BLOCKING:
          XCP_EXCLUSIVE_AREA_{0..2}: RteBswExclusiveAreaRef=XCP_EXCLUSIVE_AREA_{0..2}
          CANXCP_EXCLUSIVE_AREA_0: RteBswExclusiveAreaRef=CANXCP_EXCLUSIVE_AREA_0
          FRXCP_EXCLUSIVE_AREA_{0..2}: RteBswExclusiveAreaRef=FRXCP_EXCLUSIVE_AREA_{0..2}
          TCPIPXCP_EXCLUSIVE_AREA_0: RteBswExclusiveAreaRef=TCPIPXCP_EXCLUSIVE_AREA_0
        CanXcp_MainFunctionTimingEvent0 (RteBswEventToTaskMapping):
          RteBswImmediateRestart = false
          RteBswPositionInTask = 14
          RteBswEventRef = CanXcp_MainFunctionTimingEvent0
          RteBswMappedToTaskRef = Default_BSW_ASync_Task_10ms
          RteBswUsedOsEventRef = Rte_Ev_Cyclic2_Default_BSW_ASync_Task_10ms_0_5ms
          RteBswUsedOsAlarmRef = Rte_Al_TE2_Default_BSW_ASync_Task_10ms_0_5ms
      CanTp: RteBswImplementationRef=CanTp_Impl, RteBswModuleConfigurationRef=CanTp
        CanTp_MainFunctionTimingEvent0 (RteBswEventToTaskMapping):
          RteBswImmediateRestart = false
          RteBswPositionInTask = 13
          RteBswEventRef = CanTp_MainFunctionTimingEvent0
          RteBswMappedToTaskRef = Default_BSW_ASync_Task_10ms
          RteBswUsedOsEventRef = Rte_Ev_Cyclic2_Default_BSW_ASync_Task_10ms_0_5ms
          RteBswUsedOsAlarmRef = Rte_Al_TE2_Default_BSW_ASync_Task_10ms_0_5ms
        CANTP_EXCLUSIVE_AREA_0 (RteBswExclusiveAreaImpl): RteExclusiveAreaImplMechanism=ALL_INTERRUPT_BLOCKING, RteBswExclusiveAreaRef=CANTP_EXCLUSIVE_AREA_0
      Dcm: RteBswImplementationRef=Dcm_Impl, RteBswModuleConfigurationRef=Dcm
        Dcm_MainFunctionTimingEvent0 (RteBswEventToTaskMapping):
          RteBswImmediateRestart = false
          RteBswPositionInTask = 16
          RteBswEventRef = Dcm_MainFunctionTimingEvent0
          RteBswMappedToTaskRef = Default_BSW_ASync_Task_10ms
          RteBswUsedOsEventRef = Rte_Ev_Cyclic2_Default_BSW_ASync_Task_10ms_0_10ms
          RteBswUsedOsAlarmRef = Rte_Al_TE2_Default_BSW_ASync_Task_10ms_0_10ms
        DCM_EXCLUSIVE_AREA_0 (RteBswExclusiveAreaImpl): RteExclusiveAreaImplMechanism=ALL_INTERRUPT_BLOCKING, RteBswExclusiveAreaRef=DCM_EXCLUSIVE_AREA_0
      Dem: RteBswImplementationRef=Dem_Impl, RteBswModuleConfigurationRef=Dem
        Dem_MasterMainFunctionTimingEvent0 (RteBswEventToTaskMapping):
          RteBswImmediateRestart = false
          RteBswPositionInTask = 17
          RteBswEventRef = Dem_MasterMainFunctionTimingEvent0
          RteBswMappedToTaskRef = Default_BSW_ASync_Task_10ms
          RteBswUsedOsEventRef = Rte_Ev_Cyclic2_Default_BSW_ASync_Task_10ms_0_10ms
          RteBswUsedOsAlarmRef = Rte_Al_TE2_Default_BSW_ASync_Task_10ms_0_10ms
        Dem_SatelliteMainFunctionTimingEvent0 (RteBswEventToTaskMapping):
          RteBswImmediateRestart = false
          RteBswPositionInTask = 18
          RteBswEventRef = Dem_SatelliteMainFunctionTimingEvent0
          RteBswMappedToTaskRef = Default_BSW_ASync_Task_10ms
          RteBswUsedOsEventRef = Rte_Ev_Cyclic2_Default_BSW_ASync_Task_10ms_0_10ms
          RteBswUsedOsAlarmRef = Rte_Al_TE2_Default_BSW_ASync_Task_10ms_0_10ms
        5 x RteBswExclusiveAreaImpl, all with RteExclusiveAreaImplMechanism=ALL_INTERRUPT_BLOCKING:
          DEM_EXCLUSIVE_AREA_{0..4}: RteBswExclusiveAreaRef=DEM_EXCLUSIVE_AREA_{0..4}
    3 x RteSwComponentInstance:
      DemMaster_0_EcuSwComposition: RteSoftwareComponentInstanceRef=DemMaster_0
        27 x RteEventToTaskMapping, all with RteImmediateRestart=false:
          Timer_Dem_MasterMainFunction: RtePositionInTask=17, RteEventRef=Timer_Dem_MasterMainFunction, RteMappedToTaskRef=Default_BSW_ASync_Task_10ms, RteUsedOsEventRef=Rte_Ev_Cyclic2_Default_BSW_ASync_Task_10ms_0_10ms, RteUsedOsAlarmRef=Rte_Al_TE2_Default_BSW_ASync_Task_10ms_0_10ms
          OpEventPostRunRequested_GetPostRunRequested_DemServices: RteEventRef=OpEventPostRunRequested_GetPostRunRequested_DemServices
          OpEventGetDTCStatusAvailabilityMask_GetDTCStatusAvailabilityMask_DemServices: RteEventRef=OpEventGetDTCStatusAvailabilityMask_GetDTCStatusAvailabilityMask_DemServices
          OpEventGetIndicatorStatus_GetIndicatorStatus_IndStatus_WarningIndicator: RteEventRef=OpEventGetIndicatorStatus_GetIndicatorStatus_IndStatus_WarningIndicator
          OpEventGetEventUdsStatus_GetEventUdsStatus_GeneralEvtInfo: RteEventRef=OpEventGetEventUdsStatus_GetEventUdsStatus_GeneralEvtInfo
          OpEventGetEventStatus_GetEventStatus_GeneralEvtInfo: RteEventRef=OpEventGetEventStatus_GetEventStatus_GeneralEvtInfo
          OpEventGetEventFailed_GetEventFailed_GeneralEvtInfo: RteEventRef=OpEventGetEventFailed_GetEventFailed_GeneralEvtInfo
          OpEventGetEventTested_GetEventTested_GeneralEvtInfo: RteEventRef=OpEventGetEventTested_GetEventTested_GeneralEvtInfo
          OpEventGetDTCOfEvent_GetDTCOfEvent_GeneralEvtInfo: RteEventRef=OpEventGetDTCOfEvent_GetDTCOfEvent_GeneralEvtInfo
          OpEventGetFaultDetectionCounter_GetFaultDetectionCounter_GeneralEvtInfo: RteEventRef=OpEventGetFaultDetectionCounter_GetFaultDetectionCounter_GeneralEvtInfo
          OpEventGetEventFreezeFrameDataEx_GetEventFreezeFrameDataEx_GeneralEvtInfo: RteEventRef=OpEventGetEventFreezeFrameDataEx_GetEventFreezeFrameDataEx_GeneralEvtInfo
          OpEventGetEventExtendedDataRecordEx_GetEventExtendedDataRecordEx_GeneralEvtInfo: RteEventRef=OpEventGetEventExtendedDataRecordEx_GetEventExtendedDataRecordEx_GeneralEvtInfo
          OpEventGetEventEnableCondition_GetEventEnableCondition_GeneralEvtInfo: RteEventRef=OpEventGetEventEnableCondition_GetEventEnableCondition_GeneralEvtInfo
          OpEventGetDebouncingOfEvent_GetDebouncingOfEvent_GeneralEvtInfo: RteEventRef=OpEventGetDebouncingOfEvent_GetDebouncingOfEvent_GeneralEvtInfo
          OpEventGetMonitorStatus_GetMonitorStatus_GeneralEvtInfo: RteEventRef=OpEventGetMonitorStatus_GetMonitorStatus_GeneralEvtInfo
          OpEventGetOperationCycleState_GetOperationCycleState_OpCycle_IgnitionCycle: RteEventRef=OpEventGetOperationCycleState_GetOperationCycleState_OpCycle_IgnitionCycle
          OpEventGetOperationCycleState_GetOperationCycleState_OpCycle_OBDDrivingCycle: RteEventRef=OpEventGetOperationCycleState_GetOperationCycleState_OpCycle_OBDDrivingCycle
          OpEventGetOperationCycleState_GetOperationCycleState_OpCycle_PowerCycle: RteEventRef=OpEventGetOperationCycleState_GetOperationCycleState_OpCycle_PowerCycle
          OpEventGetOperationCycleState_GetOperationCycleState_OpCycle_WarmUpCycle: RteEventRef=OpEventGetOperationCycleState_GetOperationCycleState_OpCycle_WarmUpCycle
          OpEventSetOperationCycleState_SetOperationCycleState_OpCycle_IgnitionCycle: RteEventRef=OpEventSetOperationCycleState_SetOperationCycleState_OpCycle_IgnitionCycle
          OpEventSetOperationCycleState_SetOperationCycleState_OpCycle_OBDDrivingCycle: RteEventRef=OpEventSetOperationCycleState_SetOperationCycleState_OpCycle_OBDDrivingCycle
          OpEventSetOperationCycleState_SetOperationCycleState_OpCycle_PowerCycle: RteEventRef=OpEventSetOperationCycleState_SetOperationCycleState_OpCycle_PowerCycle
          OpEventSetOperationCycleState_SetOperationCycleState_OpCycle_WarmUpCycle: RteEventRef=OpEventSetOperationCycleState_SetOperationCycleState_OpCycle_WarmUpCycle
          OpEventClearDTC_ClearDTC_ClearDTC_DemClient: RteEventRef=OpEventClearDTC_ClearDTC_ClearDTC_DemClient
          OpEventSelectDTC_SelectDTC_ClearDTC_DemClient: RteEventRef=OpEventSelectDTC_SelectDTC_ClearDTC_DemClient
          OpEventGetEventMemoryOverflow_GetEventMemoryOverflow_OverflowIndPrimaryMemory_DemClient: RteEventRef=OpEventGetEventMemoryOverflow_GetEventMemoryOverflow_OverflowIndPrimaryMemory_DemClient
          OpEventGetNumberOfEventMemoryEntries_GetNumberOfEventMemoryEntries_OverflowIndPrimaryMemory_DemClient: RteEventRef=OpEventGetNumberOfEventMemoryEntries_GetNumberOfEventMemoryEntries_OverflowIndPrimaryMemory_DemClient
      DemSatellite_0_EcuSwComposition: RteSoftwareComponentInstanceRef=DemSatellite_0
        56 x RteEventToTaskMapping, all with RteImmediateRestart=false:
          Timer_Dem_SatelliteMainFunction: RtePositionInTask=18, RteEventRef=Timer_Dem_SatelliteMainFunction, RteMappedToTaskRef=Default_BSW_ASync_Task_10ms, RteUsedOsEventRef=Rte_Ev_Cyclic2_Default_BSW_ASync_Task_10ms_0_10ms, RteUsedOsAlarmRef=Rte_Al_TE2_Default_BSW_ASync_Task_10ms_0_10ms
          OpEventGetEventUdsStatus_GetEventUdsStatus_EvtInfo_DTC_0x000002: RteEventRef=OpEventGetEventUdsStatus_GetEventUdsStatus_EvtInfo_DTC_0x000002
          OpEventGetEventUdsStatus_GetEventUdsStatus_Event_DTC_0x000002: RteEventRef=OpEventGetEventUdsStatus_GetEventUdsStatus_Event_DTC_0x000002
          OpEventGetEventUdsStatus_GetEventUdsStatus_EvtInfo_DTC_0x000003: RteEventRef=OpEventGetEventUdsStatus_GetEventUdsStatus_EvtInfo_DTC_0x000003
          OpEventGetEventUdsStatus_GetEventUdsStatus_Event_DTC_0x000003: RteEventRef=OpEventGetEventUdsStatus_GetEventUdsStatus_Event_DTC_0x000003
          OpEventGetEventUdsStatus_GetEventUdsStatus_GeneralEvtInfo: RteEventRef=OpEventGetEventUdsStatus_GetEventUdsStatus_GeneralEvtInfo
          OpEventGetEventStatus_GetEventStatus_EvtInfo_DTC_0x000002: RteEventRef=OpEventGetEventStatus_GetEventStatus_EvtInfo_DTC_0x000002
          OpEventGetEventStatus_GetEventStatus_Event_DTC_0x000002: RteEventRef=OpEventGetEventStatus_GetEventStatus_Event_DTC_0x000002
          OpEventGetEventStatus_GetEventStatus_EvtInfo_DTC_0x000003: RteEventRef=OpEventGetEventStatus_GetEventStatus_EvtInfo_DTC_0x000003
          OpEventGetEventStatus_GetEventStatus_Event_DTC_0x000003: RteEventRef=OpEventGetEventStatus_GetEventStatus_Event_DTC_0x000003
          OpEventGetEventStatus_GetEventStatus_GeneralEvtInfo: RteEventRef=OpEventGetEventStatus_GetEventStatus_GeneralEvtInfo
          OpEventGetEventFailed_GetEventFailed_EvtInfo_DTC_0x000002: RteEventRef=OpEventGetEventFailed_GetEventFailed_EvtInfo_DTC_0x000002
          OpEventGetEventFailed_GetEventFailed_Event_DTC_0x000002: RteEventRef=OpEventGetEventFailed_GetEventFailed_Event_DTC_0x000002
          OpEventGetEventFailed_GetEventFailed_EvtInfo_DTC_0x000003: RteEventRef=OpEventGetEventFailed_GetEventFailed_EvtInfo_DTC_0x000003
          OpEventGetEventFailed_GetEventFailed_Event_DTC_0x000003: RteEventRef=OpEventGetEventFailed_GetEventFailed_Event_DTC_0x000003
          OpEventGetEventFailed_GetEventFailed_GeneralEvtInfo: RteEventRef=OpEventGetEventFailed_GetEventFailed_GeneralEvtInfo
          OpEventGetEventTested_GetEventTested_EvtInfo_DTC_0x000002: RteEventRef=OpEventGetEventTested_GetEventTested_EvtInfo_DTC_0x000002
          OpEventGetEventTested_GetEventTested_Event_DTC_0x000002: RteEventRef=OpEventGetEventTested_GetEventTested_Event_DTC_0x000002
          OpEventGetEventTested_GetEventTested_EvtInfo_DTC_0x000003: RteEventRef=OpEventGetEventTested_GetEventTested_EvtInfo_DTC_0x000003
          OpEventGetEventTested_GetEventTested_Event_DTC_0x000003: RteEventRef=OpEventGetEventTested_GetEventTested_Event_DTC_0x000003
          OpEventGetEventTested_GetEventTested_GeneralEvtInfo: RteEventRef=OpEventGetEventTested_GetEventTested_GeneralEvtInfo
          OpEventGetDTCOfEvent_GetDTCOfEvent_EvtInfo_DTC_0x000002: RteEventRef=OpEventGetDTCOfEvent_GetDTCOfEvent_EvtInfo_DTC_0x000002
          OpEventGetDTCOfEvent_GetDTCOfEvent_Event_DTC_0x000002: RteEventRef=OpEventGetDTCOfEvent_GetDTCOfEvent_Event_DTC_0x000002
          OpEventGetDTCOfEvent_GetDTCOfEvent_EvtInfo_DTC_0x000003: RteEventRef=OpEventGetDTCOfEvent_GetDTCOfEvent_EvtInfo_DTC_0x000003
          OpEventGetDTCOfEvent_GetDTCOfEvent_Event_DTC_0x000003: RteEventRef=OpEventGetDTCOfEvent_GetDTCOfEvent_Event_DTC_0x000003
          OpEventGetDTCOfEvent_GetDTCOfEvent_GeneralEvtInfo: RteEventRef=OpEventGetDTCOfEvent_GetDTCOfEvent_GeneralEvtInfo
          OpEventGetFaultDetectionCounter_GetFaultDetectionCounter_EvtInfo_DTC_0x000002: RteEventRef=OpEventGetFaultDetectionCounter_GetFaultDetectionCounter_EvtInfo_DTC_0x000002
          OpEventGetFaultDetectionCounter_GetFaultDetectionCounter_Event_DTC_0x000002: RteEventRef=OpEventGetFaultDetectionCounter_GetFaultDetectionCounter_Event_DTC_0x000002
          OpEventGetFaultDetectionCounter_GetFaultDetectionCounter_EvtInfo_DTC_0x000003: RteEventRef=OpEventGetFaultDetectionCounter_GetFaultDetectionCounter_EvtInfo_DTC_0x000003
          OpEventGetFaultDetectionCounter_GetFaultDetectionCounter_Event_DTC_0x000003: RteEventRef=OpEventGetFaultDetectionCounter_GetFaultDetectionCounter_Event_DTC_0x000003
          OpEventGetFaultDetectionCounter_GetFaultDetectionCounter_GeneralEvtInfo: RteEventRef=OpEventGetFaultDetectionCounter_GetFaultDetectionCounter_GeneralEvtInfo
          OpEventGetEventFreezeFrameDataEx_GetEventFreezeFrameDataEx_EvtInfo_DTC_0x000002: RteEventRef=OpEventGetEventFreezeFrameDataEx_GetEventFreezeFrameDataEx_EvtInfo_DTC_0x000002
          OpEventGetEventFreezeFrameDataEx_GetEventFreezeFrameDataEx_Event_DTC_0x000002: RteEventRef=OpEventGetEventFreezeFrameDataEx_GetEventFreezeFrameDataEx_Event_DTC_0x000002
          OpEventGetEventFreezeFrameDataEx_GetEventFreezeFrameDataEx_EvtInfo_DTC_0x000003: RteEventRef=OpEventGetEventFreezeFrameDataEx_GetEventFreezeFrameDataEx_EvtInfo_DTC_0x000003
          OpEventGetEventFreezeFrameDataEx_GetEventFreezeFrameDataEx_Event_DTC_0x000003: RteEventRef=OpEventGetEventFreezeFrameDataEx_GetEventFreezeFrameDataEx_Event_DTC_0x000003
          OpEventGetEventFreezeFrameDataEx_GetEventFreezeFrameDataEx_GeneralEvtInfo: RteEventRef=OpEventGetEventFreezeFrameDataEx_GetEventFreezeFrameDataEx_GeneralEvtInfo
          OpEventGetEventExtendedDataRecordEx_GetEventExtendedDataRecordEx_EvtInfo_DTC_0x000002: RteEventRef=OpEventGetEventExtendedDataRecordEx_GetEventExtendedDataRecordEx_EvtInfo_DTC_0x000002
          OpEventGetEventExtendedDataRecordEx_GetEventExtendedDataRecordEx_Event_DTC_0x000002: RteEventRef=OpEventGetEventExtendedDataRecordEx_GetEventExtendedDataRecordEx_Event_DTC_0x000002
          OpEventGetEventExtendedDataRecordEx_GetEventExtendedDataRecordEx_EvtInfo_DTC_0x000003: RteEventRef=OpEventGetEventExtendedDataRecordEx_GetEventExtendedDataRecordEx_EvtInfo_DTC_0x000003
          OpEventGetEventExtendedDataRecordEx_GetEventExtendedDataRecordEx_Event_DTC_0x000003: RteEventRef=OpEventGetEventExtendedDataRecordEx_GetEventExtendedDataRecordEx_Event_DTC_0x000003
          OpEventGetEventExtendedDataRecordEx_GetEventExtendedDataRecordEx_GeneralEvtInfo: RteEventRef=OpEventGetEventExtendedDataRecordEx_GetEventExtendedDataRecordEx_GeneralEvtInfo
          OpEventGetEventEnableCondition_GetEventEnableCondition_EvtInfo_DTC_0x000002: RteEventRef=OpEventGetEventEnableCondition_GetEventEnableCondition_EvtInfo_DTC_0x000002
          OpEventGetEventEnableCondition_GetEventEnableCondition_EvtInfo_DTC_0x000003: RteEventRef=OpEventGetEventEnableCondition_GetEventEnableCondition_EvtInfo_DTC_0x000003
          OpEventGetEventEnableCondition_GetEventEnableCondition_GeneralEvtInfo: RteEventRef=OpEventGetEventEnableCondition_GetEventEnableCondition_GeneralEvtInfo
          OpEventGetDebouncingOfEvent_GetDebouncingOfEvent_EvtInfo_DTC_0x000002: RteEventRef=OpEventGetDebouncingOfEvent_GetDebouncingOfEvent_EvtInfo_DTC_0x000002
          OpEventGetDebouncingOfEvent_GetDebouncingOfEvent_EvtInfo_DTC_0x000003: RteEventRef=OpEventGetDebouncingOfEvent_GetDebouncingOfEvent_EvtInfo_DTC_0x000003
          OpEventGetDebouncingOfEvent_GetDebouncingOfEvent_GeneralEvtInfo: RteEventRef=OpEventGetDebouncingOfEvent_GetDebouncingOfEvent_GeneralEvtInfo
          OpEventGetMonitorStatus_GetMonitorStatus_EvtInfo_DTC_0x000002: RteEventRef=OpEventGetMonitorStatus_GetMonitorStatus_EvtInfo_DTC_0x000002
          OpEventGetMonitorStatus_GetMonitorStatus_EvtInfo_DTC_0x000003: RteEventRef=OpEventGetMonitorStatus_GetMonitorStatus_EvtInfo_DTC_0x000003
          OpEventGetMonitorStatus_GetMonitorStatus_GeneralEvtInfo: RteEventRef=OpEventGetMonitorStatus_GetMonitorStatus_GeneralEvtInfo
          OpEventSetEventStatus_SetEventStatus_Event_DTC_0x000002: RteEventRef=OpEventSetEventStatus_SetEventStatus_Event_DTC_0x000002
          OpEventSetEventStatus_SetEventStatus_Event_DTC_0x000003: RteEventRef=OpEventSetEventStatus_SetEventStatus_Event_DTC_0x000003
          OpEventResetEventStatus_ResetEventStatus_Event_DTC_0x000002: RteEventRef=OpEventResetEventStatus_ResetEventStatus_Event_DTC_0x000002
          OpEventResetEventStatus_ResetEventStatus_Event_DTC_0x000003: RteEventRef=OpEventResetEventStatus_ResetEventStatus_Event_DTC_0x000003
          OpEventResetEventDebounceStatus_ResetEventDebounceStatus_Event_DTC_0x000002: RteEventRef=OpEventResetEventDebounceStatus_ResetEventDebounceStatus_Event_DTC_0x000002
          OpEventResetEventDebounceStatus_ResetEventDebounceStatus_Event_DTC_0x000003: RteEventRef=OpEventResetEventDebounceStatus_ResetEventDebounceStatus_Event_DTC_0x000003
      Dcm_EcuSwComposition: RteSoftwareComponentInstanceRef=Dcm
        7 x RteEventToTaskMapping, all with RteImmediateRestart=false:
          Timer_Dcm_MainFunction: RtePositionInTask=16, RteEventRef=Timer_Dcm_MainFunction, RteMappedToTaskRef=Default_BSW_ASync_Task_10ms, RteUsedOsEventRef=Rte_Ev_Cyclic2_Default_BSW_ASync_Task_10ms_0_10ms, RteUsedOsAlarmRef=Rte_Al_TE2_Default_BSW_ASync_Task_10ms_0_10ms
          OpEventGetActiveProtocol_GetActiveProtocol_DCMServices: RteEventRef=OpEventGetActiveProtocol_GetActiveProtocol_DCMServices
          OpEventGetSesCtrlType_GetSesCtrlType_DCMServices: RteEventRef=OpEventGetSesCtrlType_GetSesCtrlType_DCMServices
          OpEventResetToDefaultSession_ResetToDefaultSession_DCMServices: RteEventRef=OpEventResetToDefaultSession_ResetToDefaultSession_DCMServices
          OpEventGetSecurityLevel_GetSecurityLevel_DCMServices: RteEventRef=OpEventGetSecurityLevel_GetSecurityLevel_DCMServices
          OpEventSetActiveDiagnostic_SetActiveDiagnostic_DCMServices: RteEventRef=OpEventSetActiveDiagnostic_SetActiveDiagnostic_DCMServices
          OpEventGetRequestKind_GetRequestKind_DCMServices: RteEventRef=OpEventGetRequestKind_GetRequestKind_DCMServices
    Uart (RteBswModuleInstance): RteBswImplementationRef=Uart_Impl, RteBswModuleConfigurationRef=Uart
      Uart_MainFunction_ReadTimingEvent0 (RteBswEventToTaskMapping): RteBswImmediateRestart=false, RteBswEventRef=Uart_MainFunction_ReadTimingEvent0
      Uart_MainFunction_WriteTimingEvent0 (RteBswEventToTaskMapping): RteBswImmediateRestart=false, RteBswEventRef=Uart_MainFunction_WriteTimingEvent0
    DigApp_EcuSwComposition (RteSwComponentInstance): RteSoftwareComponentInstanceRef=DigApp
      45 x RteEventToTaskMapping, all with RteImmediateRestart=false:
        OIT_DataServices_Spare_Part_Number_Spare_Part_Number_WriteData_DataServices_Spare_Part_Number_Spare_Part_Number_WriteData: RteEventRef=OIT_DataServices_Spare_Part_Number_Spare_Part_Number_WriteData_DataServices_Spare_Part_Number_Spare_Part_Number_WriteData
        OIT_DataServices_Spare_Part_Number_Spare_Part_Number_ConditionCheckRead_DataServices_Spare_Part_Number_Spare_Part_NumberC28D5180: RteEventRef=OIT_DataServices_Spare_Part_Number_Spare_Part_Number_ConditionCheckRead_DataServices_Spare_Part_Number_Spare_Part_NumberC28D5180
        OIT_DataServices_Spare_Part_Number_Spare_Part_Number_ReadData_DataServices_Spare_Part_Number_Spare_Part_Number_ReadData: RteEventRef=OIT_DataServices_Spare_Part_Number_Spare_Part_Number_ReadData_DataServices_Spare_Part_Number_Spare_Part_Number_ReadData
        OIT_DataServices_Vehicle_Identification_VIN_WriteData_DataServices_Vehicle_Identification_VIN_WriteData: RteEventRef=OIT_DataServices_Vehicle_Identification_VIN_WriteData_DataServices_Vehicle_Identification_VIN_WriteData
        OIT_DataServices_Vehicle_Identification_VIN_ConditionCheckRead_DataServices_Vehicle_Identification_VIN_ConditionCheckRead: RteEventRef=OIT_DataServices_Vehicle_Identification_VIN_ConditionCheckRead_DataServices_Vehicle_Identification_VIN_ConditionCheckRead
        OIT_DataServices_Vehicle_Identification_VIN_ReadData_DataServices_Vehicle_Identification_VIN_ReadData: RteEventRef=OIT_DataServices_Vehicle_Identification_VIN_ReadData_DataServices_Vehicle_Identification_VIN_ReadData
        OIT_SecurityAccess_UnlockedL1_CompareKey_SecurityAccess_UnlockedL1_CompareKey: RteEventRef=OIT_SecurityAccess_UnlockedL1_CompareKey_SecurityAccess_UnlockedL1_CompareKey
        OIT_SecurityAccess_UnlockedL1_GetSeed_SecurityAccess_UnlockedL1_GetSeed: RteEventRef=OIT_SecurityAccess_UnlockedL1_GetSeed_SecurityAccess_UnlockedL1_GetSeed
        OIT_DataServices_Boot_Software_NumberOfModules_WriteData_DataServices_Boot_Software_NumberOfModules_WriteData: RteEventRef=OIT_DataServices_Boot_Software_NumberOfModules_WriteData_DataServices_Boot_Software_NumberOfModules_WriteData
        OIT_DataServices_Boot_Software_NumberOfModules_ConditionCheckRead_DataServices_Boot_Software_NumberOfModules_ConditionCheckRead: RteEventRef=OIT_DataServices_Boot_Software_NumberOfModules_ConditionCheckRead_DataServices_Boot_Software_NumberOfModules_ConditionCheckRead
        OIT_DataServices_Boot_Software_NumberOfModules_ReadData_DataServices_Boot_Software_NumberOfModules_ReadData: RteEventRef=OIT_DataServices_Boot_Software_NumberOfModules_ReadData_DataServices_Boot_Software_NumberOfModules_ReadData
        OIT_DataServices_SerialNumber_SerialNumber_WriteData_DataServices_SerialNumber_SerialNumber_WriteData: RteEventRef=OIT_DataServices_SerialNumber_SerialNumber_WriteData_DataServices_SerialNumber_SerialNumber_WriteData
        OIT_DataServices_SerialNumber_SerialNumber_ConditionCheckRead_DataServices_SerialNumber_SerialNumber_ConditionCheckRead: RteEventRef=OIT_DataServices_SerialNumber_SerialNumber_ConditionCheckRead_DataServices_SerialNumber_SerialNumber_ConditionCheckRead
        OIT_DataServices_SerialNumber_SerialNumber_ReadData_DataServices_SerialNumber_SerialNumber_ReadData: RteEventRef=OIT_DataServices_SerialNumber_SerialNumber_ReadData_DataServices_SerialNumber_SerialNumber_ReadData
        OIT_DataServices_DataDiagnosticIdentifier_DID_DataDiagnosticIdentifier_WriteData_DataServices_DataDiagnosticIdentifier_D1EF3D720: RteEventRef=OIT_DataServices_DataDiagnosticIdentifier_DID_DataDiagnosticIdentifier_WriteData_DataServices_DataDiagnosticIdentifier_D1EF3D720
        OIT_DataServices_DataDiagnosticIdentifier_DID_DataDiagnosticIdentifier_ConditionCheckRead_DataServices_DataDiagnosticIdeCC6C9644: RteEventRef=OIT_DataServices_DataDiagnosticIdentifier_DID_DataDiagnosticIdentifier_ConditionCheckRead_DataServices_DataDiagnosticIdeCC6C9644
        OIT_DataServices_DataDiagnosticIdentifier_DID_DataDiagnosticIdentifier_ReadData_DataServices_DataDiagnosticIdentifier_DID8FC9525: RteEventRef=OIT_DataServices_DataDiagnosticIdentifier_DID_DataDiagnosticIdentifier_ReadData_DataServices_DataDiagnosticIdentifier_DID8FC9525
        OIT_DataServices_Hardware_Version_Hardware_Version_Number_WriteData_DataServices_Hardware_Version_Hardware_Version_Numbe125FF288: RteEventRef=OIT_DataServices_Hardware_Version_Hardware_Version_Number_WriteData_DataServices_Hardware_Version_Hardware_Version_Numbe125FF288
        OIT_DataServices_Hardware_Version_Hardware_Version_Number_ConditionCheckRead_DataServices_Hardware_Version_Hardware_Vers10245F7A: RteEventRef=OIT_DataServices_Hardware_Version_Hardware_Version_Number_ConditionCheckRead_DataServices_Hardware_Version_Hardware_Vers10245F7A
        OIT_DataServices_Hardware_Version_Hardware_Version_Number_ReadData_DataServices_Hardware_Version_Hardware_Version_Number62630144: RteEventRef=OIT_DataServices_Hardware_Version_Hardware_Version_Number_ReadData_DataServices_Hardware_Version_Hardware_Version_Number62630144
        OIT_CSDataServices_DID_0x1_DID_Data_GlobalTime_ReadData_CSDataServices_DID_0x1_DID_Data_GlobalTime_ReadData: RteEventRef=OIT_CSDataServices_DID_0x1_DID_Data_GlobalTime_ReadData_CSDataServices_DID_0x1_DID_Data_GlobalTime_ReadData
        OIT_RoutineServices_SampleRoutineControl_RequestResults_RoutineServices_SampleRoutineControl_RequestResults: RteEventRef=OIT_RoutineServices_SampleRoutineControl_RequestResults_RoutineServices_SampleRoutineControl_RequestResults
        OIT_RoutineServices_SampleRoutineControl_Stop_RoutineServices_SampleRoutineControl_Stop: RteEventRef=OIT_RoutineServices_SampleRoutineControl_Stop_RoutineServices_SampleRoutineControl_Stop
        OIT_RoutineServices_SampleRoutineControl_Start_RoutineServices_SampleRoutineControl_Start: RteEventRef=OIT_RoutineServices_SampleRoutineControl_Start_RoutineServices_SampleRoutineControl_Start
        OIT_DataServices_SampleIoControl_DID_Data_ShortTermAdjustment_DataServices_SampleIoControl_DID_Data_ShortTermAdjustment: RteEventRef=OIT_DataServices_SampleIoControl_DID_Data_ShortTermAdjustment_DataServices_SampleIoControl_DID_Data_ShortTermAdjustment
        OIT_DataServices_SampleIoControl_DID_Data_FreezeCurrentState_DataServices_SampleIoControl_DID_Data_FreezeCurrentState: RteEventRef=OIT_DataServices_SampleIoControl_DID_Data_FreezeCurrentState_DataServices_SampleIoControl_DID_Data_FreezeCurrentState
        OIT_DataServices_SampleIoControl_DID_Data_ResetToDefault_DataServices_SampleIoControl_DID_Data_ResetToDefault: RteEventRef=OIT_DataServices_SampleIoControl_DID_Data_ResetToDefault_DataServices_SampleIoControl_DID_Data_ResetToDefault
        OIT_DataServices_SampleIoControl_DID_Data_ReturnControlToECU_DataServices_SampleIoControl_DID_Data_ReturnControlToECU: RteEventRef=OIT_DataServices_SampleIoControl_DID_Data_ReturnControlToECU_DataServices_SampleIoControl_DID_Data_ReturnControlToECU
        OIT_DataServices_SampleIoControl_DID_Data_ReadData_DataServices_SampleIoControl_DID_Data_ReadData: RteEventRef=OIT_DataServices_SampleIoControl_DID_Data_ReadData_DataServices_SampleIoControl_DID_Data_ReadData
        OIT_RoutineServices_SampleRoutineControl_StartOnly_RequestResults_RoutineServices_SampleRoutineControl_StartOnly_RequestResults: RteEventRef=OIT_RoutineServices_SampleRoutineControl_StartOnly_RequestResults_RoutineServices_SampleRoutineControl_StartOnly_RequestResults
        OIT_RoutineServices_SampleRoutineControl_StartOnly_Start_RoutineServices_SampleRoutineControl_StartOnly_Start: RteEventRef=OIT_RoutineServices_SampleRoutineControl_StartOnly_Start_RoutineServices_SampleRoutineControl_StartOnly_Start
        OIT_DataServices_EcuIdentification_Part_Number_WriteData_DataServices_EcuIdentification_Part_Number_WriteData: RteEventRef=OIT_DataServices_EcuIdentification_Part_Number_WriteData_DataServices_EcuIdentification_Part_Number_WriteData
        OIT_DataServices_EcuIdentification_Part_Number_ConditionCheckRead_DataServices_EcuIdentification_Part_Number_ConditionCheckRead: RteEventRef=OIT_DataServices_EcuIdentification_Part_Number_ConditionCheckRead_DataServices_EcuIdentification_Part_Number_ConditionCheckRead
        OIT_DataServices_EcuIdentification_Part_Number_ReadData_DataServices_EcuIdentification_Part_Number_ReadData: RteEventRef=OIT_DataServices_EcuIdentification_Part_Number_ReadData_DataServices_EcuIdentification_Part_Number_ReadData
        OIT_SecurityAccess_Level_3_CompareKey_SecurityAccess_Level_3_CompareKey: RteEventRef=OIT_SecurityAccess_Level_3_CompareKey_SecurityAccess_Level_3_CompareKey
        OIT_SecurityAccess_Level_3_GetSeed_SecurityAccess_Level_3_GetSeed: RteEventRef=OIT_SecurityAccess_Level_3_GetSeed_SecurityAccess_Level_3_GetSeed
        OIT_DataServices_Boot_Software_Boot_Software_Identification_WriteData_DataServices_Boot_Software_Boot_Software_Identific0F39F5E2: RteEventRef=OIT_DataServices_Boot_Software_Boot_Software_Identification_WriteData_DataServices_Boot_Software_Boot_Software_Identific0F39F5E2
        OIT_DataServices_Boot_Software_Boot_Software_Identification_ConditionCheckRead_DataServices_Boot_Software_Boot_Software_F4268183: RteEventRef=OIT_DataServices_Boot_Software_Boot_Software_Identification_ConditionCheckRead_DataServices_Boot_Software_Boot_Software_F4268183
        OIT_DataServices_Boot_Software_Boot_Software_Identification_ReadData_DataServices_Boot_Software_Boot_Software_Identifica719A6842: RteEventRef=OIT_DataServices_Boot_Software_Boot_Software_Identification_ReadData_DataServices_Boot_Software_Boot_Software_Identifica719A6842
        DigInitEvent: RtePositionInTask=1, RteEventRef=DigInitEvent, RteMappedToTaskRef=Default_Appl_Init_Task
        MST_DcmEcuReset_ModeSwitch_{0..4}: RtePositionInTask=5, RteEventRef=MST_DcmEcuReset_ModeSwitch_{0..4}, RteMappedToTaskRef=Default_Appl_Task, RteUsedOsEventRef=Rte_Ev_Run_DigApp_DcmEcuReset_ModeSwitch
    DigApp (RteSwComponentType): RteComponentTypeRef=DigApp, RteImplementationRef=DigApp_Implementation
      ComponentTypeCalibration (RteComponentTypeCalibration): RteCalibrationSupportEnabled=false
    4 x RteBswModuleInstance:
      CanNm: RteBswImplementationRef=CanNm_Impl, RteBswModuleConfigurationRef=CanNm
        CanNm_MainFunctionTimingEvent0 (RteBswEventToTaskMapping): RteBswImmediateRestart=false, RteBswEventRef=CanNm_MainFunctionTimingEvent0
        7 x RteBswExclusiveAreaImpl, all with RteExclusiveAreaImplMechanism=ALL_INTERRUPT_BLOCKING:
          CANNM_EXCLUSIVE_AREA_{0..6}: RteBswExclusiveAreaRef=CANNM_EXCLUSIVE_AREA_{0..6}
      Nm: RteBswImplementationRef=Nm_Impl, RteBswModuleConfigurationRef=Nm
        4 x RteBswExclusiveAreaImpl, all with RteExclusiveAreaImplMechanism=ALL_INTERRUPT_BLOCKING:
          NM_EXCLUSIVE_AREA_{0..3}: RteBswExclusiveAreaRef=NM_EXCLUSIVE_AREA_{0..3}
      Wdg: RteBswImplementationRef=Wdg_Impl, RteBswModuleConfigurationRef=Wdg
        4 x RteBswExclusiveAreaImpl, all with RteExclusiveAreaImplMechanism=ALL_INTERRUPT_BLOCKING:
          TimerHandling: RteBswExclusiveAreaRef=TimerHandling
          ChangeMode: RteBswExclusiveAreaRef=ChangeMode
          Trigger: RteBswExclusiveAreaRef=Trigger
          CpuEndInit: RteBswExclusiveAreaRef=CpuEndInit
      WdgM: RteBswImplementationRef=WdgM_Impl, RteBswModuleConfigurationRef=WdgM
        WDGM_EXCLUSIVE_AREA_0 (RteBswExclusiveAreaImpl): RteExclusiveAreaImplMechanism=ALL_INTERRUPT_BLOCKING, RteBswExclusiveAreaRef=WDGM_EXCLUSIVE_AREA_0
        WdgM_MainFunctionTimingEvent0 (RteBswEventToTaskMapping):
          RteBswImmediateRestart = false
          RteBswPositionInTask = 19
          RteBswEventRef = WdgM_MainFunctionTimingEvent0
          RteBswMappedToTaskRef = Default_BSW_ASync_Task_10ms
          RteBswUsedOsEventRef = Rte_Ev_Cyclic2_Default_BSW_ASync_Task_10ms_0_10ms
          RteBswUsedOsAlarmRef = Rte_Al_TE2_Default_BSW_ASync_Task_10ms_0_10ms
    WdgM_SystemApplication_OsCore0_EcuSwComposition (RteSwComponentInstance): RteSoftwareComponentInstanceRef=WdgM_SystemApplication_OsCore0
      9 x RteEventToTaskMapping, all with RteImmediateRestart=false:
        Timer_WdgM_MainFunction: RtePositionInTask=19, RteEventRef=Timer_WdgM_MainFunction, RteMappedToTaskRef=Default_BSW_ASync_Task_10ms, RteUsedOsEventRef=Rte_Ev_Cyclic2_Default_BSW_ASync_Task_10ms_0_10ms, RteUsedOsAlarmRef=Rte_Al_TE2_Default_BSW_ASync_Task_10ms_0_10ms
        OpEventCheckpointReached_CheckpointReached_alive_WdgMSupervisedEntity: RteEventRef=OpEventCheckpointReached_CheckpointReached_alive_WdgMSupervisedEntity
        OpEventGetLocalStatus_GetLocalStatus_localStatus_WdgMSupervisedEntity: RteEventRef=OpEventGetLocalStatus_GetLocalStatus_localStatus_WdgMSupervisedEntity
        OpEventGetLocalStatus_GetLocalStatus_general_Core0: RteEventRef=OpEventGetLocalStatus_GetLocalStatus_general_Core0
        OpEventGetMode_GetMode_general_Core0: RteEventRef=OpEventGetMode_GetMode_general_Core0
        OpEventGetGlobalStatus_GetGlobalStatus_general_Core0: RteEventRef=OpEventGetGlobalStatus_GetGlobalStatus_general_Core0
        OpEventPerformReset_PerformReset_general_Core0: RteEventRef=OpEventPerformReset_PerformReset_general_Core0
        OpEventSetMode_SetMode_general_Core0: RteEventRef=OpEventSetMode_SetMode_general_Core0
        OpEventGetFirstExpiredSEID_GetFirstExpiredSEID_general_Core0: RteEventRef=OpEventGetFirstExpiredSEID_GetFirstExpiredSEID_general_Core0
    Dsadc (RteBswModuleInstance): RteBswImplementationRef=Dsadc_Impl, RteBswModuleConfigurationRef=Dsadc
      ChannelData (RteBswExclusiveAreaImpl): RteExclusiveAreaImplMechanism=ALL_INTERRUPT_BLOCKING, RteBswExclusiveAreaRef=ChannelData
      IntegratorRestart (RteBswExclusiveAreaImpl): RteExclusiveAreaImplMechanism=ALL_INTERRUPT_BLOCKING, RteBswExclusiveAreaRef=IntegratorRestart
