AUTOSAR XML (schema 00048)
package /ActiveEcuC
  module config Sbc: implementation-config-variant=VARIANT-PRE-COMPILE, module-description=Sbc_Impl
    SbcPublicCfg: SbcSingleInstanceApi=true, SbcDevErrorDetect=true, SbcGetVersionInfo=false, SbcUserConfigFile=
    SbcDevice: SbcDeviceId=0
      SbcInitConfig:
        SbcErrPinMonitor = true
        SbcErrPinMonitorRecovery = false
        SbcErrPinRecoveryTime = ERREC_1_MS
        SbcErrPinMonitorInSleep = false
        SbcSafeState2Delay = SS2DEL_NODELAY
      SbcDeviceAccess
        SbcSpiAccess
          SbcSpiSequence: SbcSpiSequenceRef=SpiSequence_35584
          SbcSpiChannel: SbcSpiChannelRef=SpiChannel_35584
      SbcSystemConfig
        SbcEnableSupplyNormal: SbcEnableLDO_Stby=true, SbcEnableTracker1=true, SbcEnableTracker2=true, SbcEnableLDO_Com=true, SbcEnableVoltRef=true
        SbcEnableSupplyStandby: SbcEnableLDO_Stby=true, SbcEnableTracker1=true, SbcEnableTracker2=true, SbcEnableLDO_Com=true, SbcEnableVoltRef=true
        SbcEnableSupplySleep: SbcEnableLDO_Stby=true
