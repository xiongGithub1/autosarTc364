AUTOSAR XML (schema 00048)
package /ActiveEcuC
  module config Dcm: implementation-config-variant=VARIANT-PRE-COMPILE, module-description=Dcm_Impl
    DcmConfigSet
      DcmDsl
        DcmDslProtocol
          DcmDslProtocolRow_29812fbf (DcmDslProtocolRow):
            DcmDslProtocolEndiannessConvEnabled = false
            DcmDslProtocolID = DCM_UDS_ON_CAN
            DcmDslProtocolPreemptTimeout = 0
            DcmDslProtocolPriority = 0
            DcmSendRespPendOnTransToBoot = true
            DcmTimStrP2ServerAdjust = 0
            DcmTimStrP2StarServerAdjust = 0
            DcmSendRespPendOnRestart = false
            DcmDslProtocolMaximumResponseSize = 4095
            DcmDslProtocolRxBufferID = DcmDslBuffer
            DcmDslProtocolSIDTable = DcmDsdServiceTable
            DcmDslProtocolTxBufferID = DcmDslBuffer
            DcmDemClientRef = DemClient
            DC_0xE001_oMyECU_oCAN00_da5c4252 (DcmDslConnection)
              DC_0xE001_oMyECU_oCAN00_da5c4252 (DcmDslMainConnection): DcmDslProtocolRxTesterSourceAddr=224, DcmDslProtocolRxConnectionId=1
                msg_diag_Response_MyECU_oCAN00_f4dcbbcd_Tx_c184e7e6 (DcmDslProtocolTx): DcmDslTxConfirmationPduId=0, DcmDslProtocolTxPduRef=msg_diag_Response_MyECU_oCAN00_f4dcbbcd_Tx
                msg_diag_Request_MyECU_oCAN00_956934ec_Rx_b73501b5 (DcmDslProtocolRx):
                  DcmDslProtocolRxAddrType = DCM_PHYSICAL_TYPE
                  DcmDslProtocolRxPduId = 0
                  DcmDslProtocolRxChannelId = 0
                  DcmDslProtocolRxComMChannelRef = CN_CAN00_5e566ad9
                  DcmDslProtocolRxPduRef = msg_diag_Request_MyECU_oCAN00_956934ec_Rx
            DcmDslProtocolRx (DcmDslConnection)
              DcmDslMainConnection: DcmDslProtocolRxTesterSourceAddr=0, DcmDslProtocolRxConnectionId=0
                DcmDslProtocolRx:
                  DcmDslProtocolRxAddrType = DCM_FUNCTIONAL_TYPE
                  DcmDslProtocolRxChannelId = 0
                  DcmDslProtocolRxPduId = 1
                  DcmDslProtocolRxPduRef = msg_diag_RequestGlobal_oCAN00_25be229e_Rx
                  DcmDslProtocolRxComMChannelRef = CN_CAN00_5e566ad9
        DcmDslDiagResp: DcmDslDiagRespMaxNumRespPend=0, DcmDslDiagRespOnSecondDeclinedRequest=false, DcmDslDiagRespMaxNumOfDeclinedRequests=3
        DcmDslBuffer: DcmDslBufferSize=50
      DcmGeneral:
        DcmResetToFblAfterSessionFinalResponseEnabled = false
        DcmDevErrorDetect = true
        DcmRequestManufacturerNotificationEnabled = false
        DcmRequestSupplierNotificationEnabled = false
        DcmRespondAllRequest = true
        DcmTaskTime = 0.01
        DcmVersionInfoApi = false
        DcmDspDataDefaultEndianness = LITTLE_ENDIAN
        DcmSafeBswChecks = false
        DcmSupportedIDCalculationSuppressionEnabled = false
        DcmDtrDataProvisionViaDemEnabled = true
        DcmForeignDiagnosticRequestDetectionEnabled = false
        DcmSuppressResponseOnCanTpFuncMixedAddrRequests = false
        DcmSenderReceiverPRPortsEnabled = false
        DcmAutosarVersion = AUTOSAR_4_02_02
        DcmFinalResponseToFblEnabled = true
      DcmDsd
        DcmDsdServiceTable  # ReadMemoryByAddress WriteMemoryByAddress DynamicallyDefineDataId
          12 x DcmDsdService:
            ClearDiagInfo: DcmDsdSidTabServiceId=20, DcmDsdSidTabSubfuncAvail=false
            EcuReset: DcmDsdSidTabServiceId=17, DcmDsdSidTabSubfuncAvail=true
              Hard (DcmDsdSubService): DcmDsdSubServiceId=1
            ControlDtcSetting: DcmDsdSidTabServiceId=133, DcmDsdSidTabSubfuncAvail=true
              Disable (DcmDsdSubService): DcmDsdSubServiceId=2
              Enable (DcmDsdSubService): DcmDsdSubServiceId=1
            WriteDataById: DcmDsdSidTabServiceId=46, DcmDsdSidTabSubfuncAvail=false
            ReadDataById: DcmDsdSidTabServiceId=34, DcmDsdSidTabSubfuncAvail=false
            SecurityAccess: DcmDsdSidTabServiceId=39, DcmDsdSidTabSubfuncAvail=true, DcmDsdSidTabSessionLevelRef=DcmDspSession/Programming, DcmDsdSidTabSessionLevelRef=DcmDspSession/Extended
              4 x DcmDsdSubService, all with DcmDsdSubServiceSessionLevelRef=DcmDspSession/Programming, DcmDsdSubServiceSessionLevelRef=DcmDspSession/Extended:
                SeedLevel1_Request: DcmDsdSubServiceId=1
                sendKey_Send: DcmDsdSubServiceId=4
                requestSeed_Request: DcmDsdSubServiceId=3
                KeyLevel1_Send: DcmDsdSubServiceId=2
            ReadDtcInfo: DcmDsdSidTabServiceId=25, DcmDsdSidTabSubfuncAvail=true
              12 x DcmDsdSubService:
                RNODTCBSMR: DcmDsdSubServiceId=7
                RDTCFDC: DcmDsdSubServiceId=20
                RFCDTC: DcmDsdSubServiceId=12
                RDTCEDRBDN: DcmDsdSubServiceId=6
                RDTCSSI: DcmDsdSubServiceId=3
                RSUPDTC: DcmDsdSubServiceId=10
                RDTCBSM: DcmDsdSubServiceId=2
                RDTCBSMR: DcmDsdSubServiceId=8
                RNODTCBSM: DcmDsdSubServiceId=1
                RDTCSSBDTC: DcmDsdSubServiceId=4
                RMRTFDTC: DcmDsdSubServiceId=13
                RSIODTC: DcmDsdSubServiceId=9
            TesterPresent: DcmDsdSidTabServiceId=62, DcmDsdSidTabSubfuncAvail=true
              TesterPresent (DcmDsdSubService): DcmDsdSubServiceId=0
            CommunicationControl: DcmDsdSidTabServiceId=40, DcmDsdSidTabSubfuncAvail=true, DcmDsdSidTabSessionLevelRef=DcmDspSession/Programming, DcmDsdSidTabSessionLevelRef=DcmDspSession/Extended
              4 x DcmDsdSubService, all with DcmDsdSubServiceSessionLevelRef=DcmDspSession/Programming, DcmDsdSubServiceSessionLevelRef=DcmDspSession/Extended:
                DisableRxAndEnableTx: DcmDsdSubServiceId=2
                EnableRxAndDisableTx: DcmDsdSubServiceId=1
                DisableRxAndTx: DcmDsdSubServiceId=3
                EnableRxAndTx: DcmDsdSubServiceId=0
            RoutineControl: DcmDsdSidTabServiceId=49, DcmDsdSidTabSubfuncAvail=true, DcmDsdSidTabSessionLevelRef=DcmDspSession/Programming, DcmDsdSidTabSessionLevelRef=DcmDspSession/Extended
            IoControlById: DcmDsdSidTabServiceId=47, DcmDsdSidTabSubfuncAvail=false, DcmDsdSidTabSessionLevelRef=DcmDspSession/Extended
            DiagSessionControl: DcmDsdSidTabServiceId=16, DcmDsdSidTabSubfuncAvail=true
              3 x DcmDsdSubService, all with DcmDsdSubServiceSessionLevelRef=DcmDspSession/Extended:
                Programming: DcmDsdSubServiceId=2, DcmDsdSubServiceSessionLevelRef=DcmDspSession/Programming
                Default: DcmDsdSubServiceId=1, DcmDsdSubServiceSessionLevelRef=DcmDspSession/Programming, DcmDsdSubServiceSessionLevelRef=DcmDspSession/Default
                Extended: DcmDsdSubServiceId=3, DcmDsdSubServiceSessionLevelRef=DcmDspSession/Default
      DcmDsp: DcmDspMaxDidToRead=5, DcmDspReadDIDReportsNODIByte=false
        DcmDspSession
          3 x DcmDspSessionRow, all with DcmDspSessionP2ServerMax=0.05, DcmDspSessionP2StarServerMax=5:
            Default: DcmDspSessionLevel=1, DcmDspSessionForBoot=DCM_NO_BOOT
            Programming: DcmDspSessionLevel=2, DcmDspSessionForBoot=DCM_SYS_BOOT
            Extended: DcmDspSessionLevel=3, DcmDspSessionForBoot=DCM_NO_BOOT
        DcmDspSecurity
          UnlockedL1 (DcmDspSecurityRow):
            DcmDspSecurityDelayTime = 10
            DcmDspSecurityDelayTimeOnBoot = 0
            DcmDspSecurityKeySize = 4
            DcmDspSecurityLevel = 1
            DcmDspSecurityNumAttDelay = 3
            DcmDspSecuritySeedSize = 4
            DcmDspSecurityAttemptCounterEnabled = false
            DcmDspSecurityUsePort = USE_ASYNCH_CLIENT_SERVER
          Level_3 (DcmDspSecurityRow):
            DcmDspSecurityDelayTime = 10
            DcmDspSecurityDelayTimeOnBoot = 0
            DcmDspSecurityKeySize = 2
            DcmDspSecurityLevel = 2
            DcmDspSecurityNumAttDelay = 3
            DcmDspSecuritySeedSize = 2
            DcmDspSecurityAttemptCounterEnabled = false
            DcmDspSecurityUsePort = USE_ASYNCH_CLIENT_SERVER
        DidInfo_Hardware_Version (DcmDspDidInfo)
          DcmDspDidAccess
            DcmDspDidWrite
            DcmDspDidRead
        DataInfo_SerialNumber_SerialNumber (DcmDspDataInfo): DcmDspDataFixedLength=true
        3 x DcmDspDid, all with DcmDspDidUsed=true, DcmDspDidUsePort=USE_DATA_ELEMENT_SPECIFIC_INTERFACES:
          DevelopmentData: DcmDspDidIdentifier=256, DcmDspDidInfoRef=DidInfo_DevelopmentData
            5 x DcmDspDidSignal:
              TransportLayerVersion: DcmDspDidDataPos=64, DcmDspDidDataRef=DevelopmentData_TransportLayerVersion
              CanDriverVersion: DcmDspDidDataPos=16, DcmDspDidDataRef=DevelopmentData_CanDriverVersion
              DiagnosticModuleVersion: DcmDspDidDataPos=48, DcmDspDidDataRef=DevelopmentData_DiagnosticModuleVersion
              NmVersion: DcmDspDidDataPos=32, DcmDspDidDataRef=DevelopmentData_NmVersion
              OperatingSystemVersion: DcmDspDidDataPos=0, DcmDspDidDataRef=DevelopmentData_OperatingSystemVersion
          Boot_Software: DcmDspDidIdentifier=61824, DcmDspDidInfoRef=DidInfo_Boot_Software
            NumberOfModules (DcmDspDidSignal): DcmDspDidDataPos=0, DcmDspDidDataRef=Boot_Software_NumberOfModules
            Boot_Software_Identification (DcmDspDidSignal): DcmDspDidDataPos=8, DcmDspDidDataRef=Boot_Software_Boot_Software_Identification
          SampleIoControl: DcmDspDidIdentifier=3, DcmDspDidInfoRef=DidInfo_SampleIoControl
            DID_Data (DcmDspDidSignal): DcmDspDidDataPos=0, DcmDspDidDataRef=SampleIoControl_DID_Data
        SampleRoutineControl (DcmDspRoutine):
          DcmDspRequestResultsRoutineSupported = true
          DcmDspStopRoutineSupported = true
          DcmDspRoutineIdentifier = 256
          DcmDspRoutineFixedLength = false
          DcmDspRoutineUsePort = true
          DcmDspRoutineUsed = true
          DcmDspRoutineInfoRef = RoutineInfo_SampleRoutineControl
        DidInfo_DataDiagnosticIdentifier_DID (DcmDspDidInfo)
          DcmDspDidAccess
            DcmDspDidWrite
            DcmDspDidRead
        DataInfo_DevelopmentData_OperatingSystemVersion (DcmDspDataInfo): DcmDspDataFixedLength=true
        Spare_Part_Number (DcmDspDid): DcmDspDidIdentifier=61831, DcmDspDidUsed=true, DcmDspDidUsePort=USE_DATA_ELEMENT_SPECIFIC_INTERFACES, DcmDspDidInfoRef=DidInfo_Spare_Part_Number
          Spare_Part_Number (DcmDspDidSignal): DcmDspDidDataPos=0, DcmDspDidDataRef=Spare_Part_Number_Spare_Part_Number
        DataInfo_DevelopmentData_TransportLayerVersion (DcmDspDataInfo): DcmDspDataFixedLength=true
        Vehicle_Identification (DcmDspDid):
          DcmDspDidIdentifier = 61840
          DcmDspDidUsed = true
          DcmDspDidUsePort = USE_DATA_ELEMENT_SPECIFIC_INTERFACES
          DcmDspDidInfoRef = DidInfo_Vehicle_Identification
          VIN (DcmDspDidSignal): DcmDspDidDataPos=0, DcmDspDidDataRef=Vehicle_Identification_VIN
        Vehicle_Identification_VIN (DcmDspData): DcmDspDataSize=136, DcmDspDataType=UINT8_N, DcmDspDataUsePort=USE_DATA_ASYNCH_CLIENT_SERVER, DcmDspDataInfoRef=DataInfo_Vehicle_Identification_VIN
        DataInfo_DevelopmentData_DiagnosticModuleVersion (DcmDspDataInfo): DcmDspDataFixedLength=true
        DataInfo_Hardware_Version_Hardware_Version_Number (DcmDspDataInfo): DcmDspDataFixedLength=true
        Hardware_Version (DcmDspDid): DcmDspDidIdentifier=61843, DcmDspDidUsed=true, DcmDspDidUsePort=USE_DATA_ELEMENT_SPECIFIC_INTERFACES, DcmDspDidInfoRef=DidInfo_Hardware_Version
          Hardware_Version_Number (DcmDspDidSignal): DcmDspDidDataPos=0, DcmDspDidDataRef=Hardware_Version_Hardware_Version_Number
        DataInfo_SampleIoControl_DID_Data (DcmDspDataInfo): DcmDspDataFixedLength=true
        DataInfo_Spare_Part_Number_Spare_Part_Number (DcmDspDataInfo): DcmDspDataFixedLength=true
        SampleIoControl_DID_Data (DcmDspData):
          DcmDspDataConditionCheckReadFncUsed = false
          DcmDspDataSize = 32
          DcmDspDataType = UINT32
          DcmDspDataUsePort = USE_DATA_ASYNCH_CLIENT_SERVER
          DcmDspDataInfoRef = DataInfo_SampleIoControl_DID_Data
        EcuIdentification (DcmDspDid): DcmDspDidIdentifier=61833, DcmDspDidUsed=true, DcmDspDidUsePort=USE_DATA_ELEMENT_SPECIFIC_INTERFACES, DcmDspDidInfoRef=DidInfo_EcuIdentification
          Part_Number (DcmDspDidSignal): DcmDspDidDataPos=0, DcmDspDidDataRef=EcuIdentification_Part_Number
        SerialNumber (DcmDspDid): DcmDspDidIdentifier=61836, DcmDspDidUsed=true, DcmDspDidUsePort=USE_DATA_ELEMENT_SPECIFIC_INTERFACES, DcmDspDidInfoRef=DidInfo_SerialNumber
          SerialNumber (DcmDspDidSignal): DcmDspDidDataPos=0, DcmDspDidDataRef=SerialNumber_SerialNumber
        DataInfo_Vehicle_Identification_VIN (DcmDspDataInfo): DcmDspDataFixedLength=true
        DevelopmentData_DiagnosticModuleVersion (DcmDspData):
          DcmDspDataSize = 16
          DcmDspDataType = UINT16
          DcmDspDataUsePort = USE_DATA_ASYNCH_CLIENT_SERVER
          DcmDspDataInfoRef = DataInfo_DevelopmentData_DiagnosticModuleVersion
        DataInfo_DevelopmentData_CanDriverVersion (DcmDspDataInfo): DcmDspDataFixedLength=true
        DidInfo_SerialNumber (DcmDspDidInfo)
          DcmDspDidAccess
            DcmDspDidWrite
            DcmDspDidRead
        RoutineInfo_SampleRoutineControl_StartOnly (DcmDspRoutineInfo)
          DcmDspRoutineRequestResOut
            Out_Result (DcmDspRoutineRequestResOutSignal): DcmDspRoutineSignalLength=32, DcmDspRoutineSignalType=UINT32, DcmDspRoutineSignalEndianness=BIG_ENDIAN, DcmDspRoutineSignalPos=0
          DcmDspStartRoutineIn
            In_Option1 (DcmDspStartRoutineInSignal): DcmDspRoutineSignalLength=24, DcmDspRoutineSignalType=UINT8_N, DcmDspRoutineSignalEndianness=opaque, DcmDspRoutineSignalPos=0
          DcmDspRoutineAuthorization: DcmDspRoutineSessionRef=DcmDspSession/Programming, DcmDspRoutineSessionRef=DcmDspSession/Extended
        DataInfo_EcuIdentification_Part_Number (DcmDspDataInfo): DcmDspDataFixedLength=true
        EcuIdentification_Part_Number (DcmDspData):
          DcmDspDataSize = 104
          DcmDspDataType = UINT8_N
          DcmDspDataUsePort = USE_DATA_ASYNCH_CLIENT_SERVER
          DcmDspDataInfoRef = DataInfo_EcuIdentification_Part_Number
        Spare_Part_Number_Spare_Part_Number (DcmDspData):
          DcmDspDataSize = 32
          DcmDspDataType = UINT32
          DcmDspDataUsePort = USE_DATA_ASYNCH_CLIENT_SERVER
          DcmDspDataInfoRef = DataInfo_Spare_Part_Number_Spare_Part_Number
        DidInfo_DevelopmentData (DcmDspDidInfo)
          DcmDspDidAccess
            DcmDspDidWrite
            DcmDspDidRead
        DidInfo_Spare_Part_Number (DcmDspDidInfo)
          DcmDspDidAccess
            DcmDspDidWrite
            DcmDspDidRead
        DataInfo_DevelopmentData_NmVersion (DcmDspDataInfo): DcmDspDataFixedLength=true
        DataInfo_Boot_Software_Boot_Software_Identification (DcmDspDataInfo): DcmDspDataFixedLength=true
        DidInfo_Boot_Software (DcmDspDidInfo)
          DcmDspDidAccess
            DcmDspDidWrite
            DcmDspDidRead
        DidInfo_SampleIoControl (DcmDspDidInfo)
          DcmDspDidAccess
            DcmDspDidControl:
              DcmDspDidFreezeCurrentState = true
              DcmDspDidResetToDefault = true
              DcmDspDidReturnControlToEcu = true
              DcmDspDidShortTermAdjustment = true
              DcmDspDidControlMask = DCM_CONTROLMASK_INTERNAL
              DcmDspDidControlSessionRef = DcmDspSession/Extended
            DcmDspDidRead
        SerialNumber_SerialNumber (DcmDspData): DcmDspDataSize=32, DcmDspDataType=UINT32, DcmDspDataUsePort=USE_DATA_ASYNCH_CLIENT_SERVER, DcmDspDataInfoRef=DataInfo_SerialNumber_SerialNumber
        DataInfo_DataDiagnosticIdentifier_DID_DataDiagnosticIdentifier (DcmDspDataInfo): DcmDspDataFixedLength=true
        DataInfo_Boot_Software_NumberOfModules (DcmDspDataInfo): DcmDspDataFixedLength=true
        DataDiagnosticIdentifier_DID_DataDiagnosticIdentifier (DcmDspData):
          DcmDspDataSize = 16
          DcmDspDataType = UINT16
          DcmDspDataUsePort = USE_DATA_ASYNCH_CLIENT_SERVER
          DcmDspDataInfoRef = DataInfo_DataDiagnosticIdentifier_DID_DataDiagnosticIdentifier
        ComControl (DcmDspComControl)
          DspComContolAllChannel (DcmDspComControlAllChannel): DcmDspAllComMChannelRef=CN_CAN00_5e566ad9
        Boot_Software_Boot_Software_Identification (DcmDspData):
          DcmDspDataSize = 32
          DcmDspDataType = UINT32
          DcmDspDataUsePort = USE_DATA_ASYNCH_CLIENT_SERVER
          DcmDspDataInfoRef = DataInfo_Boot_Software_Boot_Software_Identification
        DataDiagnosticIdentifier_DID (DcmDspDid):
          DcmDspDidIdentifier = 257
          DcmDspDidUsed = true
          DcmDspDidUsePort = USE_DATA_ELEMENT_SPECIFIC_INTERFACES
          DcmDspDidInfoRef = DidInfo_DataDiagnosticIdentifier_DID
          DataDiagnosticIdentifier (DcmDspDidSignal): DcmDspDidDataPos=0, DcmDspDidDataRef=DataDiagnosticIdentifier_DID_DataDiagnosticIdentifier
        DidInfo_Vehicle_Identification (DcmDspDidInfo)
          DcmDspDidAccess
            DcmDspDidWrite
            DcmDspDidRead
        Hardware_Version_Hardware_Version_Number (DcmDspData):
          DcmDspDataSize = 32
          DcmDspDataType = UINT32
          DcmDspDataUsePort = USE_DATA_ASYNCH_CLIENT_SERVER
          DcmDspDataInfoRef = DataInfo_Hardware_Version_Hardware_Version_Number
        DidInfo_EcuIdentification (DcmDspDidInfo)
          DcmDspDidAccess
            DcmDspDidWrite
            DcmDspDidRead
        4 x DcmDspData, all with DcmDspDataSize=16, DcmDspDataType=UINT16, DcmDspDataUsePort=USE_DATA_ASYNCH_CLIENT_SERVER:
          DevelopmentData_NmVersion: DcmDspDataInfoRef=DataInfo_DevelopmentData_NmVersion
          DevelopmentData_OperatingSystemVersion: DcmDspDataInfoRef=DataInfo_DevelopmentData_OperatingSystemVersion
          DevelopmentData_TransportLayerVersion: DcmDspDataInfoRef=DataInfo_DevelopmentData_TransportLayerVersion
          DevelopmentData_CanDriverVersion: DcmDspDataInfoRef=DataInfo_DevelopmentData_CanDriverVersion
        RoutineInfo_SampleRoutineControl (DcmDspRoutineInfo)
          DcmDspRoutineRequestResOut
            Out_Result (DcmDspRoutineRequestResOutSignal): DcmDspRoutineSignalLength=16, DcmDspRoutineSignalType=UINT16, DcmDspRoutineSignalEndianness=BIG_ENDIAN, DcmDspRoutineSignalPos=0
          DcmDspStartRoutineIn
            In_Option0 (DcmDspStartRoutineInSignal): DcmDspRoutineSignalLength=8, DcmDspRoutineSignalType=UINT8, DcmDspRoutineSignalPos=0
          DcmDspRoutineAuthorization: DcmDspRoutineSessionRef=DcmDspSession/Programming, DcmDspRoutineSessionRef=DcmDspSession/Extended
          DcmDspRoutineStopOut
            Out_StopState (DcmDspRoutineStopOutSignal): DcmDspRoutineSignalLength=32, DcmDspRoutineSignalType=UINT32, DcmDspRoutineSignalEndianness=BIG_ENDIAN, DcmDspRoutineSignalPos=0
          DcmDspStartRoutineOut
            Out_InitState (DcmDspStartRoutineOutSignal): DcmDspRoutineSignalLength=32, DcmDspRoutineSignalType=UINT32, DcmDspRoutineSignalEndianness=BIG_ENDIAN, DcmDspRoutineSignalPos=0
        Boot_Software_NumberOfModules (DcmDspData): DcmDspDataSize=8, DcmDspDataType=UINT8, DcmDspDataUsePort=USE_DATA_ASYNCH_CLIENT_SERVER, DcmDspDataInfoRef=DataInfo_Boot_Software_NumberOfModules
        SampleRoutineControl_StartOnly (DcmDspRoutine):
          DcmDspRequestResultsRoutineSupported = true
          DcmDspStopRoutineSupported = false
          DcmDspRoutineIdentifier = 260
          DcmDspRoutineFixedLength = false
          DcmDspRoutineUsePort = true
          DcmDspRoutineUsed = true
          DcmDspRoutineInfoRef = RoutineInfo_SampleRoutineControl_StartOnly
      DcmPageBufferCfg: DcmPagedBufferEnabled=true
