AUTOSAR XML (schema 00048)
package /ActiveEcuC
  module config Uart: implementation-config-variant=VARIANT-POST-BUILD-LOADABLE, module-description=Uart_Impl
    UartGeneral:
      UartDevErrorDetect = true
      UartRunTimeErrorDetect = true
      UartSafetyEnable = false
      UartVersionInfoApi = false
      UartInitCheckApi = false
      UartDeInitApi = true
      UartStreamingRecvModeApi = false
      UartAbortReadApi = true
      UartAbortWriteApi = true
      UartCsrClksel = ASCLINS
      UartSleepEnable = false
      UartIndex = 0
      UartInitDeInitApiMode = MCAL_SUPERVISOR
      UartTimeoutCount = 4294967295
      UartMainFunctionReadPeriod = 0.005
      UartMainFunctionWritePeriod = 0.005
      UartClockRef = McuClockReferencePointConfig
    UartConfigSet
      UartChannel_0 (UartChannel):
        UartBaudRate = 115200
        UartHwUnit = ASCLIN0
        UartChannelId = 0
        UartAutoCalcBaudParams = true
        UartChanBaudNumerator = 24
        UartChanBaudDenominator = 1000
        UartChanBaudPrescalar = 4
        UartChanBaudOverSampling = 9
        UartRxPinSelection = SELECT_B_PORT15_PIN3
        UartCTSEnable = false
        UartCTSPinSelection = NONE
        UartCTSPolarity = HIGH
        UartDataLength = 8
        UartStopBits = 1
        UartParityBit = NOPARITY
        UartTxChannelMode = INTERRUPT
        UartRxChannelMode = INTERRUPT
        UartNotification:
          UartTransmitNotifPtr = NULL_PTR
          UartReceiveNotifPtr = NULL_PTR
          UartAbortTransmitNotifPtr = NULL_PTR
          UartAbortReceiveNotifPtr = NULL_PTR
          UartStreamingNotifPtr = NULL_PTR
    CommonPublishedInformation:
      ArMajorVersion = 4
      ArMinorVersion = 2
      ArPatchVersion = 2
      SwMajorVersion = 20
      SwMinorVersion = 10
      SwPatchVersion = 0
      ModuleId = 255
      VendorId = 17
      Release = _TRICORE_TC364_TQFP
