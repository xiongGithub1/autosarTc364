AUTOSAR XML (schema 00048)
package /ResourceM
  module config ResourceM: implementation-config-variant=VARIANT-PRE-COMPILE
    ResourceMMcalConfig_0 (ResourceMMcalConfig): ResourceMMasterCore=CORE0
      ResourceMMcalCore_0 (ResourceMMcalCore): ResourceMCoreID=CORE1
      ResourceMMcalCore_1 (ResourceMMcalCore): ResourceMCoreID=CORE0
