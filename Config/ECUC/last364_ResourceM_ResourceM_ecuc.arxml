AUTOSAR XML (schema 00048)
package /ResourceM
  module config ResourceM: implementation-config-variant=VARIANT-PRE-COMPILE
    ResourceMMcalConfig_0 (ResourceMMcalConfig): ResourceMMasterCore=CORE0
      ResourceMMcalCore_0 (ResourceMMcalCore): ResourceMCoreID=CORE0
        3 x ResourceMAllocation:
          ResourceMAllocation: ResourceMModuleName=SPI, ResourceMResourceRef=SpiHwConfigurationQspi_35584
          ResourceMAllocation_001: ResourceMModuleName=ADC, ResourceMResourceRef=AdcHwUnit_ADC8
          ResourceMAllocation_002: ResourceMModuleName=STM, ResourceMResourceRef=McuStmAllocationConf_0
      ResourceMMcalCore_1 (ResourceMMcalCore): ResourceMCoreID=CORE1
        9 x ResourceMAllocation:
          ResourceMAllocation_ADC0: ResourceMModuleName=ADC, ResourceMResourceRef=AdcHwUnit_ADC0
          ResourceMAllocation_ADC3: ResourceMModuleName=ADC, ResourceMResourceRef=AdcHwUnit_ADC3
          ResourceMAllocation_ADC2: ResourceMModuleName=ADC, ResourceMResourceRef=AdcHwUnit_ADC2
          ResourceMAllocation_pwm: ResourceMModuleName=PWM, ResourceMResourceRef=PwmChannel_9180IH1
          ResourceMAllocation: ResourceMModuleName=PWM, ResourceMResourceRef=PwmChannel_9180IH2
          ResourceMAllocation_001: ResourceMModuleName=PWM, ResourceMResourceRef=PwmChannel_9180IH3
          ResourceMAllocation_002: ResourceMModuleName=PWM, ResourceMResourceRef=PwmChannel_9180REF
          ResourceMAllocation_003: ResourceMModuleName=SPI, ResourceMResourceRef=SpiHwConfigurationQspi_9183
          ResourceMAllocation_004: ResourceMModuleName=SPI, ResourceMResourceRef=SpiHwConfigurationQspi_5012
