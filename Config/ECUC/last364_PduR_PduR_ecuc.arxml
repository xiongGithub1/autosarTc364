AUTOSAR XML (schema 00048)
package /ActiveEcuC
  module config PduR: implementation-config-variant=VARIANT-PRE-COMPILE, module-description=PduR_Impl
    PduRGeneral:
      PduRDevErrorDetect = true
      PduRVersionInfoApi = false
      PduRMetaDataSupport = false
      PduRPduCallback = false
      PduRSwitching = false
      PduRSafeBswChecks = false
      PduREnableDeferredTransmission = false
      PduREnableDeferredReception = false
      PduRSupportMulticore = false
      PduRRoutingTypeGateway = false
      PduRSpinlockRetryCounter = 4294967295
      PduRExtendedErrorChecks = false
      PduRGeneration:
        PduROutOfBoundsWriteProtectionStrategy = NONE
        PduROutOfBoundsWriteSanitizer = false
        PduROutOfBoundsReadSanitizer = false
        PduRNumericalDataTypeMinimizationStrategy = WITH_CAST
        PduRReduceConstantData2Define = false
        PduRBoolDataInArrayOfStructStrategy = BITMASKING
        PduRDeduplicateIndirectedData = true
        PduRDataDeduplicationStrategy = WITH_CAST
        PduRReduceBoolDataByNegationThreshold = 2
        PduRReduceBoolDataByNumericalComparisonThreshold = 2
        PduRReduceBoolDataByNumericalRelationThreshold = 2
        PduRReduceBoolDataByNumericalOperandStrategy = WITH_ANY_VALUE
        PduRReduceNumericalDataByOffsetThreshold = 2
        PduRReduceNumericalDataByArraySubtractionThreshold = 2
        PduRReduceDataByStreaming = false
        PduRShortSymbols = false
        PduRInterfacesForDeactivatedData = false
        PduRReferringKeysInComments = false
    PduRRoutingTables: PduRConfigurationId=0
      PduRRoutingTable
        7 x PduRRoutingPath, all with PduRRoutingPathCommunicationType=COMMUNICATION_INTERFACE, PduRMulticoreRoutingPath=false, PduRLockRef=PduRLock_PduRExclusiveArea:
          msg_MyECU_Lamp_oCAN00_818e1651_Tx
            PduRSrcPdu_8e8b997f (PduRSrcPdu): PduRSourcePduHandleId=4, PduRSrcPduDirection=TRANSMIT, PduRSrcPduRef=msg_MyECU_Lamp_oCAN00_818e1651_Tx, PduRSrcPduPduRBswModulesRef=IpduM
            msg_MyECU_Lamp_oCAN00_26f3473b_Tx (PduRDestPdu):
              PduRDestPduHandleId = 4
              PduRDestPduDirection = TRANSMIT
              PduRDestPduRoutingType = API_FORWARDING
              PduRDestPduDataProcessing = IMMEDIATE
              PduRPduLengthHandlingStrategy = IGNORE
              PduRDestPduCrossPartitionDestination = false
              PduRDestPduDataProvision = PDUR_DIRECT
              PduRTransmissionConfirmation = true
              PduRDestPduRef = msg_MyECU_Lamp_oCAN00_26f3473b_Tx
              PduRDestPduPduRBswModulesRef = CanIf
          msg_Receive_oCAN00_3867e0b8_Rx
            PduRSrcPdu_16740ed0 (PduRSrcPdu): PduRSourcePduHandleId=0, PduRSrcPduDirection=RECEIVE, PduRSrcPduRef=msg_Receive_oCAN00_3867e0b8_Rx, PduRSrcPduPduRBswModulesRef=CanIf
            msg_Receive_oCAN00_3867e0b8_Rx_16740ed0_Rx (PduRDestPdu):
              PduRDestPduHandleId = 0
              PduRDestPduDirection = RECEIVE
              PduRDestPduRoutingType = API_FORWARDING
              PduRDestPduDataProcessing = IMMEDIATE
              PduRPduLengthHandlingStrategy = IGNORE
              PduRDestPduCrossPartitionDestination = false
              PduRTransmissionConfirmation = false
              PduRDestPduRef = msg_Receive_oCAN00_2b456e3f_Rx
              PduRDestPduPduRBswModulesRef = Com
          msg_Transmit_oCAN00_0723e95e_Tx
            PduRSrcPdu_087fd70d (PduRSrcPdu): PduRSourcePduHandleId=5, PduRSrcPduDirection=TRANSMIT, PduRSrcPduRef=msg_Transmit_oCAN00_0723e95e_Tx, PduRSrcPduPduRBswModulesRef=Com
            msg_Transmit_oCAN00_9631a86b_Tx (PduRDestPdu):
              PduRDestPduHandleId = 5
              PduRDestPduDirection = TRANSMIT
              PduRDestPduRoutingType = API_FORWARDING
              PduRDestPduDataProcessing = IMMEDIATE
              PduRPduLengthHandlingStrategy = IGNORE
              PduRDestPduCrossPartitionDestination = false
              PduRDestPduDataProvision = PDUR_DIRECT
              PduRTransmissionConfirmation = true
              PduRDestPduRef = msg_Transmit_oCAN00_9631a86b_Tx
              PduRDestPduPduRBswModulesRef = CanIf
          msg_MyECU_Lamp_Mx_oCAN00_e57ca999_Tx
            msg_MyECU_Lamp_Mx_oCAN00_e57ca999_Tx (PduRDestPdu):
              PduRDestPduHandleId = 3
              PduRDestPduDirection = TRANSMIT
              PduRDestPduRoutingType = API_FORWARDING
              PduRDestPduDataProcessing = IMMEDIATE
              PduRPduLengthHandlingStrategy = IGNORE
              PduRDestPduCrossPartitionDestination = false
              PduRDestPduDataProvision = PDUR_DIRECT
              PduRTransmissionConfirmation = true
              PduRDestPduRef = msg_MyECU_Lamp_Mx_oCAN00_e57ca999_Tx
              PduRDestPduPduRBswModulesRef = IpduM
            PduRSrcPdu_289484a7 (PduRSrcPdu): PduRSourcePduHandleId=3, PduRSrcPduDirection=TRANSMIT, PduRSrcPduRef=msg_MyECU_Lamp_Mx_oCAN00_e57ca999_Tx, PduRSrcPduPduRBswModulesRef=Com
          msg_MyECU_Lamp_MxA1_oCAN00_7bc5773a_Tx
            PduRSrcPdu_f7c31f09 (PduRSrcPdu): PduRSourcePduHandleId=1, PduRSrcPduDirection=TRANSMIT, PduRSrcPduRef=msg_MyECU_Lamp_MxA1_oCAN00_7bc5773a_Tx, PduRSrcPduPduRBswModulesRef=Com
            msg_MyECU_Lamp_MxA1_oCAN00_7bc5773a_Tx (PduRDestPdu):
              PduRDestPduHandleId = 1
              PduRDestPduDirection = TRANSMIT
              PduRDestPduRoutingType = API_FORWARDING
              PduRDestPduDataProcessing = IMMEDIATE
              PduRPduLengthHandlingStrategy = IGNORE
              PduRDestPduCrossPartitionDestination = false
              PduRDestPduDataProvision = PDUR_DIRECT
              PduRTransmissionConfirmation = true
              PduRDestPduRef = msg_MyECU_Lamp_MxA1_oCAN00_7bc5773a_Tx
              PduRDestPduPduRBswModulesRef = IpduM
          msg_MyECU_Lamp_MxA0_oCAN00_b76f77a4_Tx
            msg_MyECU_Lamp_MxA0_oCAN00_b76f77a4_Tx (PduRDestPdu):
              PduRDestPduHandleId = 0
              PduRDestPduDirection = TRANSMIT
              PduRDestPduRoutingType = API_FORWARDING
              PduRDestPduDataProcessing = IMMEDIATE
              PduRPduLengthHandlingStrategy = IGNORE
              PduRDestPduCrossPartitionDestination = false
              PduRDestPduDataProvision = PDUR_DIRECT
              PduRTransmissionConfirmation = true
              PduRDestPduRef = msg_MyECU_Lamp_MxA0_oCAN00_b76f77a4_Tx
              PduRDestPduPduRBswModulesRef = IpduM
            PduRSrcPdu_991c8b02 (PduRSrcPdu): PduRSourcePduHandleId=0, PduRSrcPduDirection=TRANSMIT, PduRSrcPduRef=msg_MyECU_Lamp_MxA0_oCAN00_b76f77a4_Tx, PduRSrcPduPduRBswModulesRef=Com
          msg_MyECU_Lamp_MxA2_oCAN00_f54a70d9_Tx
            PduRSrcPdu_e44218bb (PduRSrcPdu): PduRSourcePduHandleId=2, PduRSrcPduDirection=TRANSMIT, PduRSrcPduRef=msg_MyECU_Lamp_MxA2_oCAN00_f54a70d9_Tx, PduRSrcPduPduRBswModulesRef=Com
            msg_MyECU_Lamp_MxA2_oCAN00_f54a70d9_Tx (PduRDestPdu):
              PduRDestPduHandleId = 2
              PduRDestPduDirection = TRANSMIT
              PduRDestPduRoutingType = API_FORWARDING
              PduRDestPduDataProcessing = IMMEDIATE
              PduRPduLengthHandlingStrategy = IGNORE
              PduRDestPduCrossPartitionDestination = false
              PduRDestPduDataProvision = PDUR_DIRECT
              PduRTransmissionConfirmation = true
              PduRDestPduRef = msg_MyECU_Lamp_MxA2_oCAN00_f54a70d9_Tx
              PduRDestPduPduRBswModulesRef = IpduM
      PduRLock_PduRExclusiveArea (PduRLock)
        PduRExclusiveArea: PduRExclusiveAreaId=0
    3 x PduRBswModules, all with PduRCancelReceive=false, PduRCancelTransmit=false, PduRChangeParameterRequestApi=false, PduRCommunicationInterface=true, PduRTransportProtocol=false, PduRTriggertransmit=false, PduRTxConfirmation=true, PduRUseTag=false:
      CanIf: PduRLowerModule=true, PduRUpperModule=false, PduRBswModuleRef=CanIf
      Com: PduRLowerModule=false, PduRUpperModule=true, PduRBswModuleRef=Com
      IpduM: PduRLowerModule=true, PduRUpperModule=true, PduRBswModuleRef=IpduM
