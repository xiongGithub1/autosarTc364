AUTOSAR XML (schema 00048)
package /ActiveEcuC
  module config PduR: implementation-config-variant=VARIANT-PRE-COMPILE, module-description=PduR_Impl
    PduRGeneral:
      PduRDevErrorDetect = true
      PduRVersionInfoApi = false
      PduRMetaDataSupport = false
      PduRPduCallback = false
      PduRSwitching = false
      PduRSafeBswChecks = false
      PduREnableDeferredTransmission = false
      PduREnableDeferredReception = false
      PduRSupportMulticore = false
      PduRRoutingTypeGateway = false
      PduRSpinlockRetryCounter = 4294967295
      PduRExtendedErrorChecks = false
      PduRGeneration:
        PduROutOfBoundsWriteProtectionStrategy = NONE
        PduROutOfBoundsWriteSanitizer = false
        PduROutOfBoundsReadSanitizer = false
        PduRNumericalDataTypeMinimizationStrategy = WITH_CAST
        PduRReduceConstantData2Define = false
        PduRBoolDataInArrayOfStructStrategy = BITMASKING
        PduRDeduplicateIndirectedData = true
        PduRDataDeduplicationStrategy = WITH_CAST
        PduRReduceBoolDataByNegationThreshold = 2
        PduRReduceBoolDataByNumericalComparisonThreshold = 2
        PduRReduceBoolDataByNumericalRelationThreshold = 2
        PduRReduceBoolDataByNumericalOperandStrategy = WITH_ANY_VALUE
        PduRReduceNumericalDataByOffsetThreshold = 2
        PduRReduceNumericalDataByArraySubtractionThreshold = 2
        PduRReduceDataByStreaming = false
        PduRShortSymbols = false
        PduRInterfacesForDeactivatedData = false
        PduRReferringKeysInComments = false
    PduRRoutingTables: PduRConfigurationId=0
      PduRRoutingTable
        7 x PduRRoutingPath, all with PduRMulticoreRoutingPath=false, PduRLockRef=PduRLock_PduRExclusiveArea:
          msg_Receive_oCAN00_3867e0b8_Rx: PduRRoutingPathCommunicationType=COMMUNICATION_INTERFACE
            PduRSrcPdu_16740ed0 (PduRSrcPdu): PduRSourcePduHandleId=0, PduRSrcPduDirection=RECEIVE, PduRSrcPduRef=msg_Receive_oCAN00_3867e0b8_Rx, PduRSrcPduPduRBswModulesRef=CanIf
            msg_Receive_oCAN00_3867e0b8_Rx_16740ed0_Rx (PduRDestPdu):
              PduRDestPduHandleId = 0
              PduRDestPduDirection = RECEIVE
              PduRDestPduRoutingType = API_FORWARDING
              PduRDestPduDataProcessing = IMMEDIATE
              PduRPduLengthHandlingStrategy = IGNORE
              PduRDestPduCrossPartitionDestination = false
              PduRTransmissionConfirmation = false
              PduRDestPduRef = msg_Receive_oCAN00_2b456e3f_Rx
              PduRDestPduPduRBswModulesRef = Com
          msg_Transmit_oCAN00_0723e95e_Tx: PduRRoutingPathCommunicationType=COMMUNICATION_INTERFACE
            PduRSrcPdu_087fd70d (PduRSrcPdu): PduRSourcePduHandleId=1, PduRSrcPduDirection=TRANSMIT, PduRSrcPduRef=msg_Transmit_oCAN00_0723e95e_Tx, PduRSrcPduPduRBswModulesRef=Com
            msg_Transmit_oCAN00_9631a86b_Tx (PduRDestPdu):
              PduRDestPduHandleId = 1
              PduRDestPduDirection = TRANSMIT
              PduRDestPduRoutingType = API_FORWARDING
              PduRDestPduDataProcessing = IMMEDIATE
              PduRPduLengthHandlingStrategy = IGNORE
              PduRDestPduCrossPartitionDestination = false
              PduRDestPduDataProvision = PDUR_DIRECT
              PduRTransmissionConfirmation = true
              PduRDestPduRef = msg_Transmit_oCAN00_9631a86b_Tx
              PduRDestPduPduRBswModulesRef = CanIf
          msg_MotorStatus_oCAN00_71118836_Tx: PduRRoutingPathCommunicationType=COMMUNICATION_INTERFACE
            msg_MotorStatus_oCAN00_a6063320_Tx (PduRDestPdu):
              PduRDestPduHandleId = 0
              PduRDestPduDirection = TRANSMIT
              PduRDestPduRoutingType = API_FORWARDING
              PduRDestPduDataProcessing = IMMEDIATE
              PduRPduLengthHandlingStrategy = IGNORE
              PduRDestPduCrossPartitionDestination = false
              PduRDestPduDataProvision = PDUR_DIRECT
              PduRTransmissionConfirmation = true
              PduRDestPduRef = msg_MotorStatus_oCAN00_a6063320_Tx
              PduRDestPduPduRBswModulesRef = CanIf
            PduRSrcPdu_96a7407f (PduRSrcPdu): PduRSourcePduHandleId=0, PduRSrcPduDirection=TRANSMIT, PduRSrcPduRef=msg_MotorStatus_oCAN00_71118836_Tx, PduRSrcPduPduRBswModulesRef=Com
          msg_diag_Request_MyECU_oCAN00_a823f7ba_Rx: PduRRoutingPathCommunicationType=TRANSPORT_PROTOCOL
            msg_diag_Request_MyECU_oCAN00_a823f7ba_Rx_11d927ad_Rx (PduRDestPdu):
              PduRDestPduHandleId = 1
              PduRDestPduDirection = RECEIVE
              PduRDestPduRoutingType = API_FORWARDING
              PduRDestPduDataProcessing = IMMEDIATE
              PduRPduLengthHandlingStrategy = UNUSED
              PduRDestPduCrossPartitionDestination = false
              PduRDestPduRef = msg_diag_Request_MyECU_oCAN00_956934ec_Rx
              PduRDestPduPduRBswModulesRef = Dcm
            PduRSrcPdu_11d927ad (PduRSrcPdu): PduRSourcePduHandleId=1, PduRSrcPduDirection=RECEIVE, PduRSrcPduRef=msg_diag_Request_MyECU_oCAN00_a823f7ba_Rx, PduRSrcPduPduRBswModulesRef=CanTp
          msg_diag_RequestGlobal_oCAN00_38f4a687_Rx: PduRRoutingPathCommunicationType=TRANSPORT_PROTOCOL
            msg_diag_RequestGlobal_oCAN00_38f4a687_Rx_fdd5755a_Rx (PduRDestPdu):
              PduRDestPduHandleId = 0
              PduRDestPduDirection = RECEIVE
              PduRDestPduRoutingType = API_FORWARDING
              PduRDestPduDataProcessing = IMMEDIATE
              PduRPduLengthHandlingStrategy = UNUSED
              PduRDestPduCrossPartitionDestination = false
              PduRDestPduRef = msg_diag_RequestGlobal_oCAN00_25be229e_Rx
              PduRDestPduPduRBswModulesRef = Dcm
            PduRSrcPdu_fdd5755a (PduRSrcPdu): PduRSourcePduHandleId=0, PduRSrcPduDirection=RECEIVE, PduRSrcPduRef=msg_diag_RequestGlobal_oCAN00_38f4a687_Rx, PduRSrcPduPduRBswModulesRef=CanTp
          msg_diag_Response_MyECU_oCAN00_f4dcbbcd_Tx: PduRRoutingPathCommunicationType=TRANSPORT_PROTOCOL
            PduRSrcPdu_f4835c60 (PduRSrcPdu): PduRSourcePduHandleId=2, PduRSrcPduDirection=TRANSMIT, PduRSrcPduRef=msg_diag_Response_MyECU_oCAN00_f4dcbbcd_Tx, PduRSrcPduPduRBswModulesRef=Dcm
            msg_diag_Response_MyECU_oCAN00_45311294_Tx (PduRDestPdu):
              PduRDestPduHandleId = 0
              PduRDestPduDirection = TRANSMIT
              PduRDestPduRoutingType = API_FORWARDING
              PduRDestPduDataProcessing = IMMEDIATE
              PduRPduLengthHandlingStrategy = UNUSED
              PduRDestPduCrossPartitionDestination = false
              PduRDestPduRef = msg_diag_Response_MyECU_oCAN00_45311294_Tx
              PduRDestPduPduRBswModulesRef = CanTp
          msg_nm_MyECU_oCAN00_92bb24c1_Tx: PduRRoutingPathCommunicationType=COMMUNICATION_INTERFACE
            PduRSrcPdu_f11d45ed (PduRSrcPdu): PduRSourcePduHandleId=3, PduRSrcPduDirection=TRANSMIT, PduRSrcPduRef=msg_nm_MyECU_oCAN00_92bb24c1_Tx, PduRSrcPduPduRBswModulesRef=Com
            msg_nm_MyECU_oCAN00_92bb24c1_Tx_f11d45ed_Tx (PduRDestPdu):
              PduRDestPduHandleId = 2
              PduRDestPduDirection = TRANSMIT
              PduRDestPduRoutingType = API_FORWARDING
              PduRDestPduDataProcessing = IMMEDIATE
              PduRPduLengthHandlingStrategy = IGNORE
              PduRDestPduCrossPartitionDestination = false
              PduRTransmissionConfirmation = true
              PduRDestPduDataProvision = PDUR_TRIGGERTRANSMIT
              PduRDestPduRef = msg_nm_MyECU_oCAN00_92bb24c1_Tx
              PduRDestPduPduRBswModulesRef = CanNm
      PduRLock_PduRExclusiveArea (PduRLock)
        PduRExclusiveArea: PduRExclusiveAreaId=0
    5 x PduRBswModules, all with PduRCancelReceive=false, PduRChangeParameterRequestApi=false:
      CanIf: PduRCancelTransmit=false, PduRCommunicationInterface=true, PduRLowerModule=true, PduRTransportProtocol=false, PduRTriggertransmit=false, PduRTxConfirmation=true, PduRUpperModule=false, PduRUseTag=false, PduRBswModuleRef=CanIf
      Com: PduRCancelTransmit=false, PduRCommunicationInterface=true, PduRLowerModule=false, PduRTransportProtocol=false, PduRTriggertransmit=true, PduRTxConfirmation=true, PduRUpperModule=true, PduRUseTag=false, PduRBswModuleRef=Com
      CanTp: PduRCancelTransmit=true, PduRCommunicationInterface=false, PduRLowerModule=true, PduRTransportProtocol=true, PduRTriggertransmit=false, PduRTxConfirmation=false, PduRUpperModule=false, PduRUseTag=false, PduRBswModuleRef=CanTp
      Dcm: PduRCancelTransmit=true, PduRCommunicationInterface=false, PduRLowerModule=false, PduRTransportProtocol=true, PduRTriggertransmit=false, PduRTxConfirmation=false, PduRUpperModule=true, PduRUseTag=true, PduRBswModuleRef=Dcm
      CanNm: PduRCancelTransmit=false, PduRCommunicationInterface=true, PduRLowerModule=true, PduRTransportProtocol=false, PduRTriggertransmit=true, PduRTxConfirmation=true, PduRUpperModule=false, PduRUseTag=false, PduRBswModuleRef=CanNm
