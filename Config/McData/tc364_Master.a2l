/* generated by ASAP2 Studio 2.1.50.8848 */
/* |  Description: Project specific master A2L file. The file may need to be adapted in order to match the ECU configuration */
/* | Copyright by Vector Informatik GmbH.     All rights reserved. */
/* | This software is copyright protected and proprietary to */
/* | Vector Informatik GmbH. Vector Informatik GmbH grants to you */
/* | only those rights as set out in the license conditions. All */
/* | other rights remain with Vector Informatik GmbH. */
/* | Initials     Name                      Company */
/* | Hs           Hannes Haas              Vector Informatik GmbH */
/* | Date        Version  Author  Description */
/* | 2012-11-23  1.00.00  Hs      Creation */
/* | 2020-03-23  1.01.00  Hr      Added CANAPE_ADDRESS_UPDATE */
/* | 2021-08-10  2.00.00  Hr      Replaced 1.2 AML by 1.4 AML */
/* |                              ESCAN00107626 a2l: Support XCPplus instead of XCP */ ASAP2_VERSION 1 71
/begin PROJECT MICROSAR ""
/begin MODULE CPP ""
/begin MOD_PAR "" /end MOD_PAR
/begin MOD_COMMON "" BYTE_ORDER MSB_LAST ALIGNMENT_BYTE 1 ALIGNMENT_WORD 2 ALIGNMENT_LONG 4 ALIGNMENT_FLOAT16_IEEE 2 ALIGNMENT_FLOAT32_IEEE 4 ALIGNMENT_FLOAT64_IEEE 8 ALIGNMENT_INT64 8 /end MOD_COMMON
/begin IF_DATA XCPplus 0x0104
 /begin PROTOCOL_LAYER 0x0104 0x07D0 0x2710 0x07D0 0x07D0 0x07D0 0x07D0 0x00 0x08 0x08 BYTE_ORDER_MSB_LAST ADDRESS_GRANULARITY_BYTE OPTIONAL_CMD SET_MTA OPTIONAL_CMD UPLOAD OPTIONAL_CMD SHORT_UPLOAD OPTIONAL_CMD TRANSPORT_LAYER_CMD /end PROTOCOL_LAYER
 /begin XCP_ON_CAN 0x0102 CAN_ID_MASTER 0x40000703 CAN_ID_SLAVE 0x40000704 BAUDRATE 0x07A120 SAMPLE_POINT 0x50 SAMPLE_RATE SINGLE BTL_CYCLES 0x14 SJW 0x01 MAX_DLC_REQUIRED
  /begin CAN_FD MAX_DLC 0x08 CAN_FD_DATA_TRANSFER_BAUDRATE 0x1E8480 SAMPLE_POINT 0x50 BTL_CYCLES 0x28 SJW 0x01 MAX_DLC_REQUIRED SECONDARY_SAMPLE_POINT 0x00 TRANSCEIVER_DELAY_COMPENSATION OFF /end CAN_FD
  /begin PROTOCOL_LAYER 0x0104 0x07D0 0x2710 0x07D0 0x07D0 0x07D0 0x07D0 0x00 0x08 0x08 BYTE_ORDER_MSB_LAST ADDRESS_GRANULARITY_BYTE OPTIONAL_CMD SET_MTA OPTIONAL_CMD UPLOAD OPTIONAL_CMD SHORT_UPLOAD /end PROTOCOL_LAYER
 /end XCP_ON_CAN
/end IF_DATA
/begin MEASUREMENT MotorCdd_FocContext.i_motor.u "" FLOAT32_IEEE NO_COMPU_METHOD 0 0 -3.40282346639E+38 3.40282346639E+38 ECU_ADDRESS 0x70000AC8 /end MEASUREMENT
/begin MEASUREMENT MotorCdd_FocContext.i_motor.v "" FLOAT32_IEEE NO_COMPU_METHOD 0 0 -3.40282346639E+38 3.40282346639E+38 ECU_ADDRESS 0x70000ACC /end MEASUREMENT
/begin MEASUREMENT MotorCdd_FocContext.i_motor.vdc "" FLOAT32_IEEE NO_COMPU_METHOD 0 0 -3.40282346639E+38 3.40282346639E+38 ECU_ADDRESS 0x70000AD4 /end MEASUREMENT
/begin MEASUREMENT MotorCdd_FocContext.i_motor.vdcMax "" FLOAT32_IEEE NO_COMPU_METHOD 0 0 -3.40282346639E+38 3.40282346639E+38 ECU_ADDRESS 0x70000AD8 /end MEASUREMENT
/begin MEASUREMENT MotorCdd_FocContext.i_motor.w "" FLOAT32_IEEE NO_COMPU_METHOD 0 0 -3.40282346639E+38 3.40282346639E+38 ECU_ADDRESS 0x70000AD0 /end MEASUREMENT
/begin MEASUREMENT MotorCdd_FocContext.idqMeas.imag "" FLOAT32_IEEE NO_COMPU_METHOD 0 0 -3.40282346639E+38 3.40282346639E+38 ECU_ADDRESS 0x70000B00 /end MEASUREMENT
/begin MEASUREMENT MotorCdd_FocContext.idqMeas.real "" FLOAT32_IEEE NO_COMPU_METHOD 0 0 -3.40282346639E+38 3.40282346639E+38 ECU_ADDRESS 0x70000AFC /end MEASUREMENT
/begin MEASUREMENT MotorCdd_FocContext.idqRef.imag "" FLOAT32_IEEE NO_COMPU_METHOD 0 0 -3.40282346639E+38 3.40282346639E+38 ECU_ADDRESS 0x70000AF8 /end MEASUREMENT
/begin MEASUREMENT MotorCdd_FocContext.idqRef.real "" FLOAT32_IEEE NO_COMPU_METHOD 0 0 -3.40282346639E+38 3.40282346639E+38 ECU_ADDRESS 0x70000AF4 /end MEASUREMENT
/begin CHARACTERISTIC MotorControll_IdRefCmd "" VALUE 0x70001094 __Float32_Value 0 NO_COMPU_METHOD -3.40282346639E+38 3.40282346639E+38 /end CHARACTERISTIC
/begin CHARACTERISTIC MotorControll_IqRefCmd "" VALUE 0x7000109C __Float32_Value 0 NO_COMPU_METHOD -3.40282346639E+38 3.40282346639E+38 /end CHARACTERISTIC
/begin CHARACTERISTIC MotorControll_MotorModeCmd "" VALUE 0x70001207 __SByte_Value 0 Table_492 -128 127 /end CHARACTERISTIC
/begin COMPU_METHOD Table_492 "" TAB_VERB "%6.3" "" COMPU_TAB_REF Table_492 /end COMPU_METHOD
/begin COMPU_VTAB Table_492 "" TAB_VERB 8 0 "MOTOR_MODE_IDLE" 1 "MOTOR_MODE_STOP" 2 "MOTOR_MODE_FOC_SPEED" 3 "MOTOR_MODE_FOC_CURRENT" 4 "MOTOR_MODE_OPEN_LOOP" 5 "MOTOR_MODE_CALIBRATION" 6 "MOTOR_MODE_CALIBRATION_ERASE" 7 "MOTOR_MODE_CALIBRATION_SAVE" /end COMPU_VTAB
/begin RECORD_LAYOUT VECTOR_RL_BOOLEAN FNC_VALUES 1 UBYTE ROW_DIR DIRECT /end RECORD_LAYOUT
/begin RECORD_LAYOUT VECTOR_RL_FLOAT32_IEEE FNC_VALUES 1 FLOAT32_IEEE ROW_DIR DIRECT /end RECORD_LAYOUT
/begin RECORD_LAYOUT VECTOR_RL_FLOAT64_IEEE FNC_VALUES 1 FLOAT64_IEEE ROW_DIR DIRECT /end RECORD_LAYOUT
/begin RECORD_LAYOUT VECTOR_RL_SBYTE FNC_VALUES 1 SBYTE ROW_DIR DIRECT /end RECORD_LAYOUT
/begin RECORD_LAYOUT VECTOR_RL_SLONG FNC_VALUES 1 SLONG ROW_DIR DIRECT /end RECORD_LAYOUT
/begin RECORD_LAYOUT VECTOR_RL_SWORD FNC_VALUES 1 SWORD ROW_DIR DIRECT /end RECORD_LAYOUT
/begin RECORD_LAYOUT VECTOR_RL_UBYTE FNC_VALUES 1 UBYTE ROW_DIR DIRECT /end RECORD_LAYOUT
/begin RECORD_LAYOUT VECTOR_RL_ULONG FNC_VALUES 1 ULONG ROW_DIR DIRECT /end RECORD_LAYOUT
/begin RECORD_LAYOUT VECTOR_RL_UWORD FNC_VALUES 1 UWORD ROW_DIR DIRECT /end RECORD_LAYOUT
/begin RECORD_LAYOUT __Float32_Value FNC_VALUES 1 FLOAT32_IEEE ROW_DIR DIRECT /end RECORD_LAYOUT
/begin RECORD_LAYOUT __SByte_Value FNC_VALUES 1 SBYTE ROW_DIR DIRECT /end RECORD_LAYOUT
/begin GROUP BswM "" /end GROUP
/begin GROUP CanIf "" /end GROUP
/begin GROUP CanSM "" /end GROUP
/begin GROUP Com "" /end GROUP
/begin GROUP ComM "" /end GROUP
/begin GROUP EcuM "" /end GROUP
/begin GROUP NvM "" /end GROUP
/begin GROUP Rte "" /end GROUP
/end MODULE
/end PROJECT
